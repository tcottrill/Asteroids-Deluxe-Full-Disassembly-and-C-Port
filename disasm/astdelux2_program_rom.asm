; Asteroids Deluxe (astdelux2) - program ROM ($6000-$7FFF), plain assembler-style listing
; GENERATED by mkplain.py from astdelux2_dump.bin - do not hand-edit.
;
; Subroutine and variable names are Atari's own, taken from the released
; rev 2 Asteroids Deluxe source archive
; (github.com/historicalsource/asteroids-deluxe) and placed on this ROM
; by matching instruction sequences (nameroutines.py) - nothing here is
; invented.  Comments to the right of an instruction, the blocks above a
; routine, and the ruled section banners are the ORIGINAL Atari comments,
; carried across the same way.  Lines marked '[note]' are this project's
; own descriptions, added where the source's comments are thin or absent
; (ROUTINE_NOTES in astdelux_config.py) - everything else is Atari's.
;
; Reading the names: NAME is a routine or data label from the source.
; NAME_20 is that routine's local label 20$ - a branch target inside it,
; kept under its owner's name.  RTS_n and NAME_RTS_n are the source's
; shared RTS labels (RTS.n there; '.' is not legal to the assembler).
; Lxxxx is an address the source does not name, and every line carries
; one so any byte can be referred to.  Packed message text is decoded
; in the comment as "TEXT" (msgtext.py).
;
; Memory map (see astdelux_defines.asm for the full glossary):
;     0000-00FF  page 0   scratch / globals
;     0100-01FF  page 1   6502 stack
;     0200-03FF  pages 2/3 player object state (bank-switched)
;     2000-3FFF  I/O
;     4000-47FF  vector RAM (2K) - the display list the DVG reads
;     4800-57FF  vector board ROM (4K) - 6502 code AND DVG picture
;                data, interleaved: TRIROT.MAC is `.ASECT` / `.=4800`,
;                so this ROM is not all display-list data.  Which bytes
;                are DVG opcodes (`.word`) and which are 6502 (decoded
;                as instructions) comes from the traced code/data map
;                (m6502trace.py), not a guess.
;     6000-7FFF  program ROM (8K)
;
; Symbol names are the originals - the source archive documents exactly
; this revision.
;
; Round-trip check: this file assembles back to the ROM bytes with ca65.
;     python mkplain.py --set astdelux2 --check
;
.include "astdelux_defines.asm"

.org $6000

;--------------------------------[ Vector ROM Forward Declarations ]--------------------------------

SPLTTP     = $4800
ATTACK     = $48BE
MULT       = $49B3
RANGE      = $49DF
CPUTD      = $4A1A
SCALER     = $4A2A
TRIPIX     = $4A6D
SETTIP     = $4A96
SINCOS     = $4B51
ROTAST     = $4B92
CHKST      = $4BD1
HITSCR     = $4D7D
EXPPIC     = $4D80
L4D81      = $4D81
L506A      = $506A
L506B      = $506B
SHIPS      = $53BC
L56F6      = $56F6
L56F7      = $56F7
VGMSGA     = $56F8
L56F9      = $56F9

;-------------------------------------[ Start Of Program ROM ]--------------------------------------

;----------------------------------------[ MAIN LINE LOOP ]-----------------------------------------

START:
; [note] Cold start of the game program: INIT, then the frame loop
L6000:  JSR INIT                ;($7BF5) INITIALIZE PLAYER 1 FOR START OF GAME
L6003:  LDA EAFLG               ;E.A. ROM BUSY ERASING?
L6005:  BNE START1              ;YEP. LEAVE IT ALONE
L6007:  STA EABC                ;STARTING @
L6009:  STA EAX
L600B:  STA EAHSX               ;INTO HS TABLE
L600D:  LDA #$20                ;READ COMMAND
L600F:  STA EAFLG

START1:
; [note] Start a new wave of asteroids, then fall into the frame loop
L6011:  JSR NEWAST              ;($698E) START UP NEW ASTEROIDS

START2:
; [note] The frame loop: wait for the DVG, then run one frame of the game
L6014:  BIT HALT                ;WAIT FOR VG TO FINISH
L6017:  BMI START2
L6019:  JSR ROTAST              ;($4B92) ROTATE THE ASTEROIDS

START2_10:
L601C:  LSR SYNC                ;WAIT FOR FRAME SYNCH
L601E:  BCC START2_10
L6020:  LDA FRAME               ;SET UP VG BUFFER
L6022:  AND #$01                ;EVEN/ODD
L6024:  ASL A
L6025:  TAX
L6026:  EOR #$02                ;FILL THE OTHER ONE
L6028:  TAY
L6029:  LDA RADDR,X             ;GET 'JMPL' INSTRUCTION
L602C:  STA VECRAM              ;GIVE IT TO VG
L602F:  LDA RADDR+1,X
L6032:  STA $4001
L6035:  LDA RADDR,Y
L6038:  ASL A
L6039:  STA VGLIST
L603B:  LDA RADDR+1,Y
L603E:  ROL A
L603F:  AND #$1F                ;ZAP OFF THE OPCODE
L6041:  ORA #$40                ;MERGE IN 6502 ADDRESS
L6043:  STA $04
L6045:  STA GOADD               ;START VG
L6048:  STA WTDOG               ;KICK THE DOG

START2_12:
L604B:  INC FRAME               ;NEXT FRAME PLEASE
L604D:  BNE START2_22
L604F:  INC $77                 ;COUNT TO 16 BITS
L6051:  LDA $8B                 ;MSB OF ADDRESS
L6053:  ORA #$50                ;CHECKSUM 5000-5800
L6055:  STA R1
L6057:  EOR #$38                ;CHECKSUM 6800-7000 TOO
L6059:  TAX
L605A:  EOR #$18                ;CHECKSUM 7000-7800
L605C:  STA R3
L605E:  LDA PROT                ;GET LOW ADDRESS
L6060:  STA R0                  ;PUT CHECKSUM ADDRESS IN R0,R1
L6062:  STA R2                  ;ALSO IN R2,R3
L6064:  LDY #$00                ;INDEX. ALSO A ZERO FOR LATER
L6066:  LDA $8D                 ;GET ACCUM
L6068:  CLC
L6069:  ADC (R0),Y              ;CS=CS+(5000+N)
L606B:  STX R1
L606D:  ADC (R0),Y              ;CS=CS+(6800+N)
L606F:  ADC (R2),Y              ;CS=CS+(7000+N)
L6071:  ADC #$00                ;CS=CS+CARRY
L6073:  INC PROT                ;NEXT ADDRESS
L6075:  BNE START2_11           ;NO OVERFLOW
L6077:  INC $8B                 ;HIGH ADDRESS
L6079:  CPX #$6F                ;END?
L607B:  BNE START2_11           ;NOPE
L607D:  STY $8B                 ;0 -> HIGH ADDRESS
L607F:  EOR #$03                ;SEED
L6081:  STA $8C                 ;SIGNAL ERROR OR NOT (S/B 0)
L6083:  LDX #$FC                ;MOVE STACK
L6085:  TXS
L6086:  STX HOLE                ;PUT A HOLE ON THE STACK
L6088:  TYA                     ;0 -> ACC

START2_11:
L6089:  STA $8D                 ;KEEP ACCUM

START2_22:
L608B:  JSR EAUPD               ;($7B11) DO EA ROM STUFF
L608E:  JSR CHKST               ;($4BD1) CHECK FOR START
L6091:  BCS START2_50           ;START NEW GAME
L6093:  JSR UPDATE              ;($6FF0) UPDATE HIGH SCORE TABLES
L6096:  JSR GETINT              ;($6587) GET INITIALS FOR ANY NEW HIGH SCORE
L6099:  BPL START2_20           ;UPDATE IN PROGRESS
L609B:  JSR SCORES              ;($6CB9) DISPLAY HIGH SCORES
L609E:  BCS START2_20           ;WE ARE DISPLAYING SCORE TABLE
L60A0:  LDA GDELAY              ;(NOT ENOUGH TIME FOR ASTEROIDS AND SCORE TABLES)
L60A2:  BNE START2_15           ;STARTING A NEW PLAYER
L60A4:  JSR SHIELD              ;($6675) CHECK FOR SHIELDS
L60A7:  JSR FIRE                ;($64BE) FIRE SHIPS TORPEDOS
L60AA:  JSR MOVE                ;($6847) MOVE SHIP BY CONTROLS
L60AD:  JSR SETTIP              ;($4A96)
L60B0:  JSR ENEMY               ;($6347) LAUNCH ENEMY SAUCER AND TORPEDOS

START2_15:
L60B3:  JSR MOTION              ;($66F8) MOVE OBJECTS
L60B6:  JSR COLIDE              ;($610E) CHECK FOR COLLISIONS

START2_20:
L60B9:  JSR PARAMS              ;($6A9A) DISPLAY SCORE AND OTHER PARAMETERS
L60BC:  JSR SOUNDS              ;($6F12) GENERATE SOUNDS
L60BF:  LDA #$7F
L60C1:  TAX
L60C2:  JSR VGSABS              ;($7A31) POSITION BEAM FOR MINIMUM CURRENT DRAW
L60C5:  JSR VGHALT              ;($79EC) ADD HALT TO VECTOR LIST
L60C8:  JSR PKYTST              ;($7FC1)
L60CB:  LDX HOLE                ;ARE WE TO TEST?
L60CD:  BEQ START2_21           ;NOPE. ONLY WORKS ONCE EXERY 2.5 HOURS
L60CF:  LDA NPLAYR              ;ATTRACT MODE?
L60D1:  BEQ START2_21           ;YEP. WAIT UNTIL GAME STARTS
L60D3:  PLA                     ;GRAB DATA OFF STACK
L60D4:  STA R0
L60D6:  PLA
L60D7:  STA R1
L60D9:  LDY #$00
L60DB:  STY HOLE                ;COVER OUR TRACKS
L60DD:  LDA #$81
L60DF:  EOR (R0),Y              ;IS THE JSRL IN THE VG MEMORY?
L60E1:  ORA CRMERR              ;ACCUMULATE ERRORS
L60E3:  STA CRMERR              ;KEEP RESULT
L60E5:  INY
L60E6:  LDA #$C3
L60E8:  EOR (R0),Y
L60EA:  ORA CRMERR
L60EC:  STA CRMERR              ;S/B 0

START2_21:
L60EE:  LDA RDELAY
L60F1:  BEQ START2_30           ;NO DELAY TO DECREMENT
L60F3:  DEC RDELAY

START2_30:
L60F6:  ORA NROCKS
L60F9:  BNE START2_40           ;LOOP FOR NEXT PASS

START2_50:
L60FB:  JMP START1              ;($6011) START NEW SET OF ASTEROIDS

START2_40:
L60FE:  JMP START2              ;($6014)

CKSUM2:
L6101:  .byte $31               ;1

CHKST2:
; [note] Display the PLAYER n message
L6102:  LDY #$01
L6104:  JSR VGMSG               ;($718F) DISPLAY "PLAYER" MESSAGE
L6107:  LDY PLAYR
L6109:  INY
L610A:  TYA                     ;1 OR 2
L610B:  JMP VGHEX               ;($79FD) DISPLAY PLAYER NUMBER

;----------------------------------[ COLLIDE-COLLISION DETECTOR ]-----------------------------------

COLIDE:
; [note] Collision detection for every object
L610E:  LSR CHIST               ;CLEAR SHIP COLLISION FLAG
L6110:  LDX #$07

COLIDE_10:
L6112:  LDA SHPPIX,X
L6115:  BEQ COLIDE_13           ;IF INACTIVE OBJECT
L6117:  BPL COLIDE_15           ;NOT EXPLODING

COLIDE_13:
L6119:  DEX
L611A:  BPL COLIDE_10
L611C:  BIT CHIST               ;DID SHIP COLLIDE WITH ANYTHING?
L611E:  BMI COLIDE_1            ;YEP
L6120:  STX $72                 ;NOPE. INVALIDATE FLAG (X IS -1 FROM ABOVE)

COLIDE_1:
L6122:  LDX HOLE
L6124:  BEQ COLIDE_2            ;NOT TIME TO TEST
L6126:  LDA VGLIST              ;SAVE THE POSITION OF THE JSRL
L6128:  STA $0101,X             ;ON THE HOLE IN THE STACK
L612B:  LDA $04
L612D:  STA $0102,X

COLIDE_2:
L6130:  RTS

COLIDE_15:
L6131:  LDY #$1A
L6133:  CPX #$04
L6135:  BCS COLIDE_20           ;NOT SAUCER OR SHIP OR SAUCERS TORPEDOES
L6137:  DEY                     ;BYPASS SAUCER TO SAUCER COLISION
L6138:  TXA
L6139:  BNE COLIDE_20           ;SHIP DOESN'T COLIDE WITH SHIP

COLIDE_19:
L613B:  DEY
L613C:  BMI COLIDE_13           ;END OF LOOP

COLIDE_20:
L613E:  LDA OBJ,Y
L6141:  BEQ COLIDE_19           ;IF INACTIVE
L6143:  BMI COLIDE_19           ;IF AN EXPLOSION

COLIDE_21:
L6145:  STA TEMP2
L6147:  LDA OBJXH,Y             ;DO A QUICK TEST BY SUBTRACTING THE HIGH BYTE
L614A:  SEC                     ;FROM EACH OTHER AND TESTING FOR A DIFFERENCE
L614B:  SBC SHPXH,X             ;TO BE -2,-1,0,+1 OR +2
L614E:  SBC #$03                ;(NORMALISES RESULT TO BE -6 <= X <= -1
L6150:  CMP #$FA                ;IN RANGE ?
L6152:  BCC COLIDE_19           ;NOPE. TOO FAR. SKIP IT
L6154:  LDA OBJYH,Y
L6157:  SBC SHPYH,X
L615A:  SBC #$03
L615C:  CMP #$FA
L615E:  BCC COLIDE_19
L6160:  LDA OBJXL,Y             ;TEST X DIRECTION
L6163:  SEC
L6164:  SBC SHPXL,X
L6167:  STA TEMP1
L6169:  LDA OBJXH,Y
L616C:  SBC SHPXH,X
L616F:  LSR A
L6170:  ROR TEMP1
L6172:  ASL A
L6173:  BEQ COLIDE_25           ;IF WITHIN 64.
L6175:  BPL COLIDE_19           ;TOO FAR AWAY
L6177:  EOR #$FE
L6179:  BNE COLIDE_19           ;TOO FAR AWAY
L617B:  LDA TEMP1
L617D:  EOR #$FF
L617F:  ADC #$00                ;(CARRY SET FROM ABOVE)
L6181:  STA TEMP1               ;ABS VALUE OF X DISTANCE BETWEEN OBJECTS

COLIDE_25:
L6183:  LDA OBJYL,Y
L6186:  SEC
L6187:  SBC SHPYL,X
L618A:  STA $0A
L618C:  LDA OBJYH,Y
L618F:  SBC SHPYH,X
L6192:  LSR A
L6193:  ROR $0A
L6195:  ASL A
L6196:  BEQ COLIDE_35           ;IF WITHIN 64.
L6198:  BPL COLIDE_19           ;TOO FAR AWAY
L619A:  EOR #$FE
L619C:  BNE COLIDE_19           ;TOO FAR AWAY
L619E:  LDA $0A
L61A0:  EOR #$FF
L61A2:  ADC #$00                ;(CARRY SET FROM ABOVE)
L61A4:  STA $0A                 ;DISTANCE-1 BETWEEN OBJECTS

COLIDE_35:
L61A6:  LDA #$04                ;SIZE ACCUMULATOR
L61A8:  CPX #$01
L61AA:  BEQ COLIDE_42           ;SAUCER
L61AC:  BCS COLIDE_41           ;TORPEDO
L61AE:  JSR SSZ                 ;($61FA) SHIP. GET ITS SIZE
L61B1:  BNE COLIDE_41           ;(ALWAYS)

COLIDE_42:
L61B3:  JSR SCRSZ               ;($6203) GET SAUCER SIZE

COLIDE_41:
L61B6:  CPY #$19                ;ROCK?
L61B8:  BCS COLIDE_43           ;NO
L61BA:  ADC #$2A                ;SMALLEST ROCK/ENEMY SIZE
L61BC:  LSR TEMP2
L61BE:  BCS COLIDE_38           ;SMALL
L61C0:  ADC #$1E
L61C2:  LSR TEMP2
L61C4:  BCS COLIDE_38           ;MEDIUM
L61C6:  ADC #$3C                ;LARGE
L61C8:  BCC COLIDE_38           ;(ALWAYS)

COLIDE_43:
L61CA:  BEQ COLIDE_44           ;SHIP
L61CC:  JSR SCRSZ               ;($6203) SAUCER/SNOWFLAKE
L61CF:  BNE COLIDE_38           ;(ALWAYS)

COLIDE_44:
L61D1:  JSR SSZ                 ;($61FA) SHIP

COLIDE_38:
L61D4:  CMP TEMP1
L61D6:  BCC COLIDE_40           ;NO HIT
L61D8:  CMP $0A
L61DA:  BCC COLIDE_40           ;NO HIT
L61DC:  STA TEMP2               ;COMPUTE 1.5 * ABS(MINIMUM DIFF)
L61DE:  LSR A
L61DF:  CLC
L61E0:  ADC TEMP2
L61E2:  ROR A                   ;SCALE IT
L61E3:  STA TEMP2               ;3/2 DISTANCE (NO CARRY IF LESS THAN 172.)
L61E5:  LDA $0A                 ;COMPUTE ABS(DIFFX) + ABS(DIFFY)
L61E7:  ADC TEMP1
L61E9:  ROR A                   ;SCALE IT
L61EA:  CMP TEMP2               ;CHOP OFF CORNERS
L61EC:  BCS COLIDE_40           ;MISSED
L61EE:  TXA                     ;SAVE X
L61EF:  PHA
L61F0:  JSR DSTRCT              ;($62C6) BLOW 'EM UP
L61F3:  PLA                     ;RESTORE X
L61F4:  TAX

COLIDE_39:
L61F5:  LDY #$00                ;CAUSE A 'JMP 13$'

COLIDE_40:
L61F7:  JMP COLIDE_19           ;($613B)

SSZ:
; [note] Add the ship's collision size to A
L61FA:  BIT SHDON               ;SHIELDS UP?
L61FC:  BPL SSZ_1               ;NO
L61FE:  ADC #$08                ;YES. USE SLIGHTLY LARGER PIX

SSZ_1:
L6200:  ADC #$1C                ;SHIP SIZE
L6202:  RTS

SCRSZ:
; [note] Add the saucer's collision size to A
L6203:  ADC #$1C                ;ASSME SMAL SAUCER
L6205:  PHA
L6206:  LDA SAUPIX
L6209:  LSR A
L620A:  PLA
L620B:  BCS SCRSZ_2             ;IS SMALL
L620D:  ADC #$12                ;LARGE

SCRSZ_2:
L620F:  RTS

;-------------------------------[ CPYPOS - COPY ATTRIBUTES OF ROCK ]--------------------------------

CPYPOS:
; ENTRY	(X)=NEW ROCK INDEX
; (Y)=OLD ROCK INDEX
L6210:  LDA OBJ,Y               ;COPY PICTURE
L6213:  AND #$07
L6215:  STA TEMP1               ;SAVE SIZE
L6217:  LDA RANDOM              ;RANDOM NUMBER
L621A:  AND #$18                ;PICTURE NUMBER
L621C:  ORA TEMP1
L621E:  STA OBJ,X
L6221:  LDA OBJXL,Y             ;COPY POSITION
L6224:  STA OBJXL,X
L6227:  LDA OBJXH,Y
L622A:  STA OBJXH,X
L622D:  LDA OBJYL,Y
L6230:  STA OBJYL,X
L6233:  LDA OBJYH,Y
L6236:  STA OBJYH,X
L6239:  LDA XINC,Y              ;COPY VELOCITY
L623C:  STA XINC,X
L623F:  LDA YINC,Y
L6242:  STA YINC,X
L6245:  RTS

;----------------------------[ CPYVXY/CPYVYX - COPY AND MODIFY VECTORS ]----------------------------

CPYVEC:
; ENTRY	(TEMP1)=MASK FOR X SIGN (0 OR 4)
; (TEMP1+1)=MASK FOR Y SIGN (0 OR 4)
; (X)=COUNT OF VECTORS TO MOVE
; (R0,R1)= @ OF VECTOR LIST
; (R2) = + IF NO X/Y SWAP TO TAKE PLACE
; EXIT	(VGLIST,VGLIST+1)=UPDATED VECTOR LIST POINTER
; (R0,R1),R2 UNMODIFIED
; (Y)=INDEX TO LAST BYTE OF VECTOR TABLE
; USES	A,X,Y,R3,R4
L6246:  LDY #$FF
L6248:  BIT R2                  ;SWAP?
L624A:  BMI CPYVYX              ;YEP

CPYVEC_10:
L624C:  INY
L624D:  INY
L624E:  LDA (R0),Y              ;GET OPCODE BYTE
L6250:  EOR $0A                 ;APPLY ANY SIGN CHANGES
L6252:  STA (VGLIST),Y          ;STUFF IT IN VG RAM
L6254:  DEY                     ;BACK UP TO LSB
L6255:  CMP #$F0                ;SHORT VECTOR?
L6257:  BCS CPYVEC_20           ;YEP.
L6259:  LDA (R0),Y              ;COPY REST
L625B:  STA (VGLIST),Y
L625D:  INY
L625E:  INY
L625F:  LDA (R0),Y
L6261:  STA (VGLIST),Y
L6263:  INY
L6264:  LDA (R0),Y
L6266:  EOR TEMP1               ;APPLY ANY SIGN CHANGES
L6268:  STA (VGLIST),Y

CPYVEC_15:
L626A:  DEX                     ;COUNT
L626B:  BPL CPYVEC_10
L626D:  JMP VGADD               ;($7A67) UPDATE VGLIST

CPYVEC_20:
L6270:  LDA (R0),Y              ;SHORT VECTOR INSTRUCTION
L6272:  EOR TEMP1               ;MASK FOR X SIGN
L6274:  STA (VGLIST),Y
L6276:  INY
L6277:  BNE CPYVEC_15           ;ALWAYS

;--------------------------------[ CPYVYX COPY AND MODIFY VECTORS ]---------------------------------

CPYVYX:
; [note] CPYVEC's loop: copy one vector instruction, rotating it via the sign bits
L6279:  INY
L627A:  LDA (R0),Y              ;GET LOW BYTE OF VECTOR INSTRUCTION
L627C:  STA R4                  ;SAVE IT
L627E:  INY
L627F:  LDA (R0),Y              ;GET OPCODE BYTE OF VECTOR
L6281:  CMP #$F0                ;TYPE?
L6283:  BCS CPYVYX_1            ;SHORT
L6285:  INY                     ;LONG. SKIP TO MSB OF X PART
L6286:  INY
L6287:  EOR (R0),Y              ;'A' = (OPCODE + MSB Y) .XOR. (Z + MSB X)
L6289:  AND #$0F                ;'A' = (MSB Y) .XOR. (MSB X)
L628B:  STA R3                  ;SAVE IT
L628D:  EOR (R0),Y              ;'A' = (MSB Y) .XOR. (MSB X) .XOR. (Z + MSB X)
L628F:  EOR TEMP1               ;APPLY SIGN CHANGE
L6291:  STA (VGLIST),Y          ;STUFF (Z + MSB Y) TO VG
L6293:  DEY                     ;BACK UP TO LS PART OF X
L6294:  LDA (R0),Y              ;GET LS X
L6296:  PHA                     ;SAVE IT
L6297:  LDA R4                  ;GET LS Y
L6299:  STA (VGLIST),Y          ;STUFF IT TO VG
L629B:  DEY                     ;BACK UP TO OPCODE BYTE
L629C:  LDA R3                  ;GET (MSB Y) .XOR. (MSB X)
L629E:  EOR $0A                 ;APPLY SIGN CHANGE
L62A0:  EOR (R0),Y              ;'A' = (MSB Y) .XOR. (MSB X) .XOR. (OPCODE + MSB Y)
L62A2:  STA (VGLIST),Y          ;STUFF (OPCODE + MSB X) TO VG RAM
L62A4:  DEY                     ;BACK UP TO FIRST BYTE OF INSTRUCTION
L62A5:  PLA                     ;GET LS X
L62A6:  STA (VGLIST),Y          ;PUT IT IN VG RAM
L62A8:  INY                     ;SKIP UP TO NEXT WORD
L62A9:  INY

CPYVYX_5:
L62AA:  INY
L62AB:  DEX                     ;COUNT
L62AC:  BPL CPYVYX              ;CONTINUE
L62AE:  JMP VGADD               ;($7A67)

CPYVYX_1:
L62B1:  EOR R4                  ;'A' = (Z + XAS + X) .XOR. (OPCODE + YAS + Y)
L62B3:  AND #$07                ;'A' = X .XOR. Y
L62B5:  PHA                     ;SAVE IT
L62B6:  EOR (R0),Y              ;'A' = X .XOR. Y .XOR. (OPCODE + YAS + Y)
L62B8:  EOR $0A                 ;APPLY ANY SIGN CORRECTION
L62BA:  STA (VGLIST),Y          ;STUFF (OPCODE + YAS + X) TO VG RAM
L62BC:  DEY                     ;BACK UP
L62BD:  PLA                     ;'A' = X .XOR. Y
L62BE:  EOR (R0),Y              ;'A' = (Z + XAS + X) .XOR. Y .XOR. X
L62C0:  EOR TEMP1               ;APPLY ANY SIGN CORRECTION
L62C2:  STA (VGLIST),Y          ;STUFF (Z + XAS + Y) TO VG RAM
L62C4:  BCS CPYVYX_5            ;(ALWAYS; CARRY STILL SET FROM ENTRY)

;------------------------------[ DSTRCT-DESTRUCTION DURING COLLISION ]------------------------------

DSTRCT:
; [note] Destruction after a collision; decides whether to bounce instead
L62C6:  JSR BOUNCE              ;($752C) SEE IF WE SHOULD BOUNCE
L62C9:  BCS SSBTLT_80           ;BLOW UP SAUCER.
L62CB:  CPX #$01
L62CD:  BNE DSTRCT_60           ;NOT SAUCER HITTING SHIP OR ROCKS

DSTRCT_1:
; RETURNS IF NO SHIELDS
; ELSE DOESN'T RETURN AT ALL
L62CF:  CPY #$19
L62D1:  BNE DSTRCT_62           ;SAUCER HIT ROCK
L62D3:  DEX                     ;X=0
L62D4:  INY                     ;Y=NOBJ+1

DSTRCT_60:
L62D5:  TXA
L62D6:  BNE DSTRCT_63           ;IF NOT SHIP HIT A ROCK
L62D8:  JSR BLOUP_10            ;($631D) SHIP CRASHED. TAKE A LIFE

DSTRCT_62:
L62DB:  LDA #$A0
L62DD:  STA SHPPIX,X            ;EXPLOSION TIMER
L62E0:  LDA #$00
L62E2:  STA SHPXI,X             ;STOP SHIP/SAUCER/TORPEDO
L62E5:  STA SHPYI,X

DSTRCT_61:
L62E8:  CPY #$19
L62EA:  BCC DSTRCT_65           ;SHIP OR SAUCER HITTING ROCK
L62EC:  BCS SSBTLT_80           ;SHIP & SAUCER COLLIDE

DSTRCT_63:
L62EE:  LDA #$00
L62F0:  STA SHPPIX,X            ;CLEAR TORPEDO
L62F3:  CPY #$19
L62F5:  BEQ BLOUP_75            ;HIT SHIP WITH TORPEDO
L62F7:  BCS SSBTLT_80           ;HIT SAUCER WITH TORPEDO

DSTRCT_65:
L62F9:  JSR SPLIT               ;($6F7E) SPLIT UP ROCKS

BLOUP:
; [note] Explosion size for object Y: small, medium or large
L62FC:  LDA OBJ,Y
L62FF:  AND #$03                ;SIZE 0=SMALL,1=MEDUIM,2=LARGE
L6301:  EOR #$02                ;2=SMALL,3=MEDUIM,0=LARGE
L6303:  LSR A
L6304:  ROR A
L6305:  ROR A
L6306:  ORA #$3F                ;LENGTH OF EXPLOSION
L6308:  STA LEXPSND
L630A:  LDA #$A0                ;TIMER FOR EXPLOSION
L630C:  STA OBJ,Y               ;STOP OBJECTS MOTION
L630F:  LDA #$00
L6311:  STA XINC,Y
L6314:  STA YINC,Y

BLOUP_90:
L6317:  RTS

BLOUP_75:
L6318:  JSR BLOUP_10            ;($631D) SHIP CRASHED. TAKE A LIFE
L631B:  BNE BLOUP               ;(ALWAYS)

BLOUP_10:
L631D:  TXA                     ;SAVE X
L631E:  LDX PLAYR
L6320:  DEC HITS,X              ;TAKE A LIFE
L6322:  TAX                     ;RESTORE X
L6323:  LDA #$81                ;DELAY BEFORE RENTRY

SSBTLT:
; [note] Set the saucer delay and the ship's back-to-life timer
L6325:  STA SDELAY
L6328:  LDA #$05
L632A:  STA SBTLT
L632C:  RTS

SSBTLT_80:
L632D:  LDA SEDLAY
L6330:  STA EDELAY              ;DELAY BEFORE ENTERING SAUCER
L6333:  LDA NPLAYR
L6335:  BEQ BLOUP               ;IF IN ATTRACT
L6337:  LDA SAUPIX
L633A:  LSR A

SSBTLT_86:
L633B:  LDA #$00                ;1000 FOR SMALL
L633D:  BCS SSBTLT_85           ;IF SMALL SAUCER
L633F:  LDA #$20                ;200 POINTS FOR LARGE SAUCER

SSBTLT_85:
L6341:  JSR POINTS              ;($6C60) ADD 1000 PTS AND CHECK FOR 10K
L6344:  JMP BLOUP               ;($62FC)

;-----------------------------------[ ENEMY-LAUNCH EMEMY SAUCER ]-----------------------------------

ENEMY:
; [note] The saucer: launch it, or let it shoot
L6347:  LDA FRAME
L6349:  AND #$03                ;ONLY EVERY 4TH FRAME
L634B:  BEQ ENEMY_1

ENEMY_50:
L634D:  RTS

ENEMY_1:
L634E:  LDA SAUPIX              ;SAUCER
L6351:  BEQ ENEMY_15            ;NOT ALIVE
L6353:  BPL ENEMY_16            ;ALIVE. GO SHOOT
L6355:  LDY #$17                ;BLOWING UP
L6357:  JMP SNDOFF              ;($7752)

ENEMY_16:
L635A:  JMP EFIRE               ;($63E6) GO SHOOT

ENEMY_15:
L635D:  JSR SRSAUC              ;($6835) POSITION OFF SCREEN
L6360:  LDA NPLAYR
L6362:  BEQ ENEMY_6             ;IF IN ATTRACT SEND IN SAUCER
L6364:  LDA SHPPIX
L6367:  BEQ ENEMY_50            ;IF YOU ARE NOT VISIBLE
L6369:  BMI ENEMY_50            ;IF EXPLODING

ENEMY_6:
L636B:  LDA RTIMER
L636E:  BEQ ENEMY_2             ;IF TIMER ALREADY
L6370:  DEC RTIMER              ;DECREMENT ZERO TIMER

ENEMY_2:
L6373:  DEC EDELAY
L6376:  BNE ENEMY_50            ;NO TIME YET
L6378:  LDA #$01                ;IF 18., THEN GAME CAN PLAY INDEFINITE
L637A:  STA EDELAY              ;DELAY BEFORE SHOOTING OR ENTERING
L637D:  LDX NROCKS
L6380:  BEQ ENEMY_50            ;NO ROCKS
L6382:  LDA RTIMER
L6385:  BEQ ENEMY_5             ;IF NO ROCKS HIT ENTER SAUCER
L6387:  CPX DIFCTY
L638A:  BCS ENEMY_50            ;TOO MANY ROCKS

ENEMY_5:
L638C:  LDA SEDLAY
L638F:  SEC
L6390:  SBC #$06
L6392:  CMP #$20
L6394:  BCC LSF                 ;IF BELOW MINIMUM
L6396:  STA SEDLAY

LSF:
; [note] Launch a saucer from one side at a random height
L6399:  LDA RANDOM              ;RANDOM NUMBER
L639C:  LSR A
L639D:  ROR SAUYL
L63A0:  LSR A
L63A1:  ROR SAUYL
L63A4:  LSR A
L63A5:  ROR SAUYL
L63A8:  ADC #$04
L63AA:  CMP #$12
L63AC:  BCC LSF_10              ;MUST BE 0 TO 767
L63AE:  SBC #$10

LSF_10:
L63B0:  STA SAUYH               ;STARTING VERTICAL POSITION
L63B3:  LDA RANDOM              ;RANDOM NUMBER
L63B6:  ASL A                   ;DIRECTION INTO CARRY
L63B7:  LDA #$00                ;ASSUME START ON LEFT
L63B9:  TAX                     ;LOX #0
L63BA:  LDY #$10                ;VELOCITY +
L63BC:  BCC LSF_20
L63BE:  DEX                     ;LDX #-1
L63BF:  LDA #$1F
L63C1:  LDY #$F0

LSF_20:
L63C3:  STY SAUXI               ;VELOCITY IN X
L63C6:  STA SAUXH               ;X POS MSB
L63C9:  STX SAUXL               ;X POS LSB
L63CC:  LDY #$02
L63CE:  LDA DIFCTY
L63D1:  SEC
L63D2:  SBC NROCKS              ;DIFCTY-NROCKS
L63D5:  CMP #$04                ;DIFFERENCE LARGE?
L63D7:  BCC LSF_40              ;NO. USE SLUGGO
L63D9:  DEY                     ;SMALL SAUCER

LSF_40:
L63DA:  STY SAUPIX              ;USE MEDUIM SIZE PICTURE
L63DD:  LDA L63E1+2,Y
L63E0:  TAY
L63E1:  JMP SNDON               ;($775B) TURN ON SAUCER SOUND

SPSND:
L63E4:  .byte $17, $37          ;.7

;-----------------------------------[ EFIRE-ENEMY FIRE CONTROL ]------------------------------------

EFIRE:
; [note] Enemy fire control: the saucer's aim and torpedo
L63E6:  LDA FRAME
L63E8:  ASL A
L63E9:  BNE EFIRE_10            ;NOT TIME TO CHANGE DIRECTION
L63EB:  LDA RANDOM              ;RANDOM NUMBER
L63EE:  AND #$03
L63F0:  TAX
L63F1:  LDA EFIRE_99,X
L63F4:  STA SAUYI

EFIRE_10:
L63F7:  LDA NPLAYR
L63F9:  BEQ EFIRE_30            ;IF IN ATTRACT
L63FB:  LDA SDELAY
L63FE:  BNE EFIRE_40            ;DONT FIRE IF YOU ARE DEAD

EFIRE_30:
L6400:  DEC EDELAY
L6403:  BEQ EFIRE_50            ;TIME TO SHOOT

EFIRE_40:
L6405:  RTS

EFIRE_50:
L6406:  LDA #$0A
L6408:  STA EDELAY              ;DELAY BEFORE NEXT SHOT
L640B:  LDY #$19                ;POINT TO SHIP
L640D:  LDA NPLAYR              ;ATTRACT MODE?
L640F:  BEQ EFIRE_82            ;YES. SHOOT AT ROCK
L6411:  LDA RANDOM              ;RANDOM NUMBER
L6414:  LDX $8C                 ;CHECKSUMM ERRORS?
L6416:  BNE EFIRE_96            ;YEP. SHOOT WILD
L6418:  LDX #$AA                ;SHOOT AT PLAYER 2 OUT OF 3
L641A:  LDA SAUPIX
L641D:  LSR A
L641E:  BCS EFIRE_80            ;LITTLE
L6420:  LDX #$40                ;SHOOT AT PLAYER 1 OUT OF 4

EFIRE_80:
L6422:  CPX RANDOM              ;TEST
L6425:  BCS EFIRE_81            ;SHOOT @ PLAYER

EFIRE_82:
L6427:  JSR LFCR                ;($6482) SHOOT @ ROCK

EFIRE_81:
L642A:  STY R8                  ;SAVE Y
L642C:  LDX #$1A                ;SAUCER IS DOING THE SHOOTING
L642E:  JSR CPUTD               ;($4A1A) COMPUTE X DISTANCE
L6431:  JSR RANGE               ;($49DF) CHECK DIRECTION
L6434:  STA R3                  ;SAVE DIFFERENCE
L6436:  LDA TEMP2
L6438:  STA R2
L643A:  LDA R8                  ;GET OBJ PTR
L643C:  CLC
L643D:  ADC #$21
L643F:  TAY
L6440:  LDX #$3B                ;POINT TO Y PARAMETERS
L6442:  JSR CPUTD               ;($4A1A) COMPUTE Y DISTANCE
L6445:  JSR RANGE               ;($49DF) BE REAL MEAN
L6448:  JSR SCALER              ;($4A2A) SCALE DIFFERENCES, GET ARCTAN
L644B:  STA $7A
L644D:  LDA R8
L644F:  CMP #$19                ;SHOOTING AT SHIP?
L6451:  BNE EFIRE_91            ;NO. BE QUITE ACCURATE
L6453:  LDX PLAYR3              ;PLAYER NUMBER * 3
L6455:  LDA $64,X               ;MSD OF SCORE
L6457:  LDX #$00
L6459:  CMP $06                 ;SCORE > 60,000?
L645B:  BCC EFIRE_90            ;NO
L645D:  INX                     ;GET MAD

EFIRE_90:
L645E:  LDA RANDOM              ;RANDOM NUMBER
L6461:  AND EFIRE_97,X
L6464:  BPL EFIRE_95            ;NO SIGN EXTENSION
L6466:  ORA EFIRE_98,X

EFIRE_95:
L6469:  ADC $7A                 ;DONT BE TOO GOOD-JUST CLOSE

EFIRE_96:
L646B:  STA $7A                 ;ANGLE TO AIM

EFIRE_91:
L646D:  LDY #$03                ;START LOOKING HERE
L646F:  LDA #$01                ;FIRE FOR SAUCER
L6471:  STA $0F                 ;2 SAUCER TORPEDOS
L6473:  LDX R8                  ;POINT TO OBJ
L6475:  STA R8                  ;SAUCER INDEX
L6477:  JMP FIRE1               ;($64E4) FIRE A TORPEDO

EFIRE_97:
L647A:  .byte $8F, $87          ;..

EFIRE_98:
L647C:  .byte $70, $78          ;px

EFIRE_99:
L647E:  .byte $F0, $00, $00, $10 ;....

LFCR:
; LOOK FOR CLOSE ROCK
; AT ENTRY;
; (Y) MUST=NOBJ
; AT EXIT:
; (Y)=@ OF ROCK TO SHOOT AT OR # NOBJ IF NO ROCKS
L6482:  DEY

LFCR_2:
L6483:  LDA OBJ,Y
L6486:  BNE LFCR_1

LFCR_3:
L6488:  DEY
L6489:  BPL LFCR_2
L648B:  LDY #$19                ;REALLY NO ROCKS SO SHOOT @ SHIP
L648D:  SEC
L648E:  RTS

LFCR_1:
L648F:  BMI LFCR_3              ;BLOWING UP
L6491:  CMP #$40                ;SPECIAL ROCK?
L6493:  BCC LFCR_4              ;NO
L6495:  LSR A
L6496:  LSR A
L6497:  TAX
L6498:  LDA EDELAY,X            ;IS IT FLYING?
L649B:  BPL LFCR_3              ;YEP. SKIP IT
L649D:  CLC
L649E:  RTS                     ;SHOOT IT ANYWAY

LFCR_4:
L649F:  LDA SAUXH               ;GET ABS (DIFFX)
L64A2:  SEC
L64A3:  SBC OBJXH,Y
L64A6:  BPL LFCR_6
L64A8:  EOR #$FF

LFCR_6:
L64AA:  CMP #$08                ;ARE THEY CLOSE IN X?
L64AC:  BCS LFCR_3              ;NO. FORGET IT
L64AE:  LDA SAUYH               ;GET ABS (DIFFY)
L64B1:  SEC
L64B2:  SBC OBJYH,Y
L64B5:  BPL LFCR_7
L64B7:  EOR #$FF

LFCR_7:
L64B9:  CMP #$08                ;ARE THEY CLOSE IN Y?
L64BB:  BCS LFCR_3
L64BD:  RTS

;-----------------------------------[ FIRE-FIRE SHIPS TORPEDOS ]------------------------------------

FIRE:
; [note] The fire button, then into FIRE1
L64BE:  LDA NPLAYR
L64C0:  BEQ FIRE2               ;IN ATTRACT
L64C2:  BIT SHDON               ;SHIELDS?
L64C4:  BMI FIRE2               ;YEP. CAN'T FIRE
L64C6:  ASL FIRESW              ;FULLY DECODED FOR R/W
L64C9:  ROR LASTSW
L64CB:  BIT LASTSW
L64CD:  BPL FIRE2               ;BUTTON NOT ON
L64CF:  BVS FIRE2               ;BUTTON NOT DIFFERENT FROM LAST TIME
L64D1:  LDA SDELAY              ;FIRE
L64D4:  BNE FIRE2               ;SHIP NOT VISIBLE YET
L64D6:  STA R8                  ;POINT TO SHIP
L64D8:  LDA #$03
L64DA:  STA $0F                 ;STOPPING INDEX FOR SHIP
L64DC:  LDX #$19                ;POINT TO SHIP
L64DE:  LDA ANGLE
L64E0:  STA $7A                 ;INDICATE DIRECTION
L64E2:  LDY #$07                ;NUMBER OF TORPEDOS ALLOWED

FIRE1:
; [note] Find a free torpedo slot for a ship or saucer launch
L64E4:  LDA SHPPIX,Y            ;SHIP/SAUCER TORPEDO LAUNCH
L64E7:  BEQ FIRE3               ;WE FOUND INACTIVE ONE
L64E9:  DEY
L64EA:  CPY $0F
L64EC:  BNE FIRE1

FIRE2:
; [note] Shared return
L64EE:  RTS                     ;FIND INACTIVE TORPEDO TO USE

FIRE3:
; [note] Launch a torpedo into slot Y
L64EF:  STX TEMP3
L64F1:  LDA #$12
L64F3:  STA SHPPIX,Y            ;SET TIMER FOR LENGTH OF LIFE
L64F6:  LDA $7A
L64F8:  JSR COS                 ;($7134) COS(ANGLE)-SHIPS SPEED=X CHANGE TO TORPEDO
L64FB:  LDX TEMP3
L64FD:  CMP #$80                ;DIVIDE BY 2
L64FF:  ROR A                   ;SS999.BBB
L6500:  STA $0A
L6502:  CLC
L6503:  ADC XINC,X              ;ADD IN VELOCITY OF OBJECT
L6506:  BMI FIRE3_23            ;IF NEGATVE
L6508:  CMP #$70
L650A:  BCC FIRE3_30            ;IF MAX NOT EXCEEDED
L650C:  LDA #$6F
L650E:  BNE FIRE3_30            ;ALWAYS

FIRE3_23:
L6510:  CMP #$91
L6512:  BCS FIRE3_30            ;IF MIN NOT EXCEEDED
L6514:  LDA #$91

FIRE3_30:
L6516:  STA SHPXI,Y             ;SET X SPEED
L6519:  LDA $7A
L651B:  JSR SIN                 ;($7137) SIN (ANGLE)
L651E:  LDX TEMP3
L6520:  CMP #$80                ;DIVIDE BY 2
L6522:  ROR A                   ;SSAAA.BBB
L6523:  STA $0D
L6525:  CLC
L6526:  ADC YINC,X              ;ADD IN VELOCITY OF OBJ
L6529:  BMI FIRE3_33            ;IF NEGATIVE
L652B:  CMP #$70
L652D:  BCC FIRE3_40            ;IF IN RANGE
L652F:  LDA #$6F                ;SET MAX
L6531:  BNE FIRE3_40            ;ALWAYS

FIRE3_33:
L6533:  CMP #$91
L6535:  BCS FIRE3_40            ;IF IN RANGE
L6537:  LDA #$91

FIRE3_40:
L6539:  STA SHPYI,Y
L653C:  LDX #$00
L653E:  LDA $0A                 ;SCALE TO PUT TORP AT NOSE OF SHIP
L6540:  BPL FIRE3_45            ;SIGN EXTENSION
L6542:  DEX                     ;LDX I,0FF

FIRE3_45:
L6543:  STX TEMP1
L6545:  LDX R8                  ;SHIP/SAUCER INDEX
L6547:  CMP #$80
L6549:  ROR A
L654A:  CLC
L654B:  ADC $0A                 ;MULTIPLY BY 3/2
L654D:  CLC
L654E:  ADC SHPXL,X             ;ADD SHIP/SAUCER POSITION TO GET STARTING POSITION
L6551:  STA SHPXL,Y             ;OF TORPEDO
L6554:  LDA TEMP1
L6556:  ADC SHPXH,X
L6559:  STA SHPXH,Y
L655C:  LDX #$00
L655E:  LDA $0D                 ;SCALE AGAIN TO PUT AT NOSE
L6560:  BPL FIRE3_50            ;SIGN EXTENSION
L6562:  DEX                     ;LDX I,0FF

FIRE3_50:
L6563:  STX TEMP2
L6565:  LDX R8                  ;SHIP/SAUCER INDEX
L6567:  CMP #$80
L6569:  ROR A
L656A:  CLC
L656B:  ADC $0D                 ;MULTIPLY BY 3/2
L656D:  CLC
L656E:  ADC SHPYL,X             ;ADD SHIPS POSITION TO GET STARTING POSITION
L6571:  STA SHPYL,Y
L6574:  LDA TEMP2
L6576:  ADC SHPYH,X
L6579:  STA SHPYH,Y
L657C:  LDY #$27                ;ASSUME WE'RE TO DO PLAYER SOUND
L657E:  CPX #$01                ;SHIP/SAUCER SELECT INTO CARRY
L6580:  BCC FIRE3_51            ;PLAYER
L6582:  LDY #$1F                ;SAUCER

FIRE3_51:
L6584:  JMP SNDOO               ;($775C) GO TURN ON SOUND

;--------------------------[ GETINT-GET PLAYERS INITIALS FOR HIGH SCORE ]---------------------------

GETINT:
; [note] Get the player's initials for a high score
L6587:  LDA UPDFLG
L6589:  AND $43
L658B:  BPL GETINT_10           ;GET PLAYERS INITIALS
L658D:  LDA NPLAYR              ;ATTRACT?
L658F:  BNE GETINT_11           ;NO
L6591:  JSR INISOU              ;($784F) RESET SOUNDS

GETINT_11:
L6594:  LDA #$FF                ;MUST RETURN NEGATIVE
L6596:  RTS

GETINT_10:
L6597:  LDA LPLAYR
L6599:  LSR A
L659A:  BEQ GETINT_25           ;IF LAST GAME WAS 1 PLAYER GAME
L659C:  LDY #$01
L659E:  JSR VGMSG               ;($718F) DISPLAY MESSAGE 1
L65A1:  LDY #$02
L65A3:  LDX $43
L65A5:  BPL GETINT_20           ;IF PLAYER 2
L65A7:  DEY                     ;LDY I,01

GETINT_20:
L65A8:  STY PLAYR
L65AA:  LDA FRAME
L65AC:  AND #$10
L65AE:  BNE GETINT_25           ;FLASH PLAYER NUMBER
L65B0:  TYA
L65B1:  JSR VGHEX               ;($79FD) DISPLAY PLAYER NUMBER

GETINT_25:
L65B4:  LSR PLAYR               ;0 OR 1
L65B6:  JSR SBANK               ;($6CB1) SET BANK FOR PLAYER CONTROLS
L65B9:  LDY #$02
L65BB:  JSR VGMSG               ;($718F) DISPLAY MESSAGE 2 - INSTRUCTIONS
L65BE:  LDY #$03
L65C0:  JSR VGMSG               ;($718F)
L65C3:  LDY #$04
L65C5:  JSR VGMSG               ;($718F)
L65C8:  LDY #$05
L65CA:  JSR VGMSG               ;($718F)
L65CD:  LDA #$20
L65CF:  STA VGSIZE              ;USE LARGER CHARACTER FOR INITIALS
L65D1:  LDA #$64
L65D3:  LDX #$39
L65D5:  JSR VGSABS              ;($7A31) POSITION BEAM
L65D8:  LDA #$70
L65DA:  JSR VGWAIT              ;($7AFC) WAIT FOR BEAM
L65DD:  LDX PLAYR
L65DF:  LDY UPDFLG,X
L65E1:  STY TEMP2
L65E3:  TYA
L65E4:  CLC
L65E5:  ADC UPDINT
L65E7:  STA $0D                 ;INDEX FOR THE INITIAL WE ARE WORKING ON
L65E9:  JSR INITAL              ;($66E1) DISPLAY INITIAL
L65EC:  LDY TEMP2
L65EE:  INY
L65EF:  JSR INITAL              ;($66E1) DISPLAY INITIAL
L65F2:  LDY TEMP2
L65F4:  INY
L65F5:  INY
L65F6:  JSR INITAL              ;($66E1) DISPLAY THIRD INITIAL

GETINT_50:
L65F9:  ASL HYPSW
L65FC:  ROL LASTSW              ;SWITCH DEBOUNCE
L65FE:  LDA LASTSW
L6600:  AND #$1F
L6602:  CMP #$07
L6604:  BNE GETINT_60           ;NOT A VALID SWITCH
L6606:  INC UPDINT              ;ADVANCE TO NEXT LETTER
L6608:  LDA UPDINT
L660A:  CMP #$03
L660C:  BCC GETINT_55           ;IF WE ARE NOT DONE
L660E:  LDX PLAYR
L6610:  LDA #$FF
L6612:  STA UPDFLG,X            ;CLEAR UPDATING FLAG

GETINT_54:
L6614:  LDX #$00
L6616:  STX PLAYR               ;SET PLAYER NUMBER
L6618:  STX UPDINT              ;START NEXT PLAYER
L661A:  LDX #$F0                ;PREVENT TIMEOUT IF BOTH PLAYERS SET HIGH SCORE
L661C:  STX $77                 ;BRING UP HIGH SCORE TABLE NEXT
L661E:  LDA UPDFLG              ;LAST?
L6620:  BPL GETINT_51           ;NO
L6622:  JSR STEAROM             ;($7BD9) START EAROM

GETINT_51:
L6625:  JMP SBANK               ;($6CB1) SET CONTROLS FOR PLAYER 1

GETINT_55:
L6628:  INC $0D
L662A:  LDX $0D
L662C:  LDA #$F4                ;ABOUT 64 SECONDS
L662E:  STA $77                 ;RESET TIMEOUT
L6630:  LDA #$0B
L6632:  STA INITL,X             ;SET INITIAL TO A

GETINT_60:
L6634:  LDA $77
L6636:  BNE GETINT_65           ;NO TIMEOUT
L6638:  LDA #$FF
L663A:  STA UPDFLG
L663C:  STA $43                 ;STOP INITIALS
L663E:  BMI GETINT_54           ;ALWAYS

GETINT_65:
L6640:  LDA FRAME
L6642:  AND #$07
L6644:  BNE GETINT_90           ;EVERY 8TH FRAME
L6646:  LDX $0D                 ;SET UP X
L6648:  LDY INITL,X             ;GET INITIAL
L664A:  BIT ROTL                ;LEFT?
L664D:  BPL GETINT_70           ;NOPE
L664F:  INY                     ;+1

GETINT_70:
L6650:  BIT ROTR                ;RIGHT?
L6653:  BPL GETINT_75           ;NOPE
L6655:  DEY                     ;-1
L6656:  BMI GETINT_78           ;BEFORE A BLANK COMES Z

GETINT_75:
L6658:  CPY #$0B
L665A:  BCS GETINT_80           ;IF GREATER THAN A
L665C:  CPY #$01
L665E:  BEQ GETINT_77           ;AFTER BLANK COMES A
L6660:  LDY #$00                ;BEFORE A COMES A BLANK
L6662:  BEQ GETINT_85

GETINT_77:
L6664:  LDY #$0B                ;A
L6666:  BNE GETINT_85           ;ALWAYS

GETINT_78:
L6668:  LDY #$24                ;MAKE IT A Z

GETINT_80:
L666A:  CPY #$25
L666C:  BCC GETINT_85           ;LESS THAN Z
L666E:  LDY #$00

GETINT_85:
L6670:  STY INITL,X

GETINT_90:
L6672:  LDA #$00                ;MUST BE POSITIVE ON RETURN
L6674:  RTS

;---------------------------------[ SHIELD-SHIELDS BUTTON HANDLER ]---------------------------------

SHIELD:
; [note] The shield button: drain the shield while it is up
L6675:  LSR SHDON               ;ASSUME SHIELDS OFF
L6677:  LDA NPLAYR
L6679:  BEQ DSTRD0_RTS_0        ;ATTRACT
L667B:  LDA SHPPIX
L667E:  BMI DSTRD0_RTS_0        ;EXPLODING
L6680:  BEQ DSTRD0_RTS_0        ;NOT VISIBLE
L6682:  LDA SHLDS
L6685:  BEQ DSTRD0_RTS_0        ;NO SHIELD POWER LEFT
L6687:  ASL HYPSW
L668A:  ROR SHDON               ;INDICATE SWITCH SETTING
L668C:  BPL DSTRD0_RTS_0        ;SHIELDS NOT ON
L668E:  LDY #$57                ;SHIELDS
L6690:  JSR SNDPON              ;($7758)
L6693:  LDA FRAME
L6695:  AND #$03
L6697:  BNE DSTRD0_RTS_0
L6699:  DEC SHLDS               ;TAKE SHIELD POWER EVERY 4 FRAMES

DSTRD0_RTS_0:
; [note] Shared return
L669C:  RTS

;------------------------------------------[ SHIELD PIX ]-------------------------------------------

SHLDPX:
; [note] Draw the shield around the ship
L669D:  BIT SHDON               ;SHIELDS UP?
L669F:  BPL DSTRD0_RTS_0        ;NO. JUST EXIT
L66A1:  LDA SHLDS
L66A4:  AND #$F0
L66A6:  CMP #$60
L66A8:  BCS SHLDPX_1
L66AA:  LDA #$60                ;SET A MINIMUM

SHLDPX_1:
L66AC:  PHA                     ;SAVE INTENSITY
L66AD:  LDX #$12
L66AF:  LDA #$50
L66B1:  STX R0                  ;SET (R0,R1) TO POINT TO SHIELD VECTOR LIST
L66B3:  STA R1
L66B5:  LDX #$00
L66B7:  STX TEMP1               ;NO INVERSIONS
L66B9:  STX $0A
L66BB:  STX R2
L66BD:  JSR CPYVEC              ;($6246) DRAW INVISIBLE LINE TO CORNER OF OCTAGON
L66C0:  LDX #$07                ;8 LINES IN OCTAGON
L66C2:  PLA                     ;AT 'A' INTENSITY
L66C3:  STA TEMP1               ;FOOL CPYVEC INTO PUTTING INTENSITY
L66C5:  JSR AYTOR0              ;($6EB2) ADD Y+1 TO R0,R1,MOVE VECTORS, UPDATE VGLIST
L66C8:  LDA #$00
L66CA:  STA TEMP1               ;RESET INTENSITY
L66CC:  JMP AYTOR0              ;($6EB2) ADD Y+1 TO R0,R1,MOVE VECTORS,UPDATE VGLIST,EXIT

SRESET:
; [note] Soft reset: clear both player pages
L66CF:  LDA #$06
L66D1:  STA DIFCTY
L66D4:  LDX #$00
L66D6:  TXA

SRESET_1:
L66D7:  STA OBJ,X               ;SOFT RESET
L66DA:  STA $0300,X
L66DD:  INX
L66DE:  BNE SRESET_1
L66E0:  RTS

;----------------------------[ INITAL-DISPLAY AN INITIAL ON THE SCREEN ]----------------------------

INITAL:
; INITIAL-DISPLAY INITIAL ON SCREEN
; ENTRY	(Y)=INDEX INTO INITL TABLE
L66E1:  LDA a:INITL,Y           ;INITIAL
L66E4:  ASL A                   ;INDEX INTO VGMSGA TABLE
L66E5:  TAY
L66E6:  BNE INITAL_1            ;IF NOT A BLANK
L66E8:  LDA UPDFLG
L66EA:  AND $43
L66EC:  BMI INITAL_1            ;NOT UPDATING INITIALS
L66EE:  LDX #$B0
L66F0:  LDA #$56
L66F2:  JMP VGJSRL              ;($7A2A) INSERT JSRL TO UNDERLINE

INITAL_1:
L66F5:  JMP VGCHAR              ;($7A0A) DISPLAY CHARACTER AND EXIT

;--------------------------------[ MOTION - MOTION UPDATE ROUTINE ]---------------------------------

MOTION:
; THIS ROUTINE ALSO UPDATES THE EXPLOSION INDEX TO SEQUENCE
; THRU THE PICTURES.
L66F8:  LDX PLAYR3              ;PLAYSR # *3
L66FA:  LDA $64,X
L66FC:  AND #$0F                ;ISOLATE LOW 4 BITS
L66FE:  STA BINSCR              ;SAVE 'EM
L6700:  EOR $64,X               ;ISOLATE HI 4 BITS
L6702:  LSR A                   ;HIGH NIBBLE * 8
L6703:  STA R0
L6705:  LSR A
L6706:  LSR A                   ;HI NIBBLE *2
L6707:  ADC R0                  ;+ HI NIBB*8 = HI NIBB * 10
L6709:  ADC BINSCR              ;+ LOW NIBBLE
L670B:  CMP #$0F                ;MAX IT OUT
L670D:  BCC MOTION_2            ;OK

MOTION_1:
L670F:  LDA #$0F

MOTION_2:
L6711:  STA BINSCR              ;KEEP BINARY SCORE LIMITED

MOV:
; [note] MOTION's loop: move every object by its velocity
L6713:  LDX #$20
L6715:  LDA #$00
L6717:  STA R9                  ;OBJECT COUNTER

MOV_10:
L6719:  LDA OBJ,X
L671C:  BNE MOV_12              ;ACTIVE OBJECT

MOV_13:
L671E:  DEX
L671F:  BPL MOV_10              ;MORE OBJECTS
L6721:  RTS

MOV_12:
L6722:  BPL MOV_14              ;IF OBJECT ACTIVE
L6724:  JSR COMP                ;($70EC) TIME REMAINING (0 TO 60)
L6727:  LSR A
L6728:  LSR A
L6729:  LSR A
L672A:  LSR A
L672B:  CPX #$19
L672D:  BNE MOV_16              ;NOT THE SHIP
L672F:  LDA FRAME
L6731:  AND #$01                ;ADD 1 EVERYOTHER FRAME
L6733:  LSR A
L6734:  BEQ MOV_42              ;ALWAYS

MOV_16:
L6736:  SEC                     ;1+ VALUE /16

MOV_42:
L6737:  ADC OBJ,X               ;NEW EXPLOSION PICTURE
L673A:  BMI MOV_11              ;STILL INACTIVE
L673C:  CPX #$19
L673E:  BEQ MOV_18              ;IF THE SHIP
L6740:  BCS MOV_40              ;IF THE SAUCER
L6742:  DEC NROCKS
L6745:  BNE MOV_17              ;IF MORE ROCKS REMAIN
L6747:  LDY #$7F                ;DELAY BEFORE STARTING
L6749:  STY RDELAY

MOV_17:
L674C:  LDA #$00
L674E:  STA OBJ,X               ;RESET PICTURE
L6751:  BEQ MOV_13

MOV_18:
L6753:  JSR NEWSHP              ;($6A37) RESET SHIP
L6756:  JMP MOV_17              ;($674C)

MOV_40:
L6759:  LDA SEDLAY
L675C:  STA EDELAY              ;DELAY BEFORE REENTERING
L675F:  BNE MOV_17              ;ALWAYS

MOV_11:
L6761:  STA OBJ,X
L6764:  AND #$F0                ;A0 TO 0F0
L6766:  CLC
L6767:  ADC #$10                ;B0 TO 0
L6769:  CPX #$19
L676B:  BNE MOV_41              ;NOT THE SHIP
L676D:  LDA #$F0                ;SCALING FOR SHIP EXPLOSION

MOV_41:
L676F:  TAY
L6770:  LDA OBJXL,X
L6773:  STA XCOMP
L6775:  LDA OBJXH,X
L6778:  STA $06
L677A:  LDA OBJYL,X
L677D:  STA $07
L677F:  LDA OBJYH,X
L6782:  STA $08
L6784:  JMP MOV_30              ;($681C)

MOV_14:
L6787:  STA TEMP4               ;SAVE OBJ CODE FOR ATTACK
L6789:  ASL TEMP4               ;SPECIAL?
L678B:  BPL MOV_1               ;NO
L678D:  CPX #$19                ;ROCK?
L678F:  BCS MOV_1               ;NO
L6791:  AND #$3C
L6793:  LSR A
L6794:  LSR A
L6795:  TAY
L6796:  STY $1C                 ;SAVE INDEX
L6798:  LDA SRTIME,Y            ;GET CONTROL BYTE OF SPECIAL ROCK
L679B:  STA $1D                 ;SAVE DATA
L679D:  BMI MOV_1               ;NOT ATTACKING
L679F:  JSR ATTACK              ;($48BE) ATTACK

MOV_1:
L67A2:  LDY #$00
L67A4:  CLC
L67A5:  LDA XINC,X
L67A8:  BPL MOV_15              ;SIGN EXTENSION
L67AA:  DEY

MOV_15:
L67AB:  ADC OBJXL,X
L67AE:  STA OBJXL,X
L67B1:  STA XCOMP
L67B3:  TYA
L67B4:  ADC OBJXH,X
L67B7:  CMP #$20
L67B9:  BCC MOV_19              ;IF 0 TO 1023
L67BB:  CPX #$1A
L67BD:  BNE MOV_35              ;NOT THE SAUCER
L67BF:  JSR RSAUCR              ;($6826) RESET SAUCER VALUES

MOV_28:
L67C2:  JMP MOV_13              ;($671E) ALWAYS

MOV_35:
L67C5:  BIT TEMP4               ;SPECIAL ROCK?
L67C7:  BPL MOV_33              ;NOPE
L67C9:  LDY $1D                 ;WAITING?
L67CB:  BMI MOV_33              ;YEP.
L67CD:  CPY #$04                ;TIMED OUT?
L67CF:  BCS MOV_33              ;NOPE. CONTINUE
L67D1:  DEC NROCKS              ;ZAP THE OBJECT
L67D4:  DEC SPROCK
L67D7:  LDY $1C
L67D9:  LDA #$00
L67DB:  STA OBJ,X
L67DE:  STA SRTIME,Y
L67E1:  BEQ MOV_28              ;(ALWAYS)

MOV_33:
L67E3:  AND #$1F

MOV_19:
L67E5:  STA OBJXH,X
L67E8:  AND #$7F
L67EA:  STA $06
L67EC:  CLC
L67ED:  LDY #$00

MOV_2:
L67EF:  LDA YINC,X
L67F2:  BPL MOV_20              ;SIGN EXTENSION
L67F4:  DEY

MOV_20:
L67F5:  ADC OBJYL,X
L67F8:  STA OBJYL,X
L67FB:  STA $07
L67FD:  TYA
L67FE:  ADC OBJYH,X             ;0 TO 767 PLEASE
L6801:  CMP #$18
L6803:  BCC MOV_25              ;ALREADY 0 TO 767
L6805:  BEQ MOV_24              ;IF 768 UP
L6807:  LDA #$17
L6809:  BNE MOV_25

MOV_24:
L680B:  LDA #$00

MOV_25:
L680D:  STA OBJYH,X
L6810:  STA $08
L6812:  LDA OBJ,X
L6815:  AND #$03
L6817:  TAY
L6818:  LDA SIZOPT,Y            ;GET SIZE OPTION

MOV_50:
L681B:  TAY

MOV_30:
L681C:  JSR PICTUR              ;($6BC4) DISPLAY PICTURE

MOV_32:
L681F:  JMP MOV_13              ;($671E)

SIZOPT:
L6822:  .byte $00, $E0, $F0, $E0 ;....

RSAUCR:
; [note] Reset the saucer: reload its delay, silence its sound
L6826:  LDA SEDLAY
L6829:  STA EDELAY              ;DELAY BEFORE RESTARTING
L682C:  TYA                     ;SAVE Y,X
L682D:  PHA
L682E:  LDY #$17                ;TURN OFF SOUND
L6830:  JSR SNDOFF              ;($7752)
L6833:  PLA
L6834:  TAY

SRSAUC:
; [note] Park the saucer off screen
L6835:  LDA #$00
L6837:  STA SAUPIX              ;CLEAR SAUCER
L683A:  STA SAUXI
L683D:  STA SAUYI
L6840:  STA SAUXH               ;BE SURE X POSITION IS 0
L6843:  STA SAUXL

RTS_3:
; [note] Shared return
L6846:  RTS

;----------------------------------------[ MOVE-MOVE SHIP ]-----------------------------------------

MOVE:
; [note] Rotate and thrust the ship, or bring it back to life
L6847:  LDA NPLAYR
L6849:  BEQ RTS_3               ;IN ATTRACT MODE
L684B:  LDA SHPPIX
L684E:  BMI RTS_3               ;IF EXPLODING
L6850:  BNE MOVE_5              ;SHIP VISIBLE

MOVE_1:
L6852:  DEC SDELAY              ;DECREMENT COUNT
L6855:  BNE RTS_3               ;NOT DONE YET
L6857:  JSR NEARBY              ;($6935) CHECK FOR AREA FREE OF ROCKS
L685A:  BNE RTS_3               ;IF SOMETHING CLOSE BY

MOVE_92:
L685C:  LDX #$01
L685E:  STX SHPPIX              ;USE 1/4 SIZE PICTURE
L6861:  STX SBTL                ;APPROX 0=> SHIP BACK TO LIFE FLAG
L6863:  LDY #$47                ;START BACK TO LIFE SOUND
L6865:  JMP SNDON               ;($775B)

MOVE_5:
L6868:  LDA ROTL
L686B:  BPL MOVE_10             ;NO ROTATE LEFT
L686D:  LDA #$03
L686F:  BNE MOVE_15             ;ALWAYS

MOVE_10:
L6871:  LDA ROTR
L6874:  BPL MOVE_20             ;NO ROTATE RIGHT
L6876:  LDA #$FD

MOVE_15:
L6878:  CLC
L6879:  ADC ANGLE
L687B:  STA ANGLE               ;NEW ROTATION ANGLE

MOVE_20:
L687D:  LDA FRAME
L687F:  LSR A
L6880:  BCS RTS_3               ;EVERY OTHER FRAME CHECK THRUST

MOVE1:
; [note] Thrust or drag, every other frame
L6882:  LDA THRUST
L6885:  BPL MOVE1_80            ;NO THRUST
L6887:  LDA #$40
L6889:  STA R2                  ;SIGNAL TO USE COS
L688B:  LDA SHPXI               ;GET VEL X
L688E:  JSR CACCEL              ;($68ED) COMPUTE ACCELERATION
L6891:  ADC XINCL               ;COMPUTE NEW VEL
L6893:  TAX
L6894:  LDA R1
L6896:  ADC SHPXI
L6899:  JSR MOVE2               ;($6921) RANGE IT
L689C:  STA SHPXI
L689F:  STX XINCL
L68A1:  LDA #$00
L68A3:  STA R2
L68A5:  LDA SHPYI               ;GET VEL Y
L68A8:  JSR CACCEL              ;($68ED) COMPUTE ACCEL
L68AB:  ADC YINCL               ;COMPUTE NEW VEL
L68AD:  TAX
L68AE:  LDA R1
L68B0:  ADC SHPYI
L68B3:  JSR MOVE2               ;($6921) RANGE IT
L68B6:  STA SHPYI
L68B9:  STX YINCL
L68BB:  RTS

MOVE1_80:
L68BC:  LDA #$00
L68BE:  TAX                     ;LDX #0
L68BF:  SEC
L68C0:  SBC SHPXI               ;A 0-SHPXI
L68C3:  ASL A                   ;*4
L68C4:  ASL A
L68C5:  BCC MOVE1_86            ;+
L68C7:  DEX                     ;SIGN EXTEND
L68C8:  CLC

MOVE1_86:
L68C9:  ADC XINCL
L68CB:  STA XINCL
L68CD:  TXA
L68CE:  ADC SHPXI
L68D1:  STA SHPXI
L68D4:  LDA #$00
L68D6:  TAX                     ;LDX #0
L68D7:  SEC
L68D8:  SBC SHPYI               ;A=0-SHPYI
L68DB:  ASL A                   ;*4
L68DC:  ASL A
L68DD:  BCC MOVE1_88            ;+
L68DF:  DEX                     ;SIGN EXTENDED
L68E0:  CLC

MOVE1_88:
L68E1:  ADC YINCL
L68E3:  STA YINCL
L68E5:  TXA
L68E6:  ADC SHPYI
L68E9:  STA SHPYI

MOVE1_89:
L68EC:  RTS

CACCEL:
; [note] Thrust acceleration for one axis
L68ED:  BPL CACCEL_1
L68EF:  JSR COMP                ;($70EC) GET ABS(VEL) (0-3F)

CACCEL_1:
L68F2:  LSR A                   ;RANGE IT 0-7
L68F3:  LSR A
L68F4:  LSR A
L68F5:  TAX
L68F6:  LDA ACCEL,X             ;GET ACCEL MULTIPLIER
L68F9:  BIT SHDON               ;SHIELDS?
L68FB:  BPL CACCEL_2            ;NO
L68FD:  LSR A                   ;YES. USE 1/2

CACCEL_2:
L68FE:  STA R1                  ;MULTIPLIER
L6900:  LDA ANGLE               ;ANGLE
L6902:  CLC
L6903:  ADC R2
L6905:  JSR SIN                 ;($7137) SIN(ANGLE)

CACCEL_4:
L6908:  JSR MULT                ;($49B3) *R1
L690B:  LDY #$00
L690D:  ASL A                   ;*2
L690E:  BCC CACCEL_5
L6910:  DEY                     ;SIGN EXTENDED

CACCEL_5:
L6911:  ASL A
L6912:  STY R1
L6914:  ROL R1
L6916:  CLC
L6917:  RTS

ACCEL:
L6918:  .byte $80, $70, $60, $50, $40, $30, $20, $10 ;.p`P@0 .

CKSUM3:
L6920:  .byte $A6               ;.

MOVE2:
; [note] Clamp a 16-bit velocity to the maximum
L6921:  BMI MOVE2_30            ;IF OUT OF RANGE
L6923:  CMP #$40
L6925:  BCC MOVE2_35            ;IF IN RANGE
L6927:  LDX #$FF                ;MAX
L6929:  LDA #$3F
L692B:  RTS

MOVE2_30:
L692C:  CMP #$C1
L692E:  BCS MOVE2_35            ;IF IN RANGE
L6930:  LDX #$01                ;-3FFF=C001
L6932:  LDA #$C1                ;SET MAX NEGATIVE

MOVE2_35:
L6934:  RTS

;--------------------------------[ NEARBY - CHECK FOR ROCKS NEARBY ]--------------------------------

NEARBY:
; EXIT	(CC)=0 IF AREA FREE OF ROCKS
; (SDELAY)>0 IF ROCK NEAR SHIP
L6935:  LDA FRAME
L6937:  AND #$03                ;COUNT EVERY 4 FRAMES
L6939:  BNE NEARBY_11           ;NOT TIME
L693B:  INC SBTLT               ;COUNT
L693D:  BNE NEARBY_11           ;NOT 16 SECONDS
L693F:  LDA #$02                ;FIND A SMALL OBJ
L6941:  STA R0

NEARBY_14:
L6943:  LDX #$18

NEARBY_13:
L6945:  LDA OBJ,X
L6948:  ASL A                   ;MAKE SURE ITS NOT A SPECIAL
L6949:  BMI NEARBY_12           ;IT IS. SKIP IT
L694B:  AND R0
L694D:  BEQ NEARBY_12
L694F:  DEC NROCKS              ;TAKE 1 FROM TOTAL
L6952:  LDA #$00
L6954:  STA OBJ,X               ;ZAP ROCK
L6957:  BEQ NEARBY_11           ;(ALWAYS)

NEARBY_12:
L6959:  DEX                     ;COUNT DOWN
L695A:  BPL NEARBY_13           ;CONTINUE
L695C:  ASL R0                  ;LOOK FOR NEXT SIZE OBJ
L695E:  BPL NEARBY_14

NEARBY_11:
L6960:  LDX #$18

NEARBY_10:
L6962:  LDA OBJ,X
L6965:  BEQ NEARBY_40           ;OBJECT NOT ALIVE
L6967:  LDA OBJXH,X
L696A:  SEC
L696B:  SBC SHPXH
L696E:  CMP #$05
L6970:  BCC NEARBY_20           ;IF CLOSE ENOUGH
L6972:  CMP #$FB
L6974:  BCC NEARBY_40           ;TOO FAR AWAY

NEARBY_20:
L6976:  LDA OBJYH,X
L6979:  SEC
L697A:  SBC SHPYH
L697D:  CMP #$05
L697F:  BCC NEARBY_50           ;TOO CLOSE
L6981:  CMP #$FB
L6983:  BCS NEARBY_50           ;TOO CLOSE

NEARBY_40:
L6985:  DEX
L6986:  BPL NEARBY_10           ;LOOP THRU ALL OBJECTS
L6988:  INX                     ;ZERO FLAG ON EXIT
L6989:  RTS

NEARBY_50:
L698A:  INC SDELAY              ;DELAY BEFORE ENTERING SHIP

RTS_1:
; [note] Shared return
L698D:  RTS                     ;SETS NON-ZERO FLAG

;--------------------------------[ NEWAST - START UP NEW ASTEROIDS ]--------------------------------

NEWAST:
; [note] Start up new asteroids for a wave
L698E:  LDX #$18
L6990:  LDA RDELAY
L6993:  BEQ NEWAST_66
L6995:  JMP NEWAST_65           ;($69F6)

NEWAST_66:
L6998:  LDA NPLAYR              ;ATTRACT MODE?
L699A:  BEQ NEWAST_11           ;YES.
L699C:  LDA SHPPIX
L699F:  BEQ RTS_1               ;NOT WHILE SHIP IS INVISIBLE
L69A1:  BMI RTS_1               ;OR BLOWING UP

NEWAST_11:
L69A3:  LDA SAUPIX              ;SAUCER?
L69A6:  BNE RTS_1               ;YES. NO NEW ROCK
L69A8:  STA SPROCK              ;MAKE SURE THERE ARE NO SPECIALS
L69AB:  LDX PLAYR               ;POINT TO PLAYER
L69AD:  STA TRILE,X             ;ENABLE DIAMOND LAUNCH
L69AF:  LDX #$06

NEWAST_20:
L69B1:  STA SRTIME,X
L69B4:  DEX
L69B5:  BPL NEWAST_20
L69B7:  LDX SROCKS
L69BA:  CPX #$3F
L69BC:  BCC NEWAST_14
L69BE:  LDA NPLAYR
L69C0:  BNE NEWAST_15
L69C2:  JSR SRESET              ;($66CF)

NEWAST_14:
L69C5:  INC SROCKS

NEWAST_15:
L69C8:  CPX #$03
L69CA:  BCC NEWAST_21
L69CC:  LDX #$03

NEWAST_21:
L69CE:  LDY RWAVE,X

NEWAST_5:
L69D1:  STY NROCKS              ;ACTIVATE ROCKS
L69D4:  STY TEMP1               ;KEEP A COPY
L69D6:  LDX #$18
L69D8:  LDA DIFCTY
L69DB:  CMP #$0A                ;MINIMUM # OF ROCKS BEFORE MR. BILL
L69DD:  BCS NEWAST_2
L69DF:  INC DIFCTY

NEWAST_2:
L69E2:  LDY #$1A                ;POINT TO SAUCER VELOCITY

NEWAST_10:
L69E4:  JSR RNDPOS              ;($6A03) GET A RANDOM POSITION
L69E7:  DEX
L69E8:  DEC TEMP1
L69EA:  BNE NEWAST_10           ;LOOP FOR EACH NEW ROCK
L69EC:  LDA #$7F
L69EE:  STA EDELAY              ;SAUCER SHOULD WAIT
L69F1:  LDA #$30
L69F3:  STA THUMP3              ;RESET THUMP SOUND

NEWAST_65:
L69F6:  LDA #$00

NEWAST_70:
L69F8:  STA OBJ,X               ;CLEAR REST OF OBJECTS
L69FB:  DEX
L69FC:  BPL NEWAST_70           ;ASSUMES SROCKS < NOBJ
L69FE:  RTS

RWAVE:
L69FF:  .byte $06, $07, $08, $09 ;....

RNDPOS:
; [note] Place a random large rock at a screen edge
L6A03:  LDA RANDOM              ;RANDOM NUMBER
L6A06:  AND #$38                ;PICTURE NUMBER
L6A08:  ORA #$04                ;SIZE OF OBJECT
L6A0A:  STA OBJ,X               ;SET PICTURE
L6A0D:  JSR NEWVEL              ;($6A57) GET NEW VELOCITY
L6A10:  LDA RANDOM              ;RANDOM NUMBER
L6A13:  LSR A
L6A14:  AND #$1F
L6A16:  BCC RNDPOS_50           ;START ON X ARIS
L6A18:  CMP #$18                ;START ON Y AXIS
L6A1A:  BCC RNDPOS_35           ;IF 0 TO 767
L6A1C:  AND #$17                ;384 TO 512

RNDPOS_35:
L6A1E:  STA OBJYH,X
L6A21:  LDA #$00
L6A23:  STA OBJXH,X
L6A26:  STA OBJXL,X
L6A29:  BEQ RNDPOS_60           ;ALWAYS

RNDPOS_50:
L6A2B:  STA OBJXH,X
L6A2E:  LDA #$00
L6A30:  STA OBJYH,X
L6A33:  STA OBJYL,X

RNDPOS_60:
L6A36:  RTS

NEWSHP:
; [note] Put the ship at the centre, still, with full shields
L6A37:  LDA #$60
L6A39:  STA SHPXL               ;POSITION IN MIDDLE - JUST OFF CENTER
L6A3C:  STA SHPYL
L6A3F:  LDA #$00
L6A41:  STA SHPXI               ;WITH NO VELOCITY
L6A44:  STA SHPYI
L6A47:  LDA #$10
L6A49:  STA SHPXH
L6A4C:  LDA #$0C
L6A4E:  STA SHPYH
L6A51:  LDA #$FF
L6A53:  STA SHLDS               ;GIVE 'EM FULL SHIELDS
L6A56:  RTS

;----------------------------[ NEWVEL - NEW RANDOM VELOCITY USING OLD ]-----------------------------

NEWVEL:
; [note] New random velocity from the old one
L6A57:  LDA RANDOM              ;RANDOM NUMBER
L6A5A:  AND #$8F
L6A5C:  BPL NEWVEL_10           ;IF POSITIVE NUMBER 0 TO 15
L6A5E:  ORA #$F0                ;-1 TO -16

NEWVEL_10:
L6A60:  CLC
L6A61:  ADC XINC,Y
L6A64:  JSR NEWVE1              ;($6A7E) CHECK RANGE OF VELOCITIES
L6A67:  STA XINC,X
L6A6A:  LDA RANDOM              ;RANDOM NUMBER
L6A6D:  AND #$8F
L6A6F:  BPL NEWVEL_40           ;POSITIVE NUMBER 0 TO 15
L6A71:  ORA #$F0                ;NEGATIVE -1 TO -16

NEWVEL_40:
L6A73:  CLC
L6A74:  ADC YINC,Y
L6A77:  JSR NEWVE1              ;($6A7E) CHECK RANGE OF VELOCITY
L6A7A:  STA YINC,X
L6A7D:  RTS

NEWVE1:
; [note] Range-limit a velocity
L6A7E:  BPL NEWVE1_20           ;POSITIVE RESULT
L6A80:  CMP #$E1
L6A82:  BCS NEWVE1_15           ;WITHIN RANGE
L6A84:  LDA #$E1

NEWVE1_15:
L6A86:  CMP RVELM
L6A88:  BCC RTS_2               ;NOT TOO CLOSE TO ZERO
L6A8A:  LDA RVELM               ;AT LEAST 1/2
L6A8C:  RTS

NEWVE1_20:
L6A8D:  CMP RVELP
L6A8F:  BCS NEWVE1_25           ;NOT TOO CLOSE TO ZERO
L6A91:  LDA RVELP

NEWVE1_25:
L6A93:  CMP #$20
L6A95:  BCC RTS_2               ;WITHIN RANGE
L6A97:  LDA #$1F

RTS_2:
; [note] Shared return
L6A99:  RTS

;-----------------------------------[ PARAMS-DISPLAY PARAMETERS ]-----------------------------------

PARAMS:
; [note] Display the score, lives and messages for this frame
L6A9A:  LDA NPLAYR              ;ATTRACT?
L6A9C:  BEQ PARAMS_12           ;YES,STANDARD SIZE CHAR AND NO COPYRIGHT
L6A9E:  LDA #$81
L6AA0:  LDX #$C3
L6AA2:  JSR VGADD2              ;($7CCC)
L6AA5:  LDY #$00                ;INIT FOR SMALL
L6AA7:  LDA PLAYR               ;PLAYER UP?
L6AA9:  BNE PARAMS_11           ;NO,GIVE 'EM SMALL

PARAMS_12:
L6AAB:  LDY #$10

PARAMS_11:
L6AAD:  STY VGSIZE
L6AAF:  LDA #$19
L6AB1:  LDX #$DB
L6AB3:  JSR VGSABS              ;($7A31) POSITION BEAM
L6AB6:  LDA #$70
L6AB8:  JSR VGWAIT              ;($7AFC) WAIT FOR BEAM
L6ABB:  LDA NPLAYR
L6ABD:  CMP #$02
L6ABF:  BCC PARAMS_10           ;IF ATTRACT OR NOT 2 PLAYER
L6AC1:  LDA PLAYR
L6AC3:  BNE PARAMS_10           ;IF PLAYER 2 UP
L6AC5:  LDA SHPPIX
L6AC8:  BNE PARAMS_10           ;IF HE HAS APPEARED
L6ACA:  LDA SDELAY
L6ACD:  BMI PARAMS_10           ;HE HAS DIED
L6ACF:  LDA FRAME
L6AD1:  AND #$10
L6AD3:  BEQ PARAMS_20           ;FLASH SCORE

PARAMS_10:
L6AD5:  LDA #$62
L6AD7:  LDY #$03
L6AD9:  SEC
L6ADA:  JSR DIGITS              ;($7C98) DISPLAY PLAYER 1 SCORE

PARAMS_20:
L6ADD:  LDY HITS
L6ADF:  LDA #$00                ;PLAYER 1
L6AE1:  JSR GTSP                ;($6B90) GET SHIP PIX
L6AE4:  LDA #$28
L6AE6:  JSR LIVES               ;($7C72) DISPLAY NUMBER OF LIFES
L6AE9:  LDA PLAYR               ;PLAYER UP?
L6AEB:  BNE PARAMS_22           ;NOPE
L6AED:  LDA SHPPIX              ;ALIVE?
L6AF0:  BMI PARAMS_22           ;NO
L6AF2:  BEQ PARAMS_22           ;NO
L6AF4:  JSR TWO                 ;($6BA5) GO TWINKLE OFF SCREEN

PARAMS_22:
L6AF7:  LDA #$00                ;SMALL
L6AF9:  STA VGSIZE
L6AFB:  ORA $24
L6AFD:  ORA $25                 ;HIGH SCORE?
L6AFF:  BEQ PARAMS_21           ;NO. NEVER MIND WRITING IT
L6B01:  LDA #$74
L6B03:  LDX #$DB
L6B05:  JSR VGSABS              ;($7A31) POSITION BEAM
L6B08:  LDA #$50
L6B0A:  JSR VGWAIT              ;($7AFC) WAIT FOR BEAM
L6B0D:  LDA #$23
L6B0F:  LDY #$03
L6B11:  SEC
L6B12:  JSR DIGITS              ;($7C98) DISPLAY HIGH SCORE
L6B15:  LDY #$00
L6B17:  STY R3
L6B19:  JSR VGCHAR              ;($7A0A) BLANK
L6B1C:  JSR IN3TIM              ;($6D5E) 3 INITIALS

PARAMS_21:
L6B1F:  LDA NPLAYR              ;ATTRACT?
L6B21:  BEQ PARAMS_23           ;YES, NO BONUS
L6B23:  LDA $FF                 ;BONUS?
L6B25:  BMI PARAMS_23           ;NO BONUS MSG
L6B27:  LDY #$0D                ;BONUS MESSAGE
L6B29:  LDA #$00                ;ENGLISH ONLY
L6B2B:  JSR VGME                ;($7198)
L6B2E:  LDA #$68
L6B30:  CLC
L6B31:  ADC PLAYR3              ;COMPUTE @
L6B33:  LDY #$03
L6B35:  SEC
L6B36:  JSR DIGITS              ;($7C98)

PARAMS_23:
L6B39:  LDX #$10                ;MEDIUM SIZE
L6B3B:  LDA NPLAYR
L6B3D:  CMP #$01
L6B3F:  BEQ RTS_5               ;NO PLAYER 2
L6B41:  BCC PARAMS_24           ;ATTRACT. ALWAYS BIG
L6B43:  LDA PLAYR               ;PLAYER 2 UP?
L6B45:  BNE PARAMS_24           ;YES. GIVE 'EM BIG
L6B47:  TAX                     ;SMALL

PARAMS_24:
L6B48:  STX VGSIZE
L6B4A:  LDA #$C0
L6B4C:  LDX #$DB
L6B4E:  JSR VGSABS              ;($7A31) POSITION BEAM
L6B51:  LDA #$50
L6B53:  JSR VGWAIT              ;($7AFC) WAIT FOR BEAM
L6B56:  LDA NPLAYR              ;ATTRACT?
L6B58:  BEQ PARAMS_30           ;YEP. ALWAYS DISPLAY
L6B5A:  LDA PLAYR
L6B5C:  BEQ PARAMS_30           ;PLAYER NOT UP
L6B5E:  LDA SHPPIX
L6B61:  BNE PARAMS_30           ;IF HE HAS APPEARED
L6B63:  LDA SDELAY
L6B66:  BMI PARAMS_30           ;HE HAS DIED
L6B68:  LDA FRAME
L6B6A:  AND #$10
L6B6C:  BEQ PARAMS_40           ;FLASH SCORE

PARAMS_30:
L6B6E:  LDA #$65
L6B70:  LDY #$03
L6B72:  SEC                     ;ZERO SUPPRESS
L6B73:  JSR DIGITS              ;($7C98) DISPLAY SCORE FOR PLAYER 2

PARAMS_40:
L6B76:  LDY $70
L6B78:  LDA #$01                ;PLAYER 2
L6B7A:  JSR GTSP                ;($6B90) GET SHIP PIX
L6B7D:  LDA #$CF
L6B7F:  JSR LIVES               ;($7C72) DISPLAY NUMBER OF LIVES
L6B82:  LDA PLAYR               ;PLAYER 2 UP?
L6B84:  BEQ RTS_5               ;NOPE
L6B86:  LDA SHPPIX              ;ALIVE?
L6B89:  BEQ RTS_5               ;NOPE
L6B8B:  BMI RTS_5               ;NOPE
L6B8D:  JMP TWO                 ;($6BA5) DO TWINKLE

GTSP:
; AT EXIT:
; (Y)=# OF HITS-1 IF SHIP VISIBLE
; ELSE # OF HITS
L6B90:  EOR PLAYR               ;GET PLAYER
L6B92:  BEQ GTSP_1              ;WANT 1, IS 1
L6B94:  LDX $0319               ;WANT 2, IS 1
L6B97:  BMI GTSP_3              ;BLOWING UP
L6B99:  BNE GTSP_2              ;VISIBLE

GTSP_3:
; OR WANT 1, IS 2
L6B9B:  INY                     ;NOT VISIBLE

GTSP_2:
L6B9C:  RTS

GTSP_1:
L6B9D:  LDX SHPPIX              ;WANT 1, IS 1
L6BA0:  BEQ GTSP_3              ;NOT VISIBLE
L6BA2:  BMI GTSP_3              ;BLOWING UP

RTS_5:
; WANT 2, IS 2
L6BA4:  RTS                     ;VISIBLE

TWO:
; [note] Ramp the returning ship's intensity up (the back-to-life twinkle)
L6BA5:  LDA SBTL                ;GET SHIP INTENSITY
L6BA7:  CMP #$C0                ;AT MAX?
L6BA9:  BCC TWO_1               ;NOPE. TWINKLE
L6BAB:  RTS                     ;YEP. JUST EXIT

TWO_1:
L6BAC:  PHA                     ;SAVE SBTL VALUE
L6BAD:  EOR #$FF                ;NEGATE IT
L6BAF:  ADC #$C1                ;COMPUTE 0C0-SBTL
L6BB1:  STA SBTL                ;PASS IT TO SHPPIC ROUTINE
L6BB3:  LDA ANGLE               ;SAVE CURRENT ANGLE
L6BB5:  PHA
L6BB6:  LDA #$40                ;90 DEGREES
L6BB8:  STA ANGLE
L6BBA:  JSR SHPPIC              ;($6E3C) DRAW A TWINKLE SHIP
L6BBD:  PLA                     ;RESTORE STUFF
L6BBE:  STA ANGLE
L6BC0:  PLA
L6BC1:  STA SBTL
L6BC3:  RTS                     ;DONE

;---------------------------------[ PICTUR-DISPLAY OBJECT PICTURE ]---------------------------------

PICTUR:
; ENTRY (Y)=SCALING FACTOR TO BE USED
; (XCOMP,XCOMP+3)=OBJECT POSITION
L6BC4:  STY VGSIZE              ;SET SCALING FACTOR
L6BC6:  STX TEMP3               ;SAVE X
L6BC8:  LSR $06                 ;PUT VALUES INTO INTEGER FORMAT
L6BCA:  ROR XCOMP
L6BCC:  LSR $06
L6BCE:  ROR XCOMP
L6BD0:  LSR $06
L6BD2:  ROR XCOMP
L6BD4:  LSR $08
L6BD6:  ROR $07
L6BD8:  LSR $08
L6BDA:  ROR $07
L6BDC:  INC $08                 ;ADD 128 (RANGE IS 127<Y<897)
L6BDE:  LSR $08
L6BE0:  ROR $07
L6BE2:  JSR POSBEM              ;($6C43) POSITION BEAM
L6BE5:  LDX TEMP3
L6BE7:  JSR PICTUR_31           ;($6BED)
L6BEA:  LDX TEMP3               ;THE FOLLOWING CODE ALWAYS RETURNS HERE
L6BEC:  RTS

PICTUR_31:
L6BED:  LDA OBJ,X
L6BF0:  BPL PICTUR_35           ;IF NOT EXPLODING
L6BF2:  CPX #$19
L6BF4:  BEQ PICTUR_33           ;IF THE SHIP
L6BF6:  AND #$0C
L6BF8:  LSR A                   ;0, 2, 4 OR 6
L6BF9:  TAY
L6BFA:  LDA EXPPIC,Y
L6BFD:  LDX EXPPIC+1,Y
L6C00:  BNE PICTUR_78           ;ALWAYS

PICTUR_33:
L6C02:  JMP SHPEXP              ;($6D77) EXPLODE SHIP

PICTUR_35:
L6C05:  CPX #$19
L6C07:  BEQ PICTUR_50           ;IF THE SHIP
L6C09:  CPX #$1A
L6C0B:  BEQ PICTUR_60           ;IF SAUCER
L6C0D:  BCS PICTUR_70           ;IF A TORPEDO (DOT)
L6C0F:  ASL A
L6C10:  BPL PICTUR_37
L6C12:  JMP TRIPIX              ;($4A6D)

PICTUR_37:
L6C15:  LSR A
L6C16:  LSR A
L6C17:  LSR A
L6C18:  AND #$06
L6C1A:  TAY
L6C1B:  LDA ROCKSA,Y
L6C1E:  LDX ROCKSA+1,Y

PICTUR_78:
L6C21:  JMP VGADD2              ;($7CCC) ADD JSRL OF PICTURE TO VECTOR LIST

PICTUR_50:
L6C24:  JSR SHLDPX              ;($669D) DISPLAY THE SHIELD IF ENABLED
L6C27:  JMP SHPPIC              ;($6E3C) DISPLAY SHIP PICTURE

PICTUR_60:
L6C2A:  LDA #$34
L6C2C:  LDX #$C7
L6C2E:  BNE PICTUR_78           ;ALWAYS

PICTUR_70:
L6C30:  LDA #$70
L6C32:  LDX #$F0
L6C34:  JSR VGDOT               ;($7AFE) PUT A DOT THERE
L6C37:  LDX TEMP3
L6C39:  LDA FRAME
L6C3B:  AND #$03
L6C3D:  BNE PICTUR_75           ;EVERY FOURTH FRAME
L6C3F:  DEC OBJ,X               ;DECREMENT ACTIVE COUNT

PICTUR_75:
L6C42:  RTS

POSBEM:
; [note] Position the beam, then wait for it
L6C43:  LDX #$05
L6C45:  JSR VGLABS              ;($7A4A) POSITION BEAM
L6C48:  LDA #$70                ;WE WANT A WAIT OF 7
L6C4A:  SEC
L6C4B:  SBC VGSIZE              ;BACK DOWN BY AMOUNT OF SCALE

POSBEM_28:
L6C4D:  CMP #$A0                ;TOO BIG?
L6C4F:  BCC POSBEM_30           ;NOPE. (0-90)
L6C51:  PHA                     ;SAVE IT
L6C52:  LDA #$90
L6C54:  JSR VGWAIT              ;($7AFC) INSERT A WAIT
L6C57:  PLA
L6C58:  SEC
L6C59:  SBC #$10                ;BACK DOWN AGAIN
L6C5B:  BNE POSBEM_28           ;(ALWAYS)

POSBEM_30:
L6C5D:  JMP VGWAIT              ;($7AFC) INSERT A WAIT AND EXIT

;----------------------------------[ POINTS-ADD POINTS TO SCORE ]-----------------------------------

POINTS:
; ENTRY:
; A+CARRY=# TO ADD TO POINTS (/100)
; AT EXIT:
; SCORE(PLAYR)=SCORE(PLAYR)+A*1000+CARRY*10000
L6C60:  ROR A
L6C61:  ROR R0
L6C63:  LSR A
L6C64:  ROR R0
L6C66:  LSR A
L6C67:  ROR R0
L6C69:  LSR A
L6C6A:  ROR R0
L6C6C:  STA R1
L6C6E:  SED
L6C6F:  STX R2                  ;SAVE X
L6C71:  LDX PLAYR3
L6C73:  LDA R0
L6C75:  AND #$F0                ;LOW DIGIT ALWAY=0
L6C77:  CLC
L6C78:  ADC SCORE,X
L6C7A:  STA SCORE,X
L6C7C:  LDA R1
L6C7E:  ADC $63,X
L6C80:  STA $63,X
L6C82:  LDA #$00
L6C84:  ADC $64,X
L6C86:  STA $64,X
L6C88:  CMP $6A,X               ;HIT THE NEXT PLATEAU?
L6C8A:  BCC POINTS_19           ;NOPE. NEVER MIND
L6C8C:  BNE POINTS_10           ;YEP.
L6C8E:  LDA $63,X               ;CHECK NEXT BYTE DOWN
L6C90:  CMP $69,X
L6C92:  BCC POINTS_19           ;OK

POINTS_10:
L6C94:  CLC                     ;HIT LIMIT
L6C95:  LDA $FE                 ;SO UP IT A NOTCH
L6C97:  ADC $69,X
L6C99:  STA $69,X
L6C9B:  LDA $FF
L6C9D:  ADC $6A,X
L6C9F:  STA $6A,X
L6CA1:  LDX PLAYR
L6CA3:  LDA HITS,X
L6CA5:  CMP #$0A                ;NO MORE THAN 10 LIVES
L6CA7:  BCS POINTS_19
L6CA9:  INC HITS,X              ;GIVE 'EM ANOTHER LIFE
L6CAB:  INC SND3                ;SIGNAL THAT WE MUST MAKE NOISE

POINTS_19:
L6CAD:  CLD
L6CAE:  LDX R2                  ;RESTORE X
L6CB0:  RTS

;------------------------------------[ SBANK - SET BANK SELECT ]------------------------------------

SBANK:
; [note] Select the current player's RAM page
L6CB1:  LDA PLAYR               ;0 OR 1
L6CB3:  LSR A
L6CB4:  ROR A                   ;0 OR 80
L6CB5:  STA BNKSEL
L6CB8:  RTS

;--------------------------------[ SCORES-DISPLAY HIGH SCORE TABLE ]--------------------------------

SCORES:
; (CC)=CARRY SET IF DISPLAYING TABLE
L6CB9:  LDX NPLAYR
L6CBB:  BNE SCORES_40           ;NOT ATTRACT MODE
L6CBD:  LDA $77
L6CBF:  AND #$04
L6CC1:  BEQ SCORES_30           ;DISPLAY SCORES

SCORES_90:
L6CC3:  STX VGSIZE
L6CC5:  LDA #$70
L6CC7:  LDX #$68
L6CC9:  JSR VGSABS              ;($7A31) POSITION BEAM
L6CCC:  LDA #$70
L6CCE:  JSR VGWAIT              ;($7AFC) WAIT
L6CD1:  JSR CPYRS               ;($717E) PUT UP COPY RIGHT
L6CD4:  LDY #$07
L6CD6:  JSR VGMSG               ;($718F) GAME OVER

SCORES_40:
L6CD9:  CLC
L6CDA:  RTS

SCORES_30:
L6CDB:  LDA HSCORE
L6CDD:  ORA $24
L6CDF:  ORA $25
L6CE1:  BEQ SCORES_90           ;IF NO HIGH SCORES
L6CE3:  LDY #$00
L6CE5:  JSR VGMSG               ;($718F) DISPLAY "HIGH SCORE" MESSAGE
L6CE8:  LDX #$00
L6CEA:  STX R0                  ;ITEM COUNTR (COUNTS BY 1 IN BCD)
L6CEC:  STX R3                  ;ITEM COUNTER (COUNTS BY 3 IN BINARY)
L6CEE:  LDA #$A7
L6CF0:  STA R2                  ;Y VALUE FOR FIRST LINE OF DISPLAY
L6CF2:  LDX #$23

SCORES_20:
L6CF4:  LDA #$10
L6CF6:  STA VGSIZE              ;CHARACTER SIZE
L6CF8:  STX R1                  ;SCORE INDEX
L6CFA:  LDA $00,X               ;ANY SCORE?
L6CFC:  ORA VGSIZE,X
L6CFE:  ORA VGBRIT,X
L6D00:  BEQ SCORES_80           ;A 0 ENDS THE SEARCH
L6D02:  LDA #$5F                ;VALUE OF X FOR LINE
L6D04:  LDX R2                  ;GET Y
L6D06:  JSR VGSABS              ;($7A31) POSITION BEAM
L6D09:  LDA #$40
L6D0B:  JSR VGWAIT              ;($7AFC) WAIT FOR IT
L6D0E:  LDA R0                  ;UPDATE BCD ITEM COUNTER
L6D10:  SED
L6D11:  CLC
L6D12:  ADC #$01
L6D14:  CLD
L6D15:  STA R0
L6D17:  LDA #$10                ;GET ADDRESS OF ITEM COUNTER
L6D19:  SEC                     ;SUPPRESS LEADING ZERO'S
L6D1A:  LDY #$01                ;ONLY 2 DIGITS (1 BYTE)
L6D1C:  JSR DIGITS              ;($7C98)
L6D1F:  LDA #$40
L6D21:  TAX
L6D22:  JSR VGDOT               ;($7AFE) PRINT A PERIOD AFTER NUMBER
L6D25:  LDY #$00
L6D27:  JSR VGCHAR              ;($7A0A) PRINT A SPACE AFTER THAT
L6D2A:  LDA R1                  ;'A' = ADDRESS OF 3 BYTE SCORE
L6D2C:  LDY #$03                ;6 DIGITS (3 BYTES)
L6D2E:  SEC                     ;SUPPRESS LEADING ZEROES
L6D2F:  JSR DIGITS              ;($7C98)
L6D32:  LDY #$00
L6D34:  JSR VGCHAR              ;($7A0A) FOLLOW WITH A BLANK
L6D37:  JSR IN3TIM              ;($6D5E) DISPLAY 3 INITIALS
L6D3A:  LDA R0
L6D3C:  CMP #$04                ;ONE OF FIRST 3?
L6D3E:  BCS SCORES_21           ;NO
L6D40:  LDA R2                  ;PUT IN JSRL TO SHIP
L6D42:  ADC #$02
L6D44:  TAX                     ;Y POSITION
L6D45:  LDA #$B2                ;X POSITION
L6D47:  LDY #$02                ;# OF LIVES
L6D49:  JSR LIVESS              ;($7C74)

SCORES_21:
L6D4C:  LDA R2                  ;GET 'Y' POSITION
L6D4E:  SEC                     ;BACK DOWN
L6D4F:  SBC #$08                ;COMPUTE Y OF NEXT LINE
L6D51:  STA R2
L6D53:  LDX R1                  ;GET SCORE INDEX
L6D55:  INX                     ;+3
L6D56:  INX
L6D57:  INX
L6D58:  CPX #$41                ;END?
L6D5A:  BCC SCORES_20           ;NOPE

SCORES_80:
L6D5C:  SEC                     ;YEP. SIGNAL SCORES ARE UP
L6D5D:  RTS

IN3TIM:
; [note] Display all three initials: INITAL for each
L6D5E:  JSR IN3TIM_1            ;($6D64)
L6D61:  JSR IN3TIM_1            ;($6D64)

IN3TIM_1:
L6D64:  LDY R3                  ;Y = INITIAL INDEX
L6D66:  JSR INITAL              ;($66E1) DISPLAY INITIAL
L6D69:  INC R3                  ;BUMP POINTER
L6D6B:  RTS

;------------------------------[ SEARCH - SEARCH FOR FREE ROCK ENTRY ]------------------------------

SEARCH:
; [note] Find a free rock slot, from X down; $FF if none
L6D6C:  LDX #$18

SEARC1:
; [note] SEARCH's loop entry
L6D6E:  LDA OBJ,X
L6D71:  BEQ SEARC1_20           ;FOUND ONE
L6D73:  DEX
L6D74:  BPL SEARC1              ;LOOP TIL EXHAUSTED

SEARC1_20:
L6D76:  RTS

;--------------------------------[ SHPEXP-SHIP EXPLODING PICTURES ]---------------------------------

SHPEXP:
; [note] The ship's explosion: move and draw its fragments
L6D77:  LDA SHPPIX
L6D7A:  CMP #$A2
L6D7C:  BCS SHPEXP_10           ;NOT THE FIRST EXPLOSION
L6D7E:  LDX #$07                ;# OF VECTORS IN SHIP PICTURE

SHPEXP_5:
L6D80:  LDA RANDOM
L6D83:  AND #$07
L6D85:  EOR XCOMP               ;APPLY IT TO THE POSITION
L6D87:  ASL A                   ;SCALE IT
L6D88:  STA SXPXL,X             ;X LSB
L6D8B:  LDA $06
L6D8D:  ROL A
L6D8E:  STA SXPXH,X             ;X MSB
L6D91:  LDA RANDOM
L6D94:  AND #$07
L6D96:  EOR $07                 ;ADD IT TO POSITION
L6D98:  ASL A                   ;SCALE IT
L6D99:  STA SXPYL,X             ;Y LSB
L6D9C:  LDA $08
L6D9E:  ROL A
L6D9F:  STA SXPYH,X             ;Y MSB
L6DA2:  LDA RANDOM
L6DA5:  AND #$0F
L6DA7:  ADC #$F8
L6DA9:  STA EXPTMB,X
L6DAC:  JSR SHPEXP_150          ;($6E31)
L6DAF:  STA EXPDX,X             ;X VEL
L6DB1:  JSR SHPEXP_150          ;($6E31)
L6DB4:  STA EXPDY,X             ;Y VELOCITY
L6DB6:  DEX
L6DB7:  BPL SHPEXP_5            ;CONTINUE

SHPEXP_10:
L6DB9:  LDA #$07
L6DBB:  STA R2                  ;NO X/Y FLIP REQUIRED
L6DBD:  STA R5                  ;LOOP COUNT

SHPEXP_20:
L6DBF:  LDX R5                  ;VECTOR COUNTER
L6DC1:  LDA SHPPIX              ;GET SHIP PICTURE (A0-FF)
L6DC4:  JSR COMP                ;($70EC) A = 60 - 0 IN INCREMENTS OF 1
L6DC7:  AND #$F0                ;60 - 0 IN INCREMENTS OF 10
L6DC9:  ADC #$60                ;CO - 60
L6DCB:  STA TEMP1               ;INTENSITY
L6DCD:  LDA EXPANG,X            ;ORIENTATION
L6DCF:  ADC EXPTMB,X            ;UPDATE IT
L6DD2:  STA EXPANG,X
L6DD4:  LSR A                   ;GET CODE
L6DD5:  LSR A
L6DD6:  PHA                     ;SAVE IT FOR LATER
L6DD7:  LSR A                   ;PUT IT IN BIT 2
L6DD8:  LSR A
L6DD9:  LSR A
L6DDA:  AND #$04                ;ISOLATE BIT 2
L6DDC:  STA $0A                 ;Y INVERSION BIT
L6DDE:  ORA TEMP1               ;MERGE IT WITH INTENSITY
L6DE0:  STA TEMP1               ;PASS IT
L6DE2:  JSR SHPEXP_100          ;($6E12) COMPUTE X
L6DE5:  STA $06                 ;MOVE DATA BACK TO X SLOT
L6DE7:  LDA $07
L6DE9:  STA XCOMP
L6DEB:  TXA
L6DEC:  CLC
L6DED:  ADC #$08                ;SKIP UP TO Y PARAMETERS
L6DEF:  TAX
L6DF0:  JSR SHPEXP_100          ;($6E12) COMPUTE THEM
L6DF3:  JSR POSBEM              ;($6C43) POSITION BEAM
L6DF6:  PLA                     ;GET ORIENTATION
L6DF7:  AND #$1E                ;ISOLATE PIX CODE
L6DF9:  TAX
L6DFA:  LDA L506A,X             ;POINT TO FRAME ROUTINE
L6DFD:  ASL A                   ;ITS A JSRL SO WE MUST UNPACK IT
L6DFE:  STA R0                  ;AND PUT THE ACTUAL ADDRESS INTO R0,R1
L6E00:  LDA L506B,X
L6E03:  ROL A
L6E04:  EOR #$C0                ;DROP BIT 15 AND SET BIT 14
L6E06:  STA R1
L6E08:  LDX #$00
L6E0A:  JSR CPYVEC              ;($6246) MOVE IN 1 VECTOR
L6E0D:  DEC R5                  ;COUNT DOWN
L6E0F:  BPL SHPEXP_20           ;CONTINUE
L6E11:  RTS                     ;EXIT

SHPEXP_100:
L6E12:  LDY #$00
L6E14:  LDA EXPDX,X             ;GET DIRECTION
L6E16:  BPL SHPEXP_101
L6E18:  DEY                     ;SIGN EXTEND

SHPEXP_101:
L6E19:  CLC
L6E1A:  ADC SXPXL,X             ;UPDATE POSITION
L6E1D:  STA SXPXL,X
L6E20:  STA $07                 ;PASS IT TO VGLABS ROUTINE HERE
L6E22:  TYA
L6E23:  ADC SXPXH,X
L6E26:  AND #$07                ;ROLL OVER TOP AND SIDES
L6E28:  STA SXPXH,X
L6E2B:  LSR A
L6E2C:  STA $08
L6E2E:  ROR $07
L6E30:  RTS

SHPEXP_150:
L6E31:  LDA RANDOM
L6E34:  AND #$07                ;MASK TO 3 BITS
L6E36:  CLC
L6E37:  ADC #$FC                ;MAKE IT RANGE -4 < N < +3
L6E39:  ADC #$00                ;MAKE IT RANGE -4 < N < +4
L6E3B:  RTS

;----------------------------------[ SHPPIC-DISPLAY SHIP PICTURE ]----------------------------------

SHPPIC:
; [note] Draw the ship, and its flame when thrusting
L6E3C:  LDA SBTL
L6E3E:  CMP #$C0                ;TWINKLE ON THE SCREEN?
L6E40:  BCS SHPPIC_1            ;NOPE
L6E42:  ADC #$06                ;YEP. TWINKLE
L6E44:  STA SBTL
L6E46:  LDA RANDOM              ;RANDOM NUMBER
L6E49:  AND #$04                ;GET RANDOM INVERSION BITS
L6E4B:  STA TEMP1
L6E4D:  LDA RANDOM              ;RANDOM NUMBER
L6E50:  AND #$04
L6E52:  STA $0A
L6E54:  LDA RANDOM              ;RANDOM NUMBER
L6E57:  AND #$80
L6E59:  STA R2
L6E5B:  LDA #$09                ;10 PAIRS OF VECTORS
L6E5D:  STA R5
L6E5F:  LDA #$4D
L6E61:  LDX #$87
L6E63:  STA R1                  ;INIT R0,R1
L6E65:  STX R0
L6E67:  LDY #$00                ;0=> Y
L6E69:  LDX #$00

SHPPIC_2:
L6E6B:  JSR AYTOR0              ;($6EB2) COMPUTE R0,R1 = Y+1, COPY 1 VECTOR
L6E6E:  LDA RANDOM              ;RANDOM NUMBER
L6E71:  LSR A                   ;PUT IT IN CARRY
L6E72:  LDA #$00
L6E74:  BCC SHPPIC_4            ;SHOW A DOT
L6E76:  LDA #$70                ;BLANK A DOT

SHPPIC_4:
L6E78:  ORA TEMP1               ;MERGE WITH INVERSION BIT
L6E7A:  STA TEMP1
L6E7C:  JSR AYTOR0              ;($6EB2) COMPUTE R0,R1 = Y+1, COPY 1 VECTOR
L6E7F:  LDA TEMP1               ;CLEAR INTENSITY FLAG
L6E81:  AND #$04                ;BUT KEEP INVERSION BIT
L6E83:  STA TEMP1
L6E85:  DEC R5                  ;COUNT
L6E87:  BPL SHPPIC_2            ;CONTINUE
L6E89:  JSR AYTOR0              ;($6EB2) RETURN BEAM TO CENTER AT 0 INTENSITY

SHPPIC_1:
L6E8C:  JSR CPTSPX              ;($6EC1)
L6E8F:  JSR CPYVEC              ;($6246) WITH NO INTENSITY CHANGE
L6E92:  LDA SBTL                ;GET INTENSITY
L6E94:  AND #$F0
L6E96:  CMP #$60                ;THERE IS A MINIMUM INTENSITY
L6E98:  BCS SHPPIC_3
L6E9A:  LDA #$60                ;BELOW WHICH IT CAN'T BE SEEN

SHPPIC_3:
L6E9C:  ORA TEMP1               ;MERGE IN THE X INVERSION BIT
L6E9E:  STA TEMP1
L6EA0:  LDX #$07                ;LOAD X WITH VECTOR COUNT-1 (S/B A 5)
L6EA2:  JSR AYTOR0              ;($6EB2) ADD Y+1 TO R0, COPY VECTORS

THRTST:
; [note] Is the thrust button on?
L6EA5:  BIT THRUST              ;TRUE?
L6EA8:  BPL TTST                ;NO THRUST. EXIT
L6EAA:  LDA FRAME
L6EAC:  AND #$04
L6EAE:  BEQ TTST                ;FLICKER AT 15HZ
L6EB0:  LDX #$01                ;ALL THRUSTS ARE ONLY 2 VECTORS

AYTOR0:
; [note] Advance the source pointer by Y+1, then CPYVEC
L6EB2:  TYA                     ;POINT R0,R1 TO FLAME VECTORS
L6EB3:  SEC                     ;+1
L6EB4:  ADC R0
L6EB6:  STA R0
L6EB8:  LDA #$00
L6EBA:  ADC R1
L6EBC:  STA R1
L6EBE:  JMP CPYVEC              ;($6246) COPY FLAME VECTORS AND EXIT

CPTSPX:
; [note] Point R0/R1 at the ship hull for the current ANGLE
L6EC1:  LDA ANGLE
L6EC3:  SEC
L6EC4:  SBC #$40                ;PICTURES ARE STORED 90-135 SO BACK UP
L6EC6:  JSR CPXROT              ;($6EE2) COMPUTE INDEX INTO ROTATIONS ARRAY
L6EC9:  TYA                     ;Y COMES BACK POINTING TO WORD
L6ECA:  LSR A                   ;FIX IT TO POINT TO BYTE
L6ECB:  TAY
L6ECC:  LDX #$53                ;GET HIGH BYTE OF ADDRESS OF SHIP VECTORS
L6ECE:  LDA SHIPS,Y             ;GET OFFSET
L6ED1:  ASL A                   ;*2
L6ED2:  BCC CPTSPX_5            ;X=X+CARRY
L6ED4:  INX
L6ED5:  CLC

CPTSPX_5:
L6ED6:  ADC #$C6                ;ADD OFFSET TO ADDRESS
L6ED8:  STA R0
L6EDA:  TXA
L6EDB:  ADC #$00
L6EDD:  STA R1
L6EDF:  LDX #$00

TTST:
; [note] Shared return
L6EE1:  RTS

;---------------------------[ CPXROT OBJECT ORIENTATION INDEX EVALUATOR ]---------------------------

CPXROT:
; [note] Object orientation index from the angle
L6EE2:  LSR A                   ;THROW AWAY LOW 2 BITS OF ANGLE
L6EE3:  STA R0                  ;SAVE RESIDUAL
L6EE5:  LSR A
L6EE6:  LSR A                   ;GET THE 1/2 QUADRANT NUMBER
L6EE7:  LSR A
L6EE8:  LSR A
L6EE9:  TAY
L6EEA:  LDA TABLE,Y             ;GET OPERATIONS CODE
L6EED:  ASL A                   ;PUT NEGATE BIT INTO CARRY
L6EEE:  STA R2                  ;SAVE RESIDUAL
L6EF0:  LDA R0                  ;GET ANGLE (/2)
L6EF2:  AND #$0E                ;ISOLATE PORTION WITHIN 45 DEGREES
L6EF4:  BCC CPXROT_1            ;NO NEGATE
L6EF6:  EOR #$0E                ;NEGATE 3 BITS TO 4 BITS
L6EF8:  ADC #$01                ;(CARRY SET FROM ABOVE)

CPXROT_1:
L6EFA:  TAY                     ;PASS IT TO USER
L6EFB:  LDA R2                  ;GET RESIDUAL OPERATIONS BITS
L6EFD:  AND #$04                ;ISOLATE X MASK
L6EFF:  STA TEMP1               ;PASS IT TO USER
L6F01:  ASL R2                  ;PLACE SWAP BIT INTO BIT 7
L6F03:  LDA R2
L6F05:  AND #$04                ;ISOLATE Y MASK
L6F07:  STA $0A                 ;PASS IT TO USER
L6F09:  RTS                     ;FINI

TABLE:
; placed by hand: DSTRD0.MAC:2891 `TABLE: CT 0,0,0,0 ...`, the CPXROT control table: bit 7 negate pix select, 5 swap X with Y, 1 X sign mask, 0 Y sign mask. Eight bytes, one per orientation octant. Built by the CT macro, so the by-content placement cannot see its bytes
L6F0A:  .byte $00, $A3, $22, $81, $03, $A0, $21, $82 ;.."...!.

;------------------------------------[ SOUNDS-GENERATE SOUNDS ]-------------------------------------

SOUNDS:
; [note] Decide which sounds play this frame
L6F12:  LSR R0                  ;ASSUME NO THRUST
L6F14:  LDX NPLAYR
L6F16:  BEQ SOUNDS_60           ;ATTRACT. RESET EXPLOSION
L6F18:  LDX $A9                 ;CHANNELS 6 AND 7 MUST NOT BE BUSY
L6F1A:  BNE SOUNDS_25           ;NO SUCH LUCK. WAIT UNTIL NEXT TIME
L6F1C:  LDA SND3                ;ANY EXTRA LIFE NOISE REQ?
L6F1E:  BEQ SOUNDS_24           ;NOPE
L6F20:  LDY #$2F                ;YEP. START IT
L6F22:  JSR SNDON               ;($775B)
L6F25:  STX SND3                ;CLEAR THE FLAG FOR NEXT TIME
L6F27:  BEQ SOUNDS_25           ;(ALWAYS)

SOUNDS_24:
L6F29:  LDA HSSND               ;ANY HI SCORE NOISE REQ?
L6F2B:  BEQ SOUNDS_25           ;NO.
L6F2D:  LDY #$5F
L6F2F:  JSR SNDON               ;($775B)
L6F32:  STX HSSND               ;CLEAR FLAG FOR NEXT TIME

SOUNDS_25:
L6F34:  LDA SHPPIX              ;SHIP?
L6F37:  BMI SOUNDS_27           ;SHIP IS DESTROYED
L6F39:  BEQ SOUNDS_27           ;SHIP NOT ON SCREEN YET
L6F3B:  ASL THRUST              ;SIGNAL THRUST
L6F3E:  ROR R0
L6F40:  LDA NROCKS
L6F43:  BEQ SOUNDS_27           ;IF NOT ROCKS
L6F45:  LDA THUMP1
L6F47:  BEQ SOUNDS_30           ;IF THUMP SOUND IS OFF
L6F49:  DEC THUMP1
L6F4B:  BNE SOUNDS_50           ;LEAVE SOUND ON

SOUNDS_27:
L6F4D:  LDA THUMP3
L6F50:  STA THUMP2              ;AT LEAST 8 FRAMES BEFORE ITS ON AGAIN
L6F52:  BPL SOUNDS_50           ;ALWAYS

SOUNDS_30:
L6F54:  DEC THUMP2
L6F56:  BNE SOUNDS_50           ;LEAVE SOUND OFF
L6F58:  LDA #$04
L6F5A:  STA THUMP1              ;NUMBER FRAMES FOR SOUND TO BE ON
L6F5C:  INC LTHUMP              ;CHEAP WAY TO TOGGLE BIT 0
L6F5E:  LDA LTHUMP
L6F60:  AND #$01                ;ISOLATE IT
L6F62:  TAX
L6F63:  LDY TSS,X
L6F66:  JSR SNDPON              ;($7758)

SOUNDS_50:
L6F69:  LDA LEXPSND
L6F6B:  TAX
L6F6C:  AND #$3F
L6F6E:  BEQ SOUNDS_60           ;IF NO EXPLOSION VOLUME
L6F70:  DEX

SOUNDS_60:
L6F71:  STX LEXPSND
L6F73:  STX EXPSND              ;SET SOUND FREQUENCY/LEVEL
L6F76:  LDA R0                  ;GET THRUST CONTROL
L6F78:  STA SPTEN               ;TURN ON/OFF THRUST SOUND
L6F7B:  RTS

TSS:
L6F7C:  .byte $07, $0F          ;..

;-------------------------------[ SPLIT - SPLIT ROCK INTO FRAGMENTS ]-------------------------------

SPLIT:
; ENTRY	(Y)=INDEX OF OBJECT BEING SPLIT
; (X)=INDEX OF SHIP, SAUCER OR TORPEDO
L6F7E:  STX TEMP3               ;SAVE X
L6F80:  LDA #$50
L6F82:  STA RTIMER              ;RESET TIMER IF ROCK HAS BEEN HIT

SPLIT_1:
L6F85:  LDA OBJ,Y
L6F88:  AND #$78                ;SAVE PICTURE
L6F8A:  ASL A
L6F8B:  BPL SPLIT_2
L6F8D:  JMP SPLTTP              ;($4800)

SPLIT_2:
L6F90:  LSR A
L6F91:  STA $0F
L6F93:  LDA OBJ,Y
L6F96:  AND #$07
L6F98:  LSR A
L6F99:  TAX
L6F9A:  BEQ SPLIT_10            ;EMPTY NOW
L6F9C:  ORA $0F

SPLIT_10:
L6F9E:  STA OBJ,Y               ;NEW PICTURE & SIZE
L6FA1:  LDA NPLAYR
L6FA3:  BEQ SPLIT_20            ;WE ARE IN ATTRACT
L6FA5:  LDA TEMP3
L6FA7:  BEQ SPLIT_15            ;SHIP DOES IT
L6FA9:  CMP #$04
L6FAB:  BCC SPLIT_20            ;NO POINTS IF SAUCER DOES IT

SPLIT_15:
L6FAD:  LDA HITSCR,X            ;SCORE FOR HIT
L6FB0:  CLC
L6FB1:  JSR POINTS              ;($6C60) ADD POINTS AND CHECK FOR 10K

SPLIT_20:
L6FB4:  LDX OBJ,Y
L6FB7:  BEQ SPLIT_90            ;DISAPPEARED
L6FB9:  JSR SEARCH              ;($6D6C) SEARCH FOR NEW ENTRY
L6FBC:  BMI SPLIT_90            ;NO MORE ENTRIES
L6FBE:  INC NROCKS
L6FC1:  JSR CPYPOS              ;($6210) COPY POSITION FOR NEW ENTRY
L6FC4:  JSR NEWVEL              ;($6A57) NEW VELOCITY
L6FC7:  LDA XINC,X
L6FCA:  AND #$1F
L6FCC:  ASL A
L6FCD:  EOR OBJXL,X
L6FD0:  STA OBJXL,X             ;PREVENT OVERLAPING ROCKS
L6FD3:  JSR SEARC1              ;($6D6E) LOOK FOR NEW ENTRY
L6FD6:  BMI SPLIT_90            ;NO MORE ROOM
L6FD8:  INC NROCKS
L6FDB:  JSR CPYPOS              ;($6210) COPY POSITION & PICTURE + VELOCITY
L6FDE:  JSR NEWVEL              ;($6A57) NEW VELOCITY USING OLD
L6FE1:  LDA YINC,X
L6FE4:  AND #$1F
L6FE6:  ASL A
L6FE7:  EOR OBJYL,X
L6FEA:  STA OBJYL,X

SPLIT_90:
L6FED:  LDX TEMP3
L6FEF:  RTS

;--------------------------------[ UPDATE-UPDATE HIGH SCORE TABLE ]---------------------------------

UPDATE:
; [note] Update the high-score table with a finished game's score
L6FF0:  LDA NPLAYR
L6FF2:  BPL UPDATE_90           ;FRAME AFTER END OF GAME (A=-1)
L6FF4:  STA $77                 ;PUT UP HIGH SCORE TABLE NEXT
L6FF6:  STA UPDFLG
L6FF8:  STA $43                 ;CLEAR FLAGS
L6FFA:  STA EAHSX
L6FFC:  JSR INISOU              ;($784F) RESET SOUNDS
L6FFF:  LDX #$03                ;PLAYER SCORE INDEX

UPDATE_18:
L7001:  LDY #$00                ;INDEX INTO HIGH SCORE TABLE

UPDATE_20:
L7003:  LDA a:HSCORE,Y
L7006:  CMP SCORE,X             ;SETS CARRY
L7008:  LDA a:$0024,Y
L700B:  SBC $63,X
L700D:  LDA a:$0025,Y
L7010:  SBC $64,X
L7012:  BCC UPDATE_30           ;NEW HIGH SCORE

UPDATE_25:
L7014:  INY
L7015:  INY
L7016:  INY
L7017:  CPY #$1E
L7019:  BCC UPDATE_20           ;LOOP FOR 10 ENTRIES

UPDATE_28:
L701B:  DEX
L701C:  DEX
L701D:  DEX
L701E:  BPL UPDATE_18           ;NEXT PLAYER
L7020:  LDA $43
L7022:  BMI UPDATE_29           ;NO PLAYER 2 HIGH SCORE
L7024:  CMP UPDFLG
L7026:  BCC UPDATE_29           ;IF PLAYER 2 SCORE IS BETTER THAN PLAYER 1
L7028:  ADC #$02                ;ADD 3
L702A:  CMP #$1E
L702C:  BCC UPDATE_27           ;IF NOT OUT OF TABLE NOW
L702E:  LDA #$FF

UPDATE_27:
L7030:  STA $43                 ;NEW INDEX

UPDATE_29:
L7032:  LDX EAHSX               ;ON THE HIGH SCORE TABLE?
L7034:  BMI UPDATE_99           ;NO
L7036:  LDY #$4F                ;NOISE
L7038:  JSR SNDON               ;($775B)
L703B:  LDA CRMERR              ;COPYRIGHT ERROR?
L703D:  BEQ UPDATE_97           ;NOPE
L703F:  LDA #$55                ;1 OUT OF 3 TIMES
L7041:  CMP RANDOM              ;GIVE THE GUY 2
L7044:  BCC UPDATE_97
L7046:  INC CRDT                ;FREE GAMES
L7048:  INC CRDT

UPDATE_97:
L704A:  TXA
L704B:  BNE UPDATE_99
L704D:  SEC
L704E:  ROR CPMTST
L7050:  JSR VGRCPT              ;($77F5) TEST
L7053:  LSR CPMTST

UPDATE_99:
L7055:  LDA #$00
L7057:  STA NPLAYR              ;FLAG DONE WITH UPDATE
L7059:  STA UPDINT              ;STARTING WITH FIRST INITIAL

UPDATE_90:
L705B:  RTS

UPDATE_30:
L705C:  STX TEMP2               ;SAVE INDEX
L705E:  TXA
L705F:  LSR A
L7060:  TAX                     ;0 OR 1
L7061:  STY UPDFLG,X            ;FLAG TO GET PLAYERS INITIALS
L7063:  STY R0                  ;SAVE IT HERE TOO
L7065:  CPY EAHSX               ;KEEP LOWER OF 2
L7067:  BCS UPDATE_31           ;NOT LOWER
L7069:  STY EAHSX
L706B:  LDA #$00                ;CLEAR R1
L706D:  STA R1
L706F:  TYA                     ;GET ENTRY INDEX

UPDATE_33:
L7070:  SEC                     ;DIVIDE BY 3
L7071:  SBC #$03
L7073:  BCC UPDATE_32
L7075:  INC R1
L7077:  BNE UPDATE_33           ;(ALWAYS)

UPDATE_32:
L7079:  LDA R1                  ;GET QUO
L707B:  EOR #$FF                ;NEGATE IT
L707D:  ADC #$04                ;A=[3-(ENTRY/3)]*7
L707F:  STA R1
L7081:  ASL R1
L7083:  ADC R1
L7085:  ASL R1
L7087:  ADC R1
L7089:  STA EABC                ;KEEP BYTE COUNT
L708B:  LDA #$14                ;START @ END
L708D:  STA EAX

UPDATE_31:
L708F:  LDX #$1B

UPDATE_40:
L7091:  CPX R0
L7093:  BEQ UPDATE_45           ;IF END OF COPY
L7095:  LDA UPDINT,X            ;COPY INITIALS DOWN
L7097:  STA INITL,X
L7099:  LDA UPDFLG,X
L709B:  STA $45,X
L709D:  LDA $43,X
L709F:  STA $46,X
L70A1:  LDA PLAYR3,X            ;COPY SCORES DOWN
L70A3:  STA HSCORE,X
L70A5:  LDA LPLAYR,X
L70A7:  STA $24,X
L70A9:  LDA NPLAYR,X
L70AB:  STA $25,X
L70AD:  DEX
L70AE:  DEX
L70AF:  DEX
L70B0:  BNE UPDATE_40           ;LOOP UNTIL X=0 OR DONE

UPDATE_45:
L70B2:  LDA #$0B
L70B4:  STA INITL,X             ;START LETTERS AT A
L70B6:  LDA #$00                ;CLEARS SECOND AND THIRD INITIALS
L70B8:  STA $45,X
L70BA:  STA $46,X
L70BC:  LDA #$F0                ;1 MINUTE AT 60HZ
L70BE:  STA $77                 ;PREPARE TO TIMEOUT GETTING INITIALS
L70C0:  LDX TEMP2               ;LOOP FOR NEXT PLAYER
L70C2:  LDA $64,X
L70C4:  STA a:$0025,Y
L70C7:  LDA $63,X
L70C9:  STA a:$0024,Y
L70CC:  LDA SCORE,X
L70CE:  STA a:HSCORE,Y
L70D1:  JMP UPDATE_28           ;($701B)

ATAN:
; ENTRY	(X)=X PART OF ARCTAN (Y/X) (SIGNED NUMBER)
; (Y)=Y PART (SIGNED NUMBER)
; EXIT	(A)=ARCTAN RESULT (0 TO FF, 40=90 DEGREES)
; USES	A,X,Y,(TEMP2,TEMP2+1)
L70D4:  TYA
L70D5:  BPL ATAN1               ;IF Y>-0
L70D7:  JSR COMP                ;($70EC) +Y=-Y
L70DA:  JSR ATAN1               ;($70E0) ATAN (-Y/X)
L70DD:  JMP COMP                ;($70EC) ARCTAN(Y/X)=-ARCTAN(-Y/X)

ATAN1:
; [note] ATAN, right half-plane
L70E0:  TAY                     ;DIVISOR
L70E1:  TXA
L70E2:  BPL ATAN2               ;IF X=-0
L70E4:  JSR COMP                ;($70EC) X=-X
L70E7:  JSR ATAN2               ;($70F2) ATAN(Y/-X)
L70EA:  EOR #$80                ;ARCTAN(Y/X)=80-ARTCAN(Y/-X)

COMP:
; ENTRY	(A)=VALUE TO BE COMPLEMENTED
; EXIT	(A)=ANSWER
; USES	A
L70EC:  EOR #$FF
L70EE:  CLC
L70EF:  ADC #$01
L70F1:  RTS

ATAN2:
; [note] ATAN, first quadrant
L70F2:  STA $0D                 ;DIVISOR (X)
L70F4:  TYA                     ;DIVIDEND (Y)
L70F5:  CMP $0D
L70F7:  BCC ATAN3               ;IF Y<X USE ARCTAN ON 45 DEGREE SECTOR
L70F9:  LDY $0D                 ;ELSE USE ARCCOT
L70FB:  STA $0D
L70FD:  TYA
L70FE:  JSR ATAN3               ;($7107) ARCTAN (X/Y)
L7101:  SEC
L7102:  SBC #$40
L7104:  JMP COMP                ;($70EC) ARCTAN (Y/X)=40-ARCTAN(X/Y)

ATAN3:
; [note] ATAN, first octant: table lookup on the quotient
L7107:  JSR DIVIDE              ;($7121) 4 BIT DIVIDE
L710A:  TAX
L710B:  LDA ATANA,X             ;TABLE LOOKUP
L710E:  RTS

ATANA:
L710F:  .byte $00, $02, $05, $07, $0A, $0C, $0F, $11 ;........
L7117:  .byte $13, $15, $17, $19, $1A, $1C, $1D, $1F ;........
L711F:  .byte $20               ; 

CKSUM4:
L7120:  .byte $74               ;t

;------------------------------------[ DIVIDE/SIN/COS ROUTINES ]------------------------------------

DIVIDE:
; [note] 5-bit unsigned quotient of A / TEMP2+1
L7121:  LDY #$04                ;5 BITS OF QUOTIENT

DIVIDE_10:
L7123:  CMP $0D                 ;DIVISOR BIGGER?
L7125:  BCC DIVIDE_20           ;YES
L7127:  SBC $0D                 ;NO. TAKE 1 (LEAVES C=1)

DIVIDE_20:
L7129:  ROL TEMP2               ;SAVE QUOTIENT BIT
L712B:  ASL A                   ;MOVE DIVIDEND
L712C:  DEY                     ;COUNT
L712D:  BPL DIVIDE_10           ;CONTINUE
L712F:  LDA TEMP2
L7131:  AND #$1F                ;5 BITS OF RESULTS
L7133:  RTS

COS:
; COS-COSINE
; ENTRY	=ANGLE (0 TO FF)
; EXIT	(A)=COSINE(-127,127)
L7134:  CLC                     ;COS(A)=SIN(A+PI/2)
L7135:  ADC #$40

SIN:
; ENTRY	(A)=ANGLE (0 TO FF REPRESENTS 0 TO 360 DEGREES)
; (CC)=MINUS/PLUS FLAG SET CORRECTLY
; EXIT	(A)=SINE (-127 TO +127)
; USES	A,X
L7137:  BPL SIN1                ;IF PI > ANGLE >-0
L7139:  AND #$7F
L713B:  JSR SIN1                ;($7141) SIN(A) WHEN PI > A >= 0
L713E:  JMP COMP                ;($70EC) SIN(PI+A)=-SIN(A)

SIN1:
; [note] SIN for 0..180 degrees via the quarter-wave table
L7141:  CMP #$41
L7143:  BCC SIN1_10             ;PI/2 >- ANGLE >- 0
L7145:  EOR #$7F                ;SIN(PI/2+A)=SIN(PI/2-A)
L7147:  ADC #$00                ;ADD 1

SIN1_10:
L7149:  TAX
L714A:  LDA SINCOS,X
L714D:  RTS

;-------------------------------------------[ MESSAGES ]--------------------------------------------

SETROL:
; also DSTMSG in the linker map
; [note] Rotate the four rock shapes and build the copyright display list
L714E:  LDA #$04
L7150:  STA FRAME

SETROL_1:
L7152:  JSR ROTAST              ;($4B92)
L7155:  DEC FRAME
L7157:  BNE SETROL_1
L7159:  LDX #$C9                ;GET JSRL <LABS,CIRCLR,CIRCLP>
L715B:  LDA #$47                ;POINT TO VG RAM
L715D:  STA $04
L715F:  LDA #$02
L7161:  STA VGLIST
L7163:  LDA #$C1
L7165:  JSR VGADD2              ;($7CCC) STUFF IT
L7168:  LDA #$03
L716A:  STA TEMP1
L716C:  LDA #$76
L716E:  STA $0A
L7170:  LDA #$00
L7172:  STA VGSIZE
L7174:  LDA #$70
L7176:  LDX #$20
L7178:  JSR CM                  ;($71B5) UNPACK ATARI, INC
L717B:  JMP VGRTSL              ;($79E8) FOLLOW WITH A RTSL

CPYRS:
; [note] The copyright line on the high-score screen
L717E:  LDA #$C5                ;GET JSRL TO CIRCLC,CIRCLP
L7180:  LDX #$C9
L7182:  JSR VGADD2              ;($7CCC) STUFF IF
L7185:  LDX #$03                ;POINT TO CODED ATARI, INC
L7187:  LDA #$76
L7189:  STA $0A
L718B:  STX TEMP1
L718D:  BNE ASTMSG_2            ;(ALWAYS) GO UNPACK MESSAGE

;---------------------------[ VGMSG-VECTOR GENERATOR MESSAGE PROCESSOR ]----------------------------

VGMSG:
; ENTRY	(Y)=MESSAGE NUMBER (0,1,2,...)
; USES	A,X,Y(TEMP1,TEMP1+1),TEMP2,(VGLIST,VGLIST+1)
; [note] Display message Y in the language the option switch selects
;        (OPTN4 bits 0-1: 0 English, 1 German, 2 French, 3 Spanish), in
;        medium characters.  Falls into VGME.
L718F:  LDA OPTN4
L7192:  AND #$03
L7194:  LDX #$10                ;MEDIUM SIZED CHARACTERS
L7196:  STX VGSIZE

VGME:
; [note] Display message Y in language A.  VGMSG arrives here with the
;        switch's language; SETROL's copyright line enters here with A=0
;        (English only).  Fetch the language block's address from VGMSGT,
;        add that block's offset for message Y, and TEMP1 now points at
;        the packed text.
L7198:  ASL A                   ;(SPECIAL ENGLISH ONLY ENTRY POINT)
L7199:  TAX                     ;2*LANGUAGE (0,2,4,OR 6)
L719A:  LDA VGMSGT+1,X
L719D:  STA $0A
L719F:  LDA VGMSGT,X            ;CARRY IS CLEAR FROM ASL ABOVE
L71A2:  STA TEMP1               ;TEMP1 SETUP NOW
L71A4:  ADC (TEMP1),Y           ;RELATIVE ADDRESS TO START OF MESSAGE
L71A6:  STA TEMP1
L71A8:  BCC VGME_10             ;NO OVERFLOW
L71AA:  INC $0A

VGME_10:
; [note] The message's screen position: VGMSGS holds an X,Y pair per
;        message number, in beam units over 4 as VGSABS takes them.
;        A = X, X = Y, then fall into CM.
L71AC:  TYA
L71AD:  ASL A
L71AE:  TAY
L71AF:  LDA VGMSGS,Y
L71B2:  LDX VGMSGS+1,Y

CM:
; [note] Position the beam at (A,X), emit a WAIT so it settles, then
;        unpack the text at TEMP1 into the display list (falls into ASTMSG).
L71B5:  JSR VGSABS              ;($7A31) POSITION BEAM
L71B8:  LDA #$70
L71BA:  JSR VGWAIT              ;($7AFC) WAIT FOR BEAM IS

ASTMSG_2:
; [note] Unpack ASCIN-packed text into the display list.  Every two bytes
;        hold three 5-bit character codes: b0 = c1<<3 | c2>>2, and
;        b1 = (c2 & 3)<<6 | c3<<1 | end.  Each code goes to VGMSG1/VGMSG2,
;        which append the glyph's JSRL word.  Stops at the end bit, or
;        early on a code of 0.
L71BD:  LDY #$00                ;Y IS INDEX FOR VGLIST
L71BF:  LDX #$00                ;X IS INDEX FOR TEMP1

ASTMSG_20:
; [note] The loop, one byte pair per pass: code 1 is the top five bits of
;        the first byte; code 2 straddles the two bytes, assembled by the
;        rotate chain; code 3 is bits 5-1 of the second byte, whose bit 0
;        ends the message.
L71C1:  LDA (TEMP1,X)
L71C3:  STA TEMP2
L71C5:  LSR A
L71C6:  LSR A                   ;2*INDEX
L71C7:  JSR VGMSG1              ;($71E6) PUT OUT CHARACTER AND UPDATE TEMP1
L71CA:  LDA (TEMP1,X)
L71CC:  ROL A
L71CD:  ROL TEMP2
L71CF:  ROL A
L71D0:  LDA TEMP2
L71D2:  ROL A
L71D3:  ASL A
L71D4:  JSR VGMSG2              ;($71EC) PUT OUT CHARACTER
L71D7:  LDA (TEMP1,X)
L71D9:  STA TEMP2
L71DB:  JSR VGMSG1              ;($71E6) PUT OUT CHARACTER AND UPDATE TEMP1
L71DE:  LSR TEMP2
L71E0:  BCC ASTMSG_20           ;NOT END OF LIST

VGMSG0:
; [note] Message done: Y counts the bytes written, VGADD moves VGLIST
;        past them.
L71E2:  DEY
L71E3:  JMP VGADD               ;($7A67) UPDATE VGLIST POINTER

VGMSG1:
; [note] Step the text pointer TEMP1 (carry into the high byte), then
;        emit the character in A - A is already the code doubled.
L71E6:  INC TEMP1               ;UPDATE INDIRECT POINTER TO CHARACTERS
L71E8:  BNE VGMSG2              ;NO OVERFLOW
L71EA:  INC $0A

VGMSG2:
; [note] Emit one character; A = code*2.  Zero ends the message: the two
;        PLAs drop VGMSG1's return address so the BNE lands in VGMSG0.
;        Codes 1-4 are blank, 0, 1, 2; any other code has 14 added so it
;        indexes A..Z in the VGMSGA JSRL table at $56F8.  In copyright-test
;        mode (CPMTST set) the bytes are checked by CPR.UP, not written.
L71EC:  AND #$3E
L71EE:  BNE VGMSG2_5            ;NOT END OF LIST
L71F0:  PLA
L71F1:  PLA                     ;PURGE RTS
L71F2:  BNE VGMSG0              ;RETURN

VGMSG2_5:
; [note] Not the end: map the code to its VGMSGA table index (see VGMSG2).
L71F4:  CMP #$0A
L71F6:  BCC VGMSG2_10           ;IF BLANK, 0,1 OR 2
L71F8:  ADC #$0D                ;SET CORRECT INDEX

VGMSG2_10:
; [note] Fetch the glyph's JSRL word from VGMSGA ($56F6+X, X = 2*code or
;        2*code+14) and store both bytes at VGLIST,Y - unless CPMTST says
;        to test them instead.
L71FA:  TAX
L71FB:  LDA L56F6,X             ;10. FOR A, 12. FOR B, ....
L71FE:  BIT CPMTST              ;TEST MODE?
L7200:  BMI VGMSG2_12           ;YEP. GO TEST IT
L7202:  STA (VGLIST),Y          ;PUT JSRL INTO VECTOR LIST
L7204:  INY
L7205:  LDA L56F7,X
L7208:  STA (VGLIST),Y
L720A:  INY

VGMSG2_13:
; [note] Common exit: X back to 0 for the next (TEMP1,X) read.
L720B:  LDX #$00
L720D:  RTS

VGMSG2_12:
; [note] Copyright test mode: fold both bytes of the JSRL word into the
;        error flag through CPR.UP instead of storing them.
L720E:  JSR CPR_UP              ;($7835)
L7211:  LDA L56F7,X
L7214:  JSR CPR_UP              ;($7835)
L7217:  BNE VGMSG2_13           ;(ALWAYS)

VGMSGS:
; [note] Screen position of every message, an X,Y byte pair per message
;        number: 0 HIGH SCORES, 1 PLAYER, 2 YOUR SCORE IS ONE OF THE TEN
;        BEST, 3 PLEASE ENTER YOUR INITIALS, 4 PRESS ROTATE TO SELECT
;        LETTER, 5 PRESS SHIELD WHEN LETTER IS CORRECT, 6 PRESS START,
;        7 GAME OVER, 8 1 COIN 2 CREDITS, 9 1 COIN 1 CREDIT, 10 2 COINS 1
;        CREDIT, 11 CREDITS, 12 2 GAME MINIMUM, 13 BONUS AT.  Units are
;        beam position over 4, as VGSABS takes them.
L7219:  .byte $68, $B6, $72, $B6, $0C, $AA, $0C, $A2 ;h.r.....
L7221:  .byte $0C, $9A, $0C, $92, $68, $C6, $6E, $A7 ;....h.n.
L7229:  .byte $56, $42, $5A, $42, $58, $42, $68, $32 ;VBZBXBh2
L7231:  .byte $64, $C6, $6E, $D2 ;d.n.

VGMSGT:
; [note] The four language blocks, one word each: L0 English, L1 German,
;        L2 French, L3 Spanish.  VGME indexes it by 2*language.
L7235:  .byte $3D, $72, $F3, $72, $C2, $73, $7D, $74 ;=r.r.s}t

L0:
; [note] English.  14 one-byte offsets, one per message number, relative
;        to L0, then the packed text (three characters per two bytes,
;        decoded in the gutter).  Message 13, BONUS AT, is English only.
; 14 message offsets, each relative to L0
L723D:  .byte $0E, $16, $1C, $32, $44, $58, $70, $78 ;...2DXpx
L7245:  .byte $7E, $8A, $94, $A0, $A6, $B0 ;~.....

L0_10:
L724B:  .byte $63, $56, $60, $6E, $3C, $EC, $4D, $C0 ;"HIGH SCORES"

L0_11:
L7253:  .byte $A4, $0A, $EA, $6C, $08, $00 ;"PLAYER "

L0_12:
L7259:  .byte $EC, $F2, $B0, $6E, $3C, $EC, $48, $5A ;"YOUR SCORE IS ONE OF THE TEN BEST"
L7261:  .byte $B8, $66, $92, $42, $9A, $82, $C3, $12 ;.f.B....
L7269:  .byte $0E, $12, $90, $4C, $4D, $F1 ;...LM.

L0_13:
L726F:  .byte $A4, $12, $2D, $D2, $0A, $64, $C2, $6C ;"PLEASE ENTER YOUR INITIALS"
L7277:  .byte $0F, $66, $CD, $82, $6C, $9A, $C3, $4A ;.f..l..J
L727F:  .byte $85, $C0          ;..

L0_14:
L7281:  .byte $A5, $92, $BD, $C2, $B4, $F0, $2E, $12 ;"PRESS ROTATE TO SELECT LETTER"
L7289:  .byte $0E, $26, $0D, $D2, $82, $4E, $C0, $60 ;.&...N.`
L7291:  .byte $4E, $30, $4D, $80 ;N0M.

L0_15:
L7295:  .byte $A5, $92, $BD, $C2, $BB, $1A, $4C, $10 ;"PRESS SHIELD WHEN LETTER IS CORRECT"
L729D:  .byte $0E, $D8, $4C, $82, $82, $70, $C2, $6C ;..L..p.l
L72A5:  .byte $0B, $6E, $09, $E6, $B5, $92, $3E, $00 ;.n....>.

L0_16:
L72AD:  .byte $A5, $92, $BD, $C2, $BE, $0A, $B6, $00 ;"PRESS START"

L0_17:
L72B5:  .byte $59, $62, $48, $66, $D2, $6D ;"GAME OVER"

L0_18:
L72BB:  .byte $18, $4E, $9B, $64, $09, $02, $3D, $92 ;"1 COIN 2 CREDITS"
L72C3:  .byte $43, $70, $B8, $00 ;Cp..

L0_19:
L72C7:  .byte $18, $4E, $9B, $64, $08, $C2, $3D, $92 ;"1 COIN 1 CREDIT"
L72CF:  .byte $43, $71          ;Cq

L0_20:
L72D1:  .byte $20, $4E, $9B, $64, $B8, $46, $09, $EC ;"2 COINS 1 CREDIT"
L72D9:  .byte $4A, $1A, $C0, $00 ;J...

L0_21:
L72DD:  .byte $3D, $92, $43, $70, $B8, $40 ;"CREDITS "

L0_22:
L72E3:  .byte $20, $56, $2C, $52, $0C, $5A, $93, $62 ;"2 GAME MINIMUM"
L72EB:  .byte $CC, $40          ;.@

L0_23:
L72ED:  .byte $34, $E4, $CD, $C2, $2E, $03 ;"BONUS AT "

L1:
; placed by hand: DSTMSG.MAC:286 `L1: .BYTE 10$-L1,...`, the German message table; VGMSGT's second word ($7237) is $72F3. L0 was placed by content; L1-L3 are offset tables whose bytes depend on their own position, so by-content placement cannot see them
; [note] German.  13 offsets relative to L1, then the packed text.
; 13 message offsets, each relative to L1
L72F3:  .byte $0D, $17, $1D, $37, $4F, $67, $7D, $8B ;...7Og}.
L72FB:  .byte $91, $9D, $A9, $B5, $BB ;.....

L1_10:
L7300:  .byte $64, $D2, $3B, $2E, $C2, $6C, $5A, $4C ;"HOECHSTERGEBNIS"
L7308:  .byte $93, $6F          ;.o

L1_11:
L730A:  .byte $BD, $1A, $4C, $12, $B0, $40 ;"SPIELER "

L1_12:
L7310:  .byte $6B, $2C, $0A, $6C, $5A, $4C, $93, $6E ;"IHR ERGEBNIS IST EINES DER ZEHN BESTEN"
L7318:  .byte $0B, $6E, $C0, $52, $6C, $92, $B8, $50 ;.n.Rl..P
L7320:  .byte $4D, $82, $F2, $58, $90, $4C, $4D, $F0 ;M..X.LM.
L7328:  .byte $4C, $80          ;L.

L1_13:
L732A:  .byte $33, $70, $C2, $42, $5A, $4C, $4C, $82 ;"BITTE GEBEN SIE IHRE INITIALEN EIN"
L7332:  .byte $BB, $52, $0B, $58, $B2, $42, $6C, $9A ;.R.X.Bl.
L733A:  .byte $C3, $4A, $82, $64, $0A, $5A, $90, $00 ;.J.d.Z..

L1_14:
L7342:  .byte $F6, $6C, $09, $B2, $3B, $2E, $C1, $4C ;"ZUR BUCHSTABENWAHL ROTATE DRUECKEN"
L734A:  .byte $4C, $B6, $2B, $20, $0D, $A6, $C1, $70 ;L.+ ...p
L7352:  .byte $48, $50, $B6, $52, $3B, $D2, $90, $00 ;HP.R;...

L1_15:
L735A:  .byte $DA, $64, $90, $4C, $C9, $D8, $BE, $0A ;"WENN BUCHSTABE OK SHIELD DRUECKEN"
L7362:  .byte $32, $42, $9B, $C2, $BB, $1A, $4C, $10 ;2B....L.
L736A:  .byte $0A, $2C, $CA, $4E, $7A, $65 ;.,.Nze

L1_16:
L7370:  .byte $BE, $0A, $B6, $1E, $94, $D2, $A2, $92 ;"STARTKNOEPFE DRUECKEN"
L7378:  .byte $0A, $2C, $CA, $4E, $7A, $65 ;.,.Nze

L1_17:
L737E:  .byte $BD, $1A, $4C, $12, $92, $13 ;"SPIELENDE"

L1_18:
L7384:  .byte $18, $62, $CA, $64, $F2, $42, $20, $6E ;"1 MUENZE 2 SPIELE"
L738C:  .byte $A3, $52, $82, $40 ;.R.@

L1_19:
L7390:  .byte $18, $62, $CA, $64, $F2, $42, $18, $6E ;"1 MUENZE 1 SPIEL"
L7398:  .byte $A3, $52, $80, $00 ;.R..

L1_20:
L739C:  .byte $20, $62, $CA, $64, $F2, $64, $08, $C2 ;"2 MUENZEN 1 SPIEL"
L73A4:  .byte $BD, $1A, $4C, $00 ;..L.

L1_21:
L73A8:  .byte $7D, $92, $43, $70, $48, $40 ;"KREDITE "

L1_22:
L73AE:  .byte $5A, $60, $42, $5A, $96, $F2, $B2, $82 ;"GELDEINWURF FUER ZWEI SPIELE"
L73B6:  .byte $56, $52, $B0, $7C, $DA, $5A, $0D, $E8 ;VR.|.Z..
L73BE:  .byte $6A, $60, $48, $00 ;j`H.

L2:
; placed by hand: DSTMSG.MAC:303 `L2: .BYTE 10$-L2,...`, the French message table; VGMSGT's third word ($7239) is $73C2
; [note] French.  13 offsets relative to L2, then the packed text.
; 13 message offsets, each relative to L2
L73C2:  .byte $0D, $17, $1B, $33, $43, $59, $71, $7D ;...3CYq}
L73CA:  .byte $87, $93, $9F, $AB, $B1 ;.....

L2_10:
L73CF:  .byte $8A, $5A, $84, $12, $CD, $82, $B9, $E6 ;"MEILLEUR SCORE"
L73D7:  .byte $B2, $40          ;.@

L2_11:
L73D9:  .byte $74, $F2, $4D, $83 ;"JOUER "

L2_12:
L73DD:  .byte $D4, $F0, $B2, $42, $B9, $E6, $B2, $42 ;"VOTRE SCORE EST UN DES 10 MEILLEURS"
L73E5:  .byte $4D, $F0, $0E, $64, $0A, $12, $B8, $46 ;M..d...F
L73ED:  .byte $10, $62, $4B, $60, $82, $72, $B5, $C0 ;.bK`.r..

L2_13:
L73F5:  .byte $BE, $A8, $0A, $64, $C5, $92, $F0, $74 ;"SVP ENTREZ VOS INITIALES"
L73FD:  .byte $9D, $C2, $6C, $9A, $C3, $4A, $82, $6F ;..l..J.o

L2_14:
L7405:  .byte $A4, $F2, $BD, $D2, $F0, $6C, $9E, $0A ;"POUSSEZ ROTATE POUR VOS INITIALES"
L740D:  .byte $C2, $42, $A4, $F2, $B0, $74, $9D, $C2 ;.B...t..
L7415:  .byte $6C, $9A, $C3, $4A, $82, $6F ;l..J.o

L2_15:
L741B:  .byte $A4, $F2, $BD, $D2, $F0, $6E, $63, $52 ;"POUSSEZ SHIELD QUAND LETTRE CORRECTE"
L7423:  .byte $82, $02, $AE, $4A, $92, $02, $82, $70 ;...J...p
L742B:  .byte $C5, $92, $09, $E6, $B5, $92, $3E, $13 ;......>.

L2_16:
L7433:  .byte $2D, $28, $CF, $52, $B0, $6E, $CD, $82 ;"APPUYER SUR START"
L743B:  .byte $BE, $0A, $B6, $00 ;....

L2_17:
L743F:  .byte $53, $64, $0A, $12, $0D, $0A, $B6, $1A ;"FIN DE PARTIE"
L7447:  .byte $48, $00          ;H.

L2_18:
L7449:  .byte $18, $68, $6A, $4E, $48, $48, $0B, $A6 ;"1 PIECE 2 JOUEURS"
L7451:  .byte $CA, $72, $B5, $C0 ;.r..

L2_19:
L7455:  .byte $18, $68, $6A, $4E, $48, $46, $0B, $A6 ;"1 PIECE 1 JOUEUR"
L745D:  .byte $CA, $72, $B0, $00 ;.r..

L2_20:
L7461:  .byte $20, $68, $6A, $4E, $4D, $C2, $18, $5C ;"2 PIECES 1 JOUEUR"
L7469:  .byte $9E, $52, $CD, $80 ;.R..

L2_21:
L746D:  .byte $3D, $92, $43, $70, $B8, $40 ;"CREDITS "

L2_22:
L7473:  .byte $20, $5C, $4E, $78, $0C, $5A, $93, $62 ;"2 JEUX MINIMUM"
L747B:  .byte $CC, $40          ;.@

L3:
; placed by hand: DSTMSG.MAC:325 `L3: .BYTE 10$-L3,...`, the Spanish message table; VGMSGT's fourth word ($723B) is $747D
; [note] Spanish.  13 offsets relative to L3, then the packed text.
; 13 message offsets, each relative to L3
L747D:  .byte $0D, $13, $19, $33, $47, $61, $6B, $73 ;...3Gaks
L7485:  .byte $7D, $89, $93, $9F, $A5 ;}....

L3_10:
L748A:  .byte $B2, $4E, $9D, $90, $B8, $00 ;"RECORDS"

L3_11:
L7490:  .byte $76, $56, $2A, $26, $B0, $40 ;"JUGADOR "

L3_12:
L7496:  .byte $BE, $42, $A6, $64, $C1, $5C, $48, $52 ;"SU PUNTAJE ESTA ENTRE LOS DIEZ MEJORES"
L749E:  .byte $BE, $0A, $0A, $64, $C5, $92, $0C, $26 ;...d...&
L74A6:  .byte $B8, $50, $6A, $7C, $0C, $52, $74, $EC ;.Pj|.Rt.
L74AE:  .byte $4D, $C0          ;M.

L3_13:
L74B0:  .byte $A4, $EC, $0A, $8A, $D4, $EC, $0A, $64 ;"POR FAVOR ENTRE SUS INICIALES"
L74B8:  .byte $C5, $92, $0D, $F2, $B8, $5A, $93, $4E ;.....Z.N
L74C0:  .byte $69, $60, $4D, $C0 ;i`M.

L3_14:
L74C4:  .byte $9D, $2C, $6C, $4A, $0D, $A6, $C1, $70 ;"OPRIMA ROTATE PARA SELECCIONAR LA LETRA"
L74CC:  .byte $48, $68, $2D, $8A, $0D, $D2, $82, $4E ;Hh-....N
L74D4:  .byte $3B, $66, $91, $6C, $0C, $0A, $0C, $12 ;;f.l....
L74DC:  .byte $C5, $8B          ;..

L3_15:
L74DE:  .byte $9D, $2C, $6C, $4A, $0D, $D8, $6A, $60 ;"OPRIMA SHIELD"
L74E6:  .byte $40, $00          ;@.

L3_16:
L74E8:  .byte $A6, $60, $B9, $6C, $0D, $F0, $2D, $B1 ;"PULSAR START"

L3_17:
L74F0:  .byte $76, $52, $5C, $C2, $C2, $6C, $8B, $64 ;"JUEGO TERMINADO"
L74F8:  .byte $2A, $27          ;*'

L3_18:
L74FA:  .byte $18, $54, $69, $D8, $28, $48, $0B, $B2 ;"1 FICHA 2 JUEGOS"
L7502:  .byte $4A, $E6, $B8, $00 ;J...

L3_19:
L7506:  .byte $18, $54, $69, $D8, $28, $46, $0B, $B2 ;"1 FICHA 1 JUEGO"
L750E:  .byte $4A, $E7          ;J.

L3_20:
L7510:  .byte $20, $54, $69, $D8, $2D, $C2, $18, $5C ;"2 FICHAS 1 JUEGO"
L7518:  .byte $CA, $56, $98, $00 ;.V..

L3_21:
L751C:  .byte $3D, $92, $43, $70, $9D, $C3 ;"CREDITOS "

L3_22:
L7522:  .byte $20, $5C, $CA, $56, $2D, $C2, $8B, $64 ;"2 JUEGAS MINIMO"
L752A:  .byte $6C, $67          ;lg

BOUNCE:
; also BOUNC in the linker map
; [note] Does the shield take this collision? Bounce if so
L752C:  BIT SHDON               ;SHIELDS ON?
L752E:  BPL BOUNCE_1            ;NOPE. GO THROUGH NORMAL DESTRUCTION
L7530:  TXA
L7531:  BEQ BOUNCE_2            ;SHIP HIT SOMETHING.
L7533:  CPY #$19
L7535:  BNE BOUNCE_1            ;NOT SHIP. DO NORMAL DESTRUCTION
L7537:  ADC #$18                ;FIX ADDRESS TO BE RELATIVE TO OBJ (C=1)
L7539:  TAY                     ;KEEP IT IN Y

BOUNCE_2:
L753A:  LDA OBJ,Y               ;GET OBJECT SIZE
L753D:  CPY #$1A                ;ROCK OR TORPEDO OR SAUCER?
L753F:  BEQ BOUNCE_3            ;SAUCER
L7541:  BCC BOUNCE_6            ;ROCK
L7543:  LDA #$00                ;TORPEDO
L7545:  STA OBJ,Y               ;ABSORB TORPEDOES
L7548:  LDX #$E1                ;AT THE EXPENSE OF SOME SHIELDS

BOUNCE_14:
L754A:  PLA                     ;PURGE STACK OF RETURN ADDRESS (LAST LEVEL)
L754B:  PLA

BOUNCE_4:
L754C:  TXA
L754D:  ADC SHLDS               ;UPDATE SHIELDS
L7550:  BCS BOUNCE_5            ;STILL SOME LEFT
L7552:  LDA #$00                ;CAN'T GO MINUS
L7554:  STA SHDON               ;TURN THEM OFF FOR NEXT COLLISION

BOUNCE_5:
L7556:  STA SHLDS

BOUNCE_1:
L7559:  CLC                     ;NORMAL EXIT (SOMETIMES)
L755A:  RTS

BOUNCE_3:
L755B:  LDX #$80
L755D:  CPX SHLDS               ;GOT ENUF?
L7560:  BCC BOUNCE_7            ;YEP.
L7562:  LDX #$00                ;POINT TO SHIP
L7564:  LDY #$1A                ;POINT TO SAUCER
L7566:  CLC                     ;BLOW 'EM BOTH UP
L7567:  RTS

BOUNCE_7:
L7568:  JSR BOUNCE_4            ;($754C) UPDATE SHIELDS POWER
L756B:  SEC                     ;EXIT TO AWARD POINTS/BLOW UP SAUCER
L756C:  RTS

BOUNCE_6:
L756D:  LDX #$F8
L756F:  SEC
L7570:  ROR CHIST               ;SAY SHIP HIT ROCK
L7572:  CPY $72                 ;HIT THE SAMETHING AS LAST TIME?
L7574:  BEQ BOUNCE_14           ;YEP. DON'T BOUNCE BUT TAKE SHIELD POWER
L7576:  STY $72                 ;KEEP COLLISION HISTORY
L7578:  ASL A
L7579:  AND #$86                ;LARGE OR SPECIAL?
L757B:  STA R0                  ;SAVE CODE
L757D:  BMI BOUNCE_9            ;SPECIAL
L757F:  BEQ BOUNCE_9            ;LARGE
L7581:  LDA XINC,Y              ;CUT ROCK SPEED IN HALF
L7584:  CMP #$80                ;SET CARRY TO MATCH SIGN
L7586:  ROR A                   ;ASR
L7587:  JSR NEWVE1              ;($6A7E) RANGE IT
L758A:  STA XINC,Y
L758D:  LDA YINC,Y
L7590:  CMP #$80
L7592:  ROR A
L7593:  JSR NEWVE1              ;($6A7E) RANGE IT
L7596:  STA YINC,Y

BOUNCE_9:
L7599:  LDX #$00                ;BOUNCE OFF X
L759B:  JSR BNC                 ;($75AC)
L759E:  LDX #$21
L75A0:  TYA
L75A1:  CLC
L75A2:  ADC #$21
L75A4:  TAY
L75A5:  JSR BNC                 ;($75AC) BOUNCE OFF Y
L75A8:  LDX #$B0                ;GET SHIELDS LOSS
L75AA:  BNE BOUNCE_14           ;(ALWAYS)

BNC:
; [note] Bounce the ship off rock Y on one axis
L75AC:  STX R1                  ;SAVE X
L75AE:  LDA XINC,Y
L75B1:  BMI BNC_20
L75B3:  LDA SHPXI,X
L75B6:  BMI BNC_22
L75B8:  JSR BNC_30              ;($75F6) SHIP/ROCK BOTH MOVING RIGHT (UP)
L75BB:  BCC BNC_22              ;ROCK OVERTOOK SHIP. SET SHIP = 2*ROCK

BNC_25:
L75BD:  LDA #$00                ;SHIP OVERTOOK ROCK. SET SHIP = - ROCK
L75BF:  SEC
L75C0:  SBC XINC,Y
L75C3:  JMP BNC_26              ;($75DF) RANGE IT, STORE IT, EXIT

BNC_20:
L75C6:  LDA SHPXI,X
L75C9:  BPL BNC_22
L75CB:  JSR BNC_30              ;($75F6) SHIP/ROCK BOTH MOVING LEFT (DOWN)
L75CE:  BCC BNC_25              ;SHIP OVERTOOK ROCK. SET SHIP = - ROCK

BNC_22:
L75D0:  LDA XINC,Y              ;SHIP=2*ROCK
L75D3:  BIT R0                  ;UNLESS SPECIAL
L75D5:  BPL BNC_10              ;NOT SPECIAL
L75D7:  CMP #$80                ;SPECIAL. SHIP=1.5*ROCK
L75D9:  ROR A
L75DA:  ADC XINC,Y              ;APPROX 1,5*ROCK
L75DD:  LSR A                   ;EASY TO FALL THRU

BNC_10:
L75DE:  ROL A                   ;SHIP=2*ROCK (APPROX)

BNC_26:
L75DF:  JSR MOVE2               ;($6921) RANGE IT
L75E2:  BPL BNC_1
L75E4:  CMP #$FB                ;NOT TOO CLOSE TO 0
L75E6:  BCC BNC_2
L75E8:  LDA #$FA

BNC_1:
L75EA:  CMP #$06                ;NOT TOO CLOSE TO 0
L75EC:  BCS BNC_2
L75EE:  LDA #$06

BNC_2:
L75F0:  LDX R1                  ;RESTORE X
L75F2:  STA SHPXI,X
L75F5:  RTS

BNC_30:
L75F6:  LDA OBJXL,Y             ;DOUBLE BYTE COMPARE
L75F9:  CMP SHPXL,X
L75FC:  LDA OBJXH,Y
L75FF:  SBC SHPXH,X
L7602:  RTS                     ;C=0 IF SHIP ON RIGHT (ABOVE) ROCK

ASTM:
L7603:  .byte $1F, $C4, $09, $70, $2D, $9A, $0B, $64 ;...p-..d
L760B:  .byte $38, $00          ;8.

DASOUN:
; [note] PNTRS: 12 sounds x 8 bytes, one per POKEY register ($2C00+n; even
;        n is a channel's frequency AUDF, odd its volume/distortion AUDC).
;        Each byte is that register's envelope offset from SOUND; 0 leaves
;        the register alone.  The sound number the game loads into Y is
;        the entry's offset + 7 (SND.T1 = $07, SND.T2 = $0F, ...).  Decoded
;        row by row (sndtab.py).
L760D:  .byte $00, $00, $00, $00, $00, $00, $01, $08 ;SND.T1 ($07) thump 1: AUDF4=T16+$01, AUDC4=T17+$08
L7615:  .byte $00, $00, $00, $00, $00, $00, $0F, $08 ;SND.T2 ($0F) thump 2: AUDF4=T26+$0F, AUDC4=T17+$08
L761D:  .byte $00, $00, $00, $00, $16, $21, $00, $00 ;SND.LS ($17) little saucer: AUDF3=LS4+$16, AUDC3=LS5+$21
L7625:  .byte $00, $00, $2F, $36, $00, $00, $00, $00 ;SND.SF ($1F) saucer fire: AUDF2=SF2+$2F, AUDC2=SF3+$36
L762D:  .byte $3D, $44, $00, $00, $00, $00, $00, $00 ;SND.PF ($27) ship fire: AUDF1=PF0+$3D, AUDC1=PF1+$44
L7635:  .byte $00, $00, $00, $00, $00, $00, $4B, $52 ;SND.EL ($2F) extra life: AUDF4=EL6+$4B, AUDC4=EL7+$52
L763D:  .byte $00, $00, $00, $00, $28, $21, $00, $00 ;SND.BS ($37) big saucer: AUDF3=BS4+$28, AUDC3=LS5+$21
L7645:  .byte $00, $00, $5D, $64, $00, $00, $00, $00 ;SND.DI ($3F) diamond zapped: AUDF2=DI2+$5D, AUDC2=DI3+$64
L764D:  .byte $00, $00, $00, $00, $6F, $7A, $85, $7A ;SND.BL ($47) ship back to life: AUDF3=BL4+$6F, AUDC3=BL5+$7A, AUDF4=BL6+$85, AUDC4=BL5+$7A
L7655:  .byte $90, $A5, $00, $00, $00, $00, $90, $B6 ;SND.HT ($4F) on the high score table: AUDF1=HT0+$90, AUDC1=HT1+$A5, AUDF4=HT0+$90, AUDC4=HT7+$B6
L765D:  .byte $D3, $DE, $00, $00, $00, $00, $00, $00 ;SND.S ($57) shields: AUDF1=S0+$D3, AUDC1=S1+$DE
L7665:  .byte $00, $00, $00, $00, $00, $00, $C1, $CC ;SND.DS ($5F) death star appearance: AUDF4=DS6+$C1, AUDC4=DS7+$CC

SOUND:
; [note] The envelopes.  A sequence is a macro count (1-127; 127 repeats
;        for as long as the sound is allowed to run) then 4-byte steps
;        FCNT,START,CHNG,TOT - every FCNT NMIs add CHNG, TOT times, from
;        START - a 0 ending the repeated group, and 0,0 ending the
;        sequence (the source's REP / STB / SEND / MEND).  CSOUND reads
;        SOUND..SOUND+3,Y.  Decoded row by row (sndtab.py); every step
;        checked against DASOUN.MAC.
L766D:  .byte $00, $01, $04, $E0, $03, $05 ;SOUND: offset 0, a register with POINT 0 is free
L7673:  .byte $00, $00          ;end of T16
L7675:  .byte $01               ;T17: repeat 1
L7676:  .byte $04, $A8, $FF, $05 ;every 4 NMIs add -1, 5 times, from $A8
L767A:  .byte $00, $00          ;end of T17
L767C:  .byte $01               ;T26: repeat 1
L767D:  .byte $04, $D0, $03, $05 ;every 4 NMIs add 3, 5 times, from $D0
L7681:  .byte $00, $00          ;end of T26
L7683:  .byte $7F               ;LS4: repeat 127 (for the whole sound)
L7684:  .byte $01, $04, $01, $10 ;every 1 NMI add 1, 16 times, from $04
L7688:  .byte $01, $14, $FF, $10 ;every 1 NMI add -1, 16 times, from $14
L768C:  .byte $00, $00          ;end of LS4
L768E:  .byte $7F               ;LS5: repeat 127 (for the whole sound)
L768F:  .byte $20, $A2, $00, $01 ;every 32 NMIs add 0, 1 time, from $A2
L7693:  .byte $00, $00          ;end of LS5
L7695:  .byte $7F               ;BS4: repeat 127 (for the whole sound)
L7696:  .byte $01, $10, $01, $20 ;every 1 NMI add 1, 32 times, from $10
L769A:  .byte $00, $00          ;end of BS4
L769C:  .byte $01               ;SF2: repeat 1
L769D:  .byte $02, $0C, $01, $18 ;every 2 NMIs add 1, 24 times, from $0C
L76A1:  .byte $00, $00          ;end of SF2
L76A3:  .byte $01               ;SF3: repeat 1
L76A4:  .byte $10, $A4, $FF, $03 ;every 16 NMIs add -1, 3 times, from $A4
L76A8:  .byte $00, $00          ;end of SF3
L76AA:  .byte $01               ;PF0: repeat 1
L76AB:  .byte $01, $04, $01, $40 ;every 1 NMI add 1, 64 times, from $04
L76AF:  .byte $00, $00          ;end of PF0
L76B1:  .byte $01               ;PF1: repeat 1
L76B2:  .byte $10, $A4, $FF, $04 ;every 16 NMIs add -1, 4 times, from $A4
L76B6:  .byte $00, $00          ;end of PF1
L76B8:  .byte $01               ;EL6: repeat 1
L76B9:  .byte $F0, $06, $00, $02 ;every 240 NMIs add 0, 2 times, from $06
L76BD:  .byte $00, $00          ;end of EL6
L76BF:  .byte $0F               ;EL7: repeat 15
L76C0:  .byte $10, $A8, $00, $01 ;every 16 NMIs add 0, 1 time, from $A8
L76C4:  .byte $10, $A0, $00, $01 ;every 16 NMIs add 0, 1 time, from $A0
L76C8:  .byte $00, $00          ;end of EL7
L76CA:  .byte $01               ;DI2: repeat 1
L76CB:  .byte $02, $50, $01, $70 ;every 2 NMIs add 1, 112 times, from $50
L76CF:  .byte $00, $00          ;end of DI2
L76D1:  .byte $07               ;DI3: repeat 7
L76D2:  .byte $10, $A8, $00, $01 ;every 16 NMIs add 0, 1 time, from $A8
L76D6:  .byte $10, $A0, $00, $01 ;every 16 NMIs add 0, 1 time, from $A0
L76DA:  .byte $00, $00          ;end of DI3
L76DC:  .byte $0C               ;BL4: repeat 12
L76DD:  .byte $02, $0A, $01, $03 ;every 2 NMIs add 1, 3 times, from $0A
L76E1:  .byte $04, $0C, $FF, $02 ;every 4 NMIs add -1, 2 times, from $0C
L76E5:  .byte $00, $00          ;end of BL4
L76E7:  .byte $01               ;BL5: repeat 1
L76E8:  .byte $18, $A0, $01, $05 ;every 24 NMIs add 1, 5 times, from $A0
L76EC:  .byte $18, $A5, $FF, $05 ;every 24 NMIs add -1, 5 times, from $A5
L76F0:  .byte $00, $00          ;end of BL5
L76F2:  .byte $18               ;BL6: repeat 24
L76F3:  .byte $02, $0A, $01, $02 ;every 2 NMIs add 1, 2 times, from $0A
L76F7:  .byte $02, $0B, $00, $02 ;every 2 NMIs add 0, 2 times, from $0B
L76FB:  .byte $00, $00          ;end of BL6
L76FD:  .byte $10               ;HT0: repeat 16
L76FE:  .byte $0C, $21, $00, $01 ;every 12 NMIs add 0, 1 time, from $21
L7702:  .byte $0C, $18, $00, $01 ;every 12 NMIs add 0, 1 time, from $18
L7706:  .byte $00               ;end of the repeated group
L7707:  .byte $01               ;repeat 1
L7708:  .byte $02, $20, $10, $FF ;every 2 NMIs add 16, 255 times, from $20
L770C:  .byte $04, $30, $02, $30 ;every 4 NMIs add 2, 48 times, from $30
L7710:  .byte $00, $00          ;end of HT0
L7712:  .byte $01               ;HT1: repeat 1
L7713:  .byte $30, $21, $01, $08 ;every 48 NMIs add 1, 8 times, from $21
L7717:  .byte $00               ;end of the repeated group
L7718:  .byte $01               ;repeat 1
L7719:  .byte $80, $84, $01, $04 ;every 128 NMIs add 1, 4 times, from $84
L771D:  .byte $30, $85, $FF, $04 ;every 48 NMIs add -1, 4 times, from $85
L7721:  .byte $00, $00          ;end of HT1
L7723:  .byte $04               ;HT7: repeat 4
L7724:  .byte $18, $A5, $FF, $04 ;every 24 NMIs add -1, 4 times, from $A5
L7728:  .byte $18, $A1, $01, $04 ;every 24 NMIs add 1, 4 times, from $A1
L772C:  .byte $00, $00          ;end of HT7
L772E:  .byte $10               ;DS6: repeat 16
L772F:  .byte $0C, $49, $00, $01 ;every 12 NMIs add 0, 1 time, from $49
L7733:  .byte $0C, $30, $00, $01 ;every 12 NMIs add 0, 1 time, from $30
L7737:  .byte $00, $00          ;end of DS6
L7739:  .byte $02               ;DS7: repeat 2
L773A:  .byte $C0, $A4, $00, $01 ;every 192 NMIs add 0, 1 time, from $A4
L773E:  .byte $00, $00          ;end of DS7
L7740:  .byte $01               ;S0: repeat 1
L7741:  .byte $01, $F0, $01, $0F ;every 1 NMI add 1, 15 times, from $F0
L7745:  .byte $01, $FF, $FF, $0F ;every 1 NMI add -1, 15 times, from $FF
L7749:  .byte $00, $00          ;end of S0
L774B:  .byte $01               ;S1: repeat 1
L774C:  .byte $1F, $A2, $00, $01 ;every 31 NMIs add 0, 1 time, from $A2
L7750:  .byte $00, $00          ;end of S1

;-----------------------------------------[ SOUND STARTER ]-----------------------------------------

SNDOFF:
; [note] Silence sound Y
L7752:  BIT SNDOO_1             ;SEV (1$=RTS=60)
L7755:  CLC                     ;(THIS MAKES IT EASY LATER)
L7756:  BCC SNDOO_4             ;(ALWAYS)

SNDPON:
; [note] Start sound Y, but only on idle channels
L7758:  SEC                     ;TURN ON SOUND WITH PRIORITY
L7759:  BCS SNDOO               ;(ALWAYS)

SNDON:
; [note] Start sound Y, taking its channels over
L775B:  CLC                     ;TURN ON SOUND

SNDOO:
; [note] SNDON/SNDPON's shared body; C = priority
L775C:  LDA NPLAYR              ;ATTRACT MODE?
L775E:  BEQ SNDOFF              ;YEP. TURN SOUNDS OFF INSTEAD
L7760:  CLV                     ;BE SURE THE V FLAG IS OFF

SNDOO_4:
; [note] Walk the eight POKEY registers, X = 7 down to 0, with Y on the
;        sound's PNTRS entry, last byte first (Y arrives as offset + 7).
L7761:  TXA                     ;SAVE X
L7762:  PHA
L7763:  LDX #$07                ;LOOP COUNTER

SNDOO_3:
; [note] Without priority (C clear) a register whose POINT is busy is left alone.
L7765:  BCC SNDOO_5             ;GO TURN IT ON
L7767:  LDA POINT,X             ;CHANNEL BUSY?
L7769:  BNE SNDOO_6             ;YEP. LEAVE IT ALONE THEN

SNDOO_5:
; [note] This register's sequence offset from PNTRS; 0 means the sound does
;        not use it.  V set (SNDOFF) substitutes 0.
L776B:  LDA DASOUN,Y            ;GET OFFSET
L776E:  BEQ SNDOO_6             ;NONE. LEAVE CHANNEL
L7770:  BVC SNDOO_7             ;NOT TO TURN OFF SOUND
L7772:  LDA #$00                ;TURN SOUND OFF

SNDOO_7:
; [note] Hand the register to CSOUND in the order the running NMI needs:
;        POINT = 0 stops whatever was playing, MCOUNT = $80 flags a start,
;        then POINT = the offset.  CSOUND takes it from there.
L7774:  PHA                     ;NMI'S ARE RUNNING SO WE HAVE TO DO THE TURN ON
L7775:  LDA #$00                ;IN A SPECIFIC ORDER. FIRST WE TURN OFF ANY
L7777:  STA POINT,X             ;SOUNDS BY ZAPPING POINT. THEN WE SET 'MCOUNT'
L7779:  LDA #$80                ;TO '80' TO SIGNAL CSOUND TO START A SOUND.
L777B:  STA MCOUNT,X            ;'MCOUNT' IS NOT DISTURBED UNLESS POINT IS
L777D:  PLA                     ;NOT ZERO. LASTLY WE SET POINT TO THE
L777E:  STA POINT,X             ;REQUIRED OFFSET. CSOUND TAKES OVER

SNDOO_6:
; FROM HERE
; [note] Next register.
L7780:  DEY                     ;COUNT
L7781:  DEX                     ;COUNT
L7782:  BPL SNDOO_3             ;CONTINUE
L7784:  PLA                     ;RESTORE X AND EXIT
L7785:  TAX

SNDOO_1:
; [note] Shared return; SNDOFF also BITs this $60 to set V.
L7786:  RTS

;-----------------------------------------[ SOUND ROUTINE ]-----------------------------------------

CSOUND:
; [note] Step all eight sound channels; once per NMI
L7787:  LDX #$07                ;8 ITEMS

CSOUND_4:
; [note] Per register: idle if POINT is 0.  MCOUNT bit 7 means a sound was
;        just requested - go start it.  Otherwise count FRAMES down; at 0,
;        count COUNT down; at 0 the step is done, else CURRENT += CHNG.
L7789:  LDY POINT,X             ;ANY SOUND?
L778B:  BEQ CSOUND_6            ;NO
L778D:  LDA MCOUNT,X            ;ARE WE TO START ONE?
L778F:  BMI CSOUND_11           ;YES. GO START IT
L7791:  DEC FRAMES,X            ;COUNT DOWN TIMER
L7793:  BNE CSOUND_1            ;CONTINUE
L7795:  DEC COUNT,X             ;COUNT DOWN TOTAL COUNTER
L7797:  BEQ CSOUND_2            ;DONE
L7799:  LDA CURRENT,X           ;CHANGE SOUND
L779B:  CLC
L779C:  ADC SOUND+2,Y           ;BY ADDING CHANGE CODE
L779F:  JMP CSOUND_5            ;($77B0)

CSOUND_2:
; [note] Step done: Y += 4 to the next STB group.
L77A2:  INY                     ;Y=Y+4
L77A3:  INY
L77A4:  INY
L77A5:  INY

CSOUND_7:
; [note] Load a step: POINT = Y, COUNT = TOT (SOUND+3,Y), CURRENT = START
;        (SOUND+1,Y).
L77A6:  STY POINT,X
L77A8:  LDA SOUND+3,Y
L77AB:  STA COUNT,X             ;RESET TOTAL COUNTER
L77AD:  LDA SOUND+1,Y

CSOUND_5:
; [note] Store the value, reload FRAMES = FCNT (SOUND,Y).  FCNT 0 is the
;        group terminator: rewind Y to MPNTR and repeat while MCOUNT lasts,
;        else step past the 0 to the next macro count (CSOUND_11).
L77B0:  STA CURRENT,X           ;RESET VALUE
L77B2:  LDA SOUND,Y
L77B5:  STA FRAMES,X            ;RESET TIMER
L77B7:  BNE CSOUND_1            ;CONTINUE
L77B9:  LDY MPNTR,X             ;SET UP Y IN CASE OF RESTART
L77BB:  DEC MCOUNT,X            ;MACRO COUNT
L77BD:  BNE CSOUND_7            ;RESTART
L77BF:  LDY POINT,X
L77C1:  INY                     ;SKIP OVER TERM
L77C2:  BNE CSOUND_11           ;(ALWAYS)

CSOUND_10:
; [note] Macro count 0: the sound is over.  Y = 0 goes into POINT and CURRENT.
L77C4:  TAY                     ;THIS MAKES AN EASY EXIT

CSOUND_8:
; [note] Free the register (POINT = 0).
L77C5:  STY POINT,X             ;ZAP THE POINTER

CSOUND_6:
; [note] Silence it (CURRENT = 0), then write it out.
L77C7:  STY CURRENT,X           ;ZAP SOUND TOO

CSOUND_1:
; [note] Write CURRENT to POKEY register X; next register; exit after 0.
L77C9:  LDA CURRENT,X           ;GET SOUND
L77CB:  STA POKEY,X             ;WRITE TO POKEY
L77CE:  DEX                     ;COUNT
L77CF:  BPL CSOUND_4
L77D1:  RTS                     ;EXIT (FALL THUR TO IDCYC)

CSOUND_11:
; [note] Start, or continue with the next macro: the count at POINT; 0 ends.
L77D2:  LDA SOUND,Y             ;GET COUNT
L77D5:  BEQ CSOUND_10           ;END

CSOUND_9:
; [note] MCOUNT = the count, MPNTR = the first step (for repeats), load it.
L77D7:  STA MCOUNT,X
L77D9:  INY                     ;SKIP UP TO SOUND
L77DA:  STY MPNTR,X             ;SAVE POINTER
L77DC:  BNE CSOUND_7            ;(ALWAYS)

RADDR:
L77DE:  .byte $01, $E0, $C0, $E1 ;....

ROCKSA:
L77E2:  .byte $E5, $C3, $CA, $C3, $AF, $C3, $94, $C3 ;........

MODULO:
L77EA:  .byte $7F, $02, $04, $04, $05, $03, $7F, $7F ;........

FILL:
L77F2:  .byte $69, $15, $60     ;i.`

;----------------------------------------[ COPYRIGHT STUFF ]----------------------------------------

VGRCPT:
; also ASTMTS in the linker map
; [note] The copyright check: compare the display list against the expected bytes
L77F5:  BIT CPMTST              ;SHOULD WE TEST?
L77F7:  BPL VGRCPT_3            ;NO

VGRCPT_1:
L77F9:  LDA VGLIST              ;SAVE VGLIST
L77FB:  PHA
L77FC:  LDA $04
L77FE:  PHA
L77FF:  LDA #$47
L7801:  STA $04
L7803:  LDA #$02
L7805:  STA VGLIST
L7807:  LDX #$C9
L7809:  LDY #$00
L780B:  LDA #$C1
L780D:  JSR CPR_UP              ;($7835) FIX IT
L7810:  TXA
L7811:  JSR CPR_UP              ;($7835)
L7814:  LDX #$07

VGRCPT_2:
L7816:  LDA CPR_DT,X            ;GET LIST
L7819:  JSR CPR_UP              ;($7835) UPDATE ERROR FLAG
L781C:  DEX                     ;COUNT
L781D:  BPL VGRCPT_2
L781F:  DEY                     ;Y-1
L7820:  JSR VGADD               ;($7A67) ADD Y+1 TO VGLIST
L7823:  LDA #$45                ;SET UP TEMP1,TEMP1+1
L7825:  STA TEMP1
L7827:  LDA #$78
L7829:  STA $0A
L782B:  JSR ASTMSG_2            ;($71BD) CHECK MESSAGE
L782E:  PLA
L782F:  STA $04                 ;RESTORE VGLIST
L7831:  PLA
L7832:  STA VGLIST

VGRCPT_3:
L7834:  RTS                     ;EXIT

CPR_UP:
; [note] Fold one expected byte into the copyright error flag
L7835:  EOR (VGLIST),Y
L7837:  ORA CRMERR
L7839:  STA CRMERR
L783B:  INY
L783C:  RTS

CPR_DT:
L783D:  .byte $00, $00, $70, $00, $01, $C0, $A0, $80 ;..p.....

ASTMT:
L7845:  .byte $1F, $C4, $09, $70, $2D, $9A, $0B, $64 ;...p-..d
L784D:  .byte $38, $00          ;8.

INISOU:
; also ST1 in the linker map
; placed by hand: DASOUN.MAC:423 `INISOU:: LDA I,0 / LDX #7 / 1$: STA X,POINT / DEX / BPL 1$ / STA AUDCTL`. Linked into the DSTNMI region, away from the rest of DASOUN, so the in-module order check rejects it. ST1 is the linker map's name for the address and is kept as the alias
L784F:  LDA #$00
L7851:  LDX #$07

INISOU_1:
; placed by hand: DASOUN.MAC:425 `1$: STA X,POINT`, the clear loop
L7853:  STA POINT,X
L7855:  DEX
L7856:  BPL INISOU_1
L7858:  STA OPTN5
L785B:  RTS

;------------------------------------[ NMI - INTERRUPT ROUTINE ]------------------------------------

NMI:
; also DSTNMI in the linker map
; [note] The interrupt, every 4 ms: switches, coins, sound, POKEY
L785C:  BIT $01FF               ;POWER UP SELF-TEST?
L785F:  BPL NMI_100
L7861:  RTI

NMI_100:
L7862:  PHA                     ;SAVE MACHINE
L7863:  TYA
L7864:  PHA
L7865:  TXA
L7866:  PHA
L7867:  CLD
L7868:  LDA $01FF               ;STACK OVERFLOW
L786B:  ORA $01D0               ;STACK UNDERFLOW

NMI_2:
L786E:  BNE NMI_2               ;OOPS - STACK ERROR
L7870:  INC INTCT               ;ANOTHER INTERRUPT
L7872:  LDA INTCT
L7874:  AND #$03                ;16 MS
L7876:  BNE NMI_10
L7878:  INC SYNC                ;MAIN LINE SYNC UP (16 MS)
L787A:  LDA SYNC
L787C:  CMP #$03                ;ARE WE OK?
L787E:  BCC NMI_10              ;OK

NMI_HANG:
; placed by hand: DSTNMI.MAC:90 `BNE .  ;PROGRAM WHERE ARE YOU?`. The source branches to itself without a label; NAMED here. Reached when the main line misses two SYNC ticks, and spins until the watchdog resets the board
L7880:  BNE NMI_HANG            ;PROGRAM WHERE ARE YOU?

NMI_127:
L7882:  STA VGRESET             ;STOP VG IN CASE ITS HUNG

NMI_10:
L7885:  LDX NPLAYR
L7887:  BNE NMI_3               ;GAME TIME
L7889:  LDA UPDFLG              ;UPDATING INITIALS?
L788B:  AND $43
L788D:  BPL NMI_3               ;YEP. STILL HAVE SOUNDS
L788F:  STX $2C0F               ;RESET POKEY
L7892:  LDX #$04

NMI_11:
L7894:  DEX                     ;WASTE TIME
L7895:  BNE NMI_11
L7897:  LDX #$07
L7899:  STX $2C0F               ;REENABLE POKY
L789C:  STX $2C0B               ;START POTS
L789F:  LDA OPTN5               ;READ OPTION SWITCH
L78A2:  EOR #$FF
L78A4:  STA CMODE               ;KEEP THEM

NMI_3:
L78A6:  JSR CSOUND              ;($7787) DO SOUNDS

;------------------------------------------[ DETECT COIN ]------------------------------------------

MOOLAH:
; INSTRUCTIONS IN BRACKETS( "[" AND "]" ) ARE FOR ILLUSTRATION ONLY, AND ARE NOT
; ACTUALLY ASSEMBLED.
L78A9:  LDX #$02                ;X IS USED TO INDEX FROM RIGHT TO LEFT COIN MECH

DETCT:
; [note] Debounce one coin mech
L78AB:  LDA COINA,X
L78AE:  ASL A
L78AF:  LDA CNSTT,X
L78B1:  AND #$1F                ;SHARED INST. SEE BELOW IN BRACKETS []
L78B3:  BCC DETCT_5             ;BRANCH IF INPUT LOW (COIN ABSENT)
L78B5:  BEQ DETCT_1             ;STICK AT 0 (TERMINAL COUNT)
L78B7:  CMP #$1B                ;IN FIRST FIVE SAMPLES?
L78B9:  BCS DETCT_10            ;YES, RUN FAST
L78BB:  TAY                     ;ELSE SAVE STATUS
L78BC:  LDA INTCT               ;CHECK INTERUPT CTR
L78BE:  AND #$07                ;ARE D0-D2 ALL ONES?
L78C0:  CMP #$07                ;SET CARRY IF SO
L78C2:  TYA                     ;STATUS BACK INTO ACC
L78C3:  BCC DETCT_1             ;SKIP IF NOT ALL ONES

DETCT_10:
; [AND I,31.]             ISOLATE COIN-ON DOWN-COUNTER, RESET COIN-OFF UP-CTR.
L78C5:  SBC #$01                ;CARRY SET

DETCT_1:
L78C7:  STA CNSTT,X             ;SAVE UPDATED STATUS
L78C9:  LDA LAM                 ;CHECK SLAM SWITCH
L78CC:  AND #$80
L78CE:  BEQ DETCT_2             ;BRANCH IF BIT LO (SWITCH OFF)
L78D0:  LDA #$F0                ;ELSE SET PRE-COIN SLAM TIMER
L78D2:  STA LMTIM               ;DECR. 8 TIMES/FRAME=PRST FRAMES

DETCT_2:
L78D4:  LDA LMTIM               ;CHECK PRE-COIN SLAM TIMER
L78D6:  BEQ DETCT_3             ;O.K.
L78D8:  DEC LMTIM               ;ELSE RUN TIMER
L78DA:  LDA #$00
L78DC:  STA CNSTT,X             ;CLEAR COIN STATUS
L78DE:  STA PSTSL,X             ;CLEAR POST-COIN SLAM-TIMER

DETCT_3:
L78E0:  CLC                     ;DEFAULT "NO COIN DETECTED"
L78E1:  LDA PSTSL,X             ;CHECK POST-COIN SLAM-TIMER
L78E3:  BEQ DETCT_8             ;EMPTY, PROCEED
L78E5:  DEC PSTSL,X             ;RUN TIMER
L78E7:  BNE DETCT_8             ;NOT DONE, PROCEED
L78E9:  SEC                     ;WHEN IT BECOMES ZERO, INDICATE A COIN
L78EA:  BCS DETCT_8             ;(ALWAYS)

DETCT_5:
L78EC:  CMP #$1B                ;IS COIN VALID YET (ON FOR >4 SAMPLES)
L78EE:  BCS DETCT_6             ;NO, RESET IT
L78F0:  LDA CNSTT,X             ;GET STATUS AGAIN
L78F2:  ADC #$20                ;BUMP COIN-OFF UP-CTR.
L78F4:  BCC DETCT_1             ;IF IT DIDN'T WRAP, JUST STORE STATUS
L78F6:  BEQ DETCT_6             ;IT WRAPPED BUT COIN WAS ON TOO LONG, JUST RESET
L78F8:  CLC                     ;SET "VALIDITY" AGAIN

DETCT_6:
L78F9:  LDA #$1F                ;RESET DOWN-COUNTER
L78FB:  BCS DETCT_1             ;BRANCH IF COIN TOO LONG OR TOO SHORT
L78FD:  STA CNSTT,X             ;SAVE RESET STATUS
L78FF:  LDA PSTSL,X             ;CHECK HOWIES ASSUMPTION
L7901:  BEQ DETCT_7             ;BRANCH IF $PSTSL VACANT
L7903:  SEC                     ;ELSE GIVE CREDIT A LITTLE EARLY

DETCT_7:
; [CLC]                   DEFAULT TO "NO COIN" (CARRY IS ALREADY CLEAR)
L7904:  LDA #$78                ;/(4 COUNTS/FRAME)="POST" FRAMES
L7906:  STA PSTSL,X             ;DELAY ACCEPTANCE FOR POST/60 SEC.

DETCT_8:
L7908:  BCC DETCT_9
L790A:  LDA #$00                ;START WITH 0 (TO ADD 1)
L790C:  CPX #$01                ;CHECK WHICH MECH
L790E:  BCC DETCT_85            ;IF LEFT, ALWAYS ADD 1
L7910:  BEQ DETCT_83            ;IF CENTER, CHECK HALF-MUL
L7912:  LDA CMODE               ;GET DOLLAR MUL
L7914:  AND #$0C
L7916:  LSR A
L7917:  LSR A
L7918:  BEQ DETCT_85            ;00-ADD 1
L791A:  ADC #$02                ;ELSE MAP 1,2,3 TO 3,4,5
L791C:  BNE DETCT_85            ;(ALWAYS)

;---------------------------------------[ MECH-MULTIPLIERS ]----------------------------------------

DETCT_83:
L791E:  LDA CMODE               ;GET COIN MODE FROM ZERO-PAGE
L7920:  AND #$10                ;ISOLATE HALF-MULTIPLIER
L7922:  BEQ DETCT_85
L7924:  LDA #$01

DETCT_85:
; ACC=0 FOR 1 "UNIT" ,<>0 FOR 2 "UNITS" PER MIDDLE-MECH COIN.
; Z FLAG SET PER ACC.  CARRY IS DON'T CARE
L7926:  SEC
L7927:  PHA
L7928:  ADC BCCNT               ;UPDATE BONUS-ADDER COUNTER
L792A:  STA BCCNT
L792C:  PLA
L792D:  SEC
L792E:  ADC CNCT
L7930:  STA CNCT
L7932:  INC CCTIM,X             ;"QUEUE" PULSE FOR E.M. COUNTER

DETCT_9:
; ###NOTE:  THIS CODE PROVIDED ONLY FOR OLD AMERICAN GAMES. USE WITH 5 DM
; MECHS IS STRONGLY DISCOURAGED
; FALL THROUGH TO BUMP $CNCT
L7934:  DEX
L7935:  BMI BONUS
L7937:  JMP DETCT               ;($78AB)

;------------------------------------------[ BONUS-ADDER ]------------------------------------------

BONUS:
; FALL THRU TO BONUS-ADDER
L793A:  LDA CMODE               ;GET BONUS ADDER MODE
L793C:  LSR A
L793D:  LSR A
L793E:  LSR A
L793F:  LSR A
L7940:  LSR A                   ;ISOLATE BONUS-ADDER MODE IN BITS 0-2
L7941:  TAY
L7942:  LDA BCCNT
L7944:  SEC
L7945:  SBC MODULO,Y            ;SEE IF ENOUGH UNIT-COINS HAVE ACCUMULATED
L7948:  BMI CNVRT               ;BRANCH IF NOT
L794A:  STA BCCNT               ;ELSE UPDATE BONUS-ADDER AND...
L794C:  INC BC                  ;GIVE ONE OR TWO BONUS UNIT-COINS
L794E:  CPY #$03
L7950:  BNE CNVRT
L7952:  INC BC                  ;MODE 3 YIELDS 2 BONUS COINS FOR 4 INSERTED

CNVRT:
; placed by hand: DCIN65.MAC:585 `$CNVRT: GCM`, coins to credits. $EXTB (DCIN65.MAC:579), the bonus adder's exit, is the same address
L7954:  LDA CMODE
L7956:  AND #$03
L7958:  TAY
L7959:  BEQ CNVRT_2
L795B:  LSR A
L795C:  ADC #$00
L795E:  EOR #$FF
L7960:  SEC
L7961:  ADC CNCT
L7963:  BCS CNVRT_33
L7965:  ADC BC
L7967:  BMI EXT
L7969:  STA BC
L796B:  LDA #$00

CNVRT_33:
; placed by hand: DCIN65.MAC:602 `33$:  ;GENERATE CREDITS: 1 OR 2`
L796D:  CPY #$02
L796F:  BCS CNVRT_1
L7971:  INC CRDT

CNVRT_1:
; placed by hand: DCIN65.MAC:606 `1$: INC $$CRDT`
L7973:  INC CRDT

CNVRT_2:
; placed by hand: DCIN65.MAC:607 `2$: STA $CNCT  ;UPDAT COINCT`
L7975:  STA CNCT

EXT:
; [note] Pulse the coin counters
L7977:  LDA INTCT               ;GET $INTCT
L7979:  LSR A                   ;USE LSB FOR PULSE=4 FRAMES
L797A:  BCS COINC
L797C:  LDY #$00                ;START WITH FLAG OF 0
L797E:  LDX #$02

;--------------------------------------[ ELECTRO-MECH. CTRS ]---------------------------------------

EXT_1:
; FALL THROUGH TO HANDLE E.M. COUNTERS
L7980:  LDA CCTIM,X             ;CHECK TIMER(X)
L7982:  BEQ EXT_3               ;NEITHER RUNNING NOR PENDING
L7984:  CMP #$10                ;IS IT RUNNING
L7986:  BCC EXT_3               ;NO, SKIP
L7988:  ADC #$EF                ;ELSE DEC 4 MSB
L798A:  INY                     ;SET ON FLAG

EXT_2:
L798B:  STA CCTIM,X

EXT_3:
L798D:  DEX
L798E:  BPL EXT_1
L7990:  TYA                     ;CHECK "ON" FLAG
L7991:  BNE COINC               ;SKIP IF ANY ON
L7993:  LDX #$02

EXT_4:
; IF NONE OF THE COUNTERS ARE CURRENTLY ON, WE CHECK TO SEE IF ANY CAN BE
; STARTED.
L7995:  LDA CCTIM,X             ;NEED WE START THIS ONE
L7997:  BEQ EXT_5               ;NO, NO COUNTS PENDING
L7999:  CLC
L799A:  ADC #$EF                ;SET 4 MSB, DEC 4 LSB
L799C:  STA CCTIM,X             ;START TIMER
L799E:  BMI COINC               ;EXIT, SO WE DON'T START MORE

EXT_5:
L79A0:  DEX
L79A1:  BPL EXT_4

COINC:
; [note] Drive the coin outputs and return from the interrupt
L79A3:  LDA CCTIM               ;LEFT MECH
L79A5:  STA CCLFT
L79A8:  LDA $98                 ;MIDDLE
L79AA:  STA CCMID
L79AD:  LDA $99
L79AF:  STA CCRIT               ;RIGHT
L79B2:  LDA CKERR               ;ANY CHECKSUM ERRORS?
L79B4:  BEQ COINC_17            ;NOPE
L79B6:  LDA HOLE                ;TIME TO ZAP THE PROGRAM?
L79B8:  BEQ COINC_17            ;NOPE
L79BA:  LDA NPLAYR              ;ATTRACT MODE?
L79BC:  BEQ COINC_17            ;YEP. DON'T DO ANYTHING
L79BE:  TSX                     ;GET THE PSB
L79BF:  LDA $0104,X
L79C2:  ORA #$08                ;SED
L79C4:  STA $0104,X

COINC_17:
L79C7:  LDA LOUT1               ;LAMP CONTROL
L79C9:  EOR #$03
L79CB:  ROR A
L79CC:  ROR A
L79CD:  STA SLMP1               ;LAMP 1
L79D0:  ROR A
L79D1:  STA SLMP2               ;LAMP 2
L79D4:  LDA LMTIM
L79D6:  BEQ COINC_16            ;TURN TONE ON IF SLAM DETECTED
L79D8:  LDA #$08
L79DA:  LDY #$AF
L79DC:  STA POKEY
L79DF:  STY $2C01

COINC_16:
L79E2:  PLA
L79E3:  TAX
L79E4:  PLA
L79E5:  TAY
L79E6:  PLA

COINC_1:
L79E7:  RTI

;-------------------------------[ VGRTSL - ADD RTSL TO VECTOR LIST ]--------------------------------

VGRTSL:
; also DSTCUT in the linker map
; [note] Append RTSL to the display list
L79E8:  LDA #$D0                ;DXXX IS RTSL
L79EA:  BNE VGHAL1

;-------------------------------[ VGHALT - ADD HALT TO VECTOR LIST ]--------------------------------

VGHALT:
; [note] Append HALT to the display list
L79EC:  LDA #$B0                ;BXXX IS HALT

VGHAL1:
; [note] Store the word in A twice and advance (VGHALT/VGRTSL tail)
L79EE:  LDY #$00
L79F0:  STA (VGLIST),Y
L79F2:  INY
L79F3:  STA (VGLIST),Y
L79F5:  BNE VGADD               ;UPDATE VECTOR LIST

VGHEXZ:
; [note] Append a hex digit with leading-zero suppression
L79F7:  BCC VGHEX               ;IF NO ZERO SUPPRESSION
L79F9:  AND #$0F
L79FB:  BEQ VGHEX1              ;LEAVE C SET

;-------------------------------------[ VGHEX - DISPLAY DIGIT ]-------------------------------------

VGHEX:
; [note] Append one hex digit
L79FD:  AND #$0F
L79FF:  CLC
L7A00:  ADC #$01                ;CLEARS C BIT

VGHEX1:
; [note] VGHEX/VGHEXZ tail: append glyph A
L7A02:  PHP                     ;SAVE C FLAG
L7A03:  ASL A                   ;*2
L7A04:  TAY
L7A05:  JSR VGCHAR              ;($7A0A) UNPACK CHAR
L7A08:  PLP                     ;RESTORE C FLAG
L7A09:  RTS

;-----------------------------------[ VGCHAR - DISLAY CHARACTER ]-----------------------------------

VGCHAR:
; AT ENTRY:
; (Y)=INDEX OF CHARACTER*2
; USES A,X,Y UPDATES (VGLIST)
L7A0A:  CPY #$4A                ;LEGAL?
L7A0C:  BCC VGCHAR_1            ;YES
L7A0E:  LDY #$00                ;NO

VGCHAR_1:
L7A10:  LDX VGMSGA+1,Y          ;GET JSRL
L7A13:  LDA VGMSGA,Y
L7A16:  JMP VGADD2              ;($7CCC)

;-------------------------------[ VGJMPL - ADD JMPL TO VECTOR LIST ]--------------------------------

VGJMPL:
; [note] Append a JMPL to the display list (unused by the shipped ROM)
L7A19:  LSR A
L7A1A:  AND #$0F                ;BASE ADDRESS IS RELATIVE TO ZERO
L7A1C:  ORA #$E0

VGJMP1:
; [note] Store the JSRL/JMPL word and advance
L7A1E:  LDY #$01
L7A20:  STA (VGLIST),Y
L7A22:  DEY
L7A23:  TXA
L7A24:  ROR A
L7A25:  STA (VGLIST),Y          ;SAVE MSB + OPCODE
L7A27:  INY
L7A28:  BNE VGADD               ;UPDATE VECTOR POINTER

;-------------------------------[ VGJSRL - ADD JSRL TO VECTOR LIST ]--------------------------------

VGJSRL:
; [note] Append a JSRL to a shape
L7A2A:  LSR A
L7A2B:  AND #$0F                ;BASE ADDRESS IS RELATIVE
L7A2D:  ORA #$C0
L7A2F:  BNE VGJMP1              ;MOVE INTO VECTOR LIST

;--------------------------------[ VGSABS - SHORT FORM VGLABS CALL ]--------------------------------

VGSABS:
; [note] Set an absolute beam position, then VGLABS
L7A31:  LDY #$00
L7A33:  STY $06
L7A35:  STY $08
L7A37:  ASL A
L7A38:  ROL $06
L7A3A:  ASL A
L7A3B:  ROL $06
L7A3D:  STA XCOMP
L7A3F:  TXA                     ;Y COMPONENT/4
L7A40:  ASL A
L7A41:  ROL $08
L7A43:  ASL A
L7A44:  ROL $08
L7A46:  STA $07
L7A48:  LDX #$05

;------------------------------[ VGLABS - ADD LABS INTO VECTOR LIST ]-------------------------------

VGLABS:
; [note] Append a LABS from the zero-page position block
L7A4A:  LDA VGBRIT,X
L7A4C:  LDY #$00
L7A4E:  STA (VGLIST),Y          ;Y LSB
L7A50:  LDA VGLIST,X
L7A52:  AND #$0F
L7A54:  ORA #$A0
L7A56:  INY
L7A57:  STA (VGLIST),Y          ;Y MSB+OPCODE
L7A59:  LDA $00,X
L7A5B:  INY
L7A5C:  STA (VGLIST),Y          ;X LSB
L7A5E:  LDA VGSIZE,X
L7A60:  AND #$0F
L7A62:  ORA VGSIZE              ;ADD SCALE TO DETERMIN SIZE
L7A64:  INY
L7A65:  STA (VGLIST),Y          ;X MSB

;-------------------------------[ VGADD - ADD Y+1 TO VECTOR ADDRESS ]-------------------------------

VGADD:
; [note] Advance VGLIST by Y+1
L7A67:  TYA                     ;ADD 1+(Y) TO VGLIST
L7A68:  SEC
L7A69:  ADC VGLIST
L7A6B:  STA VGLIST
L7A6D:  BCC VGA_0
L7A6F:  INC $04

VGA_0:
; [note] Shared return
L7A71:  RTS

VGVCTR:
; [note] The general vector emitter (unused by the shipped ROM)
L7A72:  LDX #$00                ;INITIALISE X
L7A74:  LDA $06                 ;GET HIGH BYTE OF X
L7A76:  CMP #$80                ;SET CARRY = TO BIT 7
L7A78:  BCC VGA_0_2             ;ITS ALREADY +
L7A7A:  TXA                     ;XCOMP=0-XCOMP
L7A7B:  SBC XCOMP               ;(CARRY SET ON ENTRY)
L7A7D:  STA XCOMP
L7A7F:  TXA
L7A80:  SBC $06
L7A82:  STA $06                 ;(CARRY ALWAYS SET AFTER NEGATE OF - NUMBER)

;-------------------------------[ VGVCTR - ADD VCTR TO VECTOR LIST ]--------------------------------

VGA_0_2:
L7A84:  ROL TEMP1               ;SAVE SIGN OF X
L7A86:  LDA $08                 ;REPEAT ABOVE FOR Y
L7A88:  CMP #$80
L7A8A:  BCC VGA_0_4
L7A8C:  TXA                     ;XCOMP=0-XCOMP
L7A8D:  SBC $07
L7A8F:  STA $07
L7A91:  TXA
L7A92:  SBC $08
L7A94:  STA $08                 ;(CARRY ALWAYS SET AFTER A NEGATE

VGA_0_4:
L7A96:  ROL TEMP1               ;SAVE SIGN OF Y
L7A98:  ORA $06
L7A9A:  BEQ VGA_0_5             ;IF LESS THAN 256 IN LENGTH
L7A9C:  CMP #$02
L7A9E:  BCS VGA_0_20            ;NO NORMALIZE NEEDED
L7AA0:  LDY #$01                ;ONE SHIFT NEEDED
L7AA2:  BNE VGA_0_8             ;ALWAYS

VGA_0_5:
L7AA4:  LDY #$02
L7AA6:  LDX #$09
L7AA8:  LDA XCOMP
L7AAA:  ORA $07
L7AAC:  BEQ VGA_0_20            ;ZERO LENGTH VECTOR

VGA_0_6:
L7AAE:  BMI VGA_0_8             ;COUNT IS RIGHT

VGA_0_7:
L7AB0:  INY                     ;GET NORMALIZE COUNT
L7AB1:  ASL A
L7AB2:  BPL VGA_0_7

VGA_0_8:
L7AB4:  TYA
L7AB5:  TAX                     ;SAVE SHIFT COUNT FOR TIMER
L7AB6:  LDA $06

VGA_0_10:
L7AB8:  ASL XCOMP
L7ABA:  ROL A
L7ABB:  ASL $07
L7ABD:  ROL $08
L7ABF:  DEY
L7AC0:  BNE VGA_0_10            ;NORMALIZE NUMBERS
L7AC2:  STA $06

VGA_0_20:
L7AC4:  TXA
L7AC5:  SEC
L7AC6:  SBC #$0A
L7AC8:  EOR #$FF                ;9-COUNT=TIMER (TTTT)
L7ACA:  ASL A
L7ACB:  ROR TEMP1               ;SIGN OF Y (S)
L7ACD:  ROL A
L7ACE:  ROR TEMP1               ;SIGN OF X (S)
L7AD0:  ROL A
L7AD1:  ASL A
L7AD2:  STA TEMP1               ;TTTTXSSX
L7AD4:  LDY #$00
L7AD6:  LDA $07
L7AD8:  STA (VGLIST),Y
L7ADA:  LDA TEMP1
L7ADC:  AND #$F4                ;SIGN+EXPONENT
L7ADE:  ORA $08
L7AE0:  INY
L7AE1:  STA (VGLIST),Y
L7AE3:  LDA XCOMP
L7AE5:  INY
L7AE6:  STA (VGLIST),Y
L7AE8:  LDA TEMP1
L7AEA:  AND #$02
L7AEC:  ASL A                   ;SIGN
L7AED:  ORA VGBRIT              ;BRIGHTNESS
L7AEF:  ORA $06
L7AF1:  INY
L7AF2:  STA (VGLIST),Y          ;STORE LAST BYTE OF VCTR
L7AF4:  JMP VGADD               ;($7A67) UPDATE VECTOR ADDRESS POINTER

;---------------------------[ VGAWT - DO A VGSABS FOLLOWED BY A WAIT 7 ]----------------------------

VGAWT:
; [note] Position the beam, then a WAIT
L7AF7:  JSR VGSABS              ;($7A31) DO A LABS
L7AFA:  LDA #$70                ;FOLLOW WITH A WAIT

;-------------------------------[ VGWAIT - ADD WAIT TO VECTOR LIST ]--------------------------------

VGWAIT:
; [note] A WAIT with no intensity
L7AFC:  LDX #$00                ;NO INTENSITY

;--------------------------[ VGDOT - DRAW A DOT AT THE CURRENT POSITION ]---------------------------

VGDOT:
; [note] A dot: a WAIT with intensity X
L7AFE:  LDY #$01
L7B00:  STA (VGLIST),Y          ;SAVE TIMER VALUE
L7B02:  DEY
L7B03:  TYA                     ;(A):=(Y):=0
L7B04:  STA (VGLIST),Y          ;0, TIMER, 0, 0=WAIT
L7B06:  INY
L7B07:  INY
L7B08:  STA (VGLIST),Y
L7B0A:  INY
L7B0B:  TXA                     ;INSERT INTENSITY
L7B0C:  STA (VGLIST),Y
L7B0E:  JMP VGADD               ;($7A67)

;---------------------------------------------[ ENTRY ]---------------------------------------------

EAUPD:
; also EAROM in the linker map
; [note] One step of the EAROM state machine
L7B11:  LDA INTCT               ;CAN ONLY DO HIS ONCE EVERY 16 INTERRUPTS
L7B13:  AND #$0C
L7B15:  BNE EAUPD_1             ;WAIT
L7B17:  LDA EAFLG               ;ANY ACTIVITY?
L7B19:  BEQ EAUPD_2             ;NO. DESELECT EA ROM AND EXIT
L7B1B:  BPL EAUPD_3             ;R/W
L7B1D:  LDX EAX                 ;ERASE.GET ADDRESS
L7B1F:  LDA #$06                ;SELECT ERASE MODE
L7B21:  STA EACTL               ;DE-SELECT
L7B24:  STA EADAL,X             ;STORE ADDRESS
L7B27:  LDA #$0E
L7B29:  DEC EAX                 ;NEXT @
L7B2B:  DEC EABC                ;COUNT
L7B2D:  BNE EAUPD_2             ;CONTINUE
L7B2F:  LDX #$40                ;SELECT WRITE MODE
L7B31:  STX EAFLG

EAUPD_9:
L7B33:  INC EAX                 ;NEXT ADDRESS

EAUPD_2:
L7B35:  STA EACTL               ;DO EA CONTROL

EAUPD_1:
L7B38:  RTS                     ;EXIT

EAUPD_3:
L7B39:  LDY EABC                ;GET BYTE POINTER
L7B3B:  BNE EAUPD_5             ;NO FIRST
L7B3D:  STY EACS                ;RESET CHECKSUM

EAUPD_5:
L7B3F:  ASL A                   ;MODE?(CLEARS CARRY)
L7B40:  BPL EAUPD_10            ;READ
L7B42:  LDA EABDS,Y             ;GET @ OF @
L7B45:  BPL EAUPD_6
L7B47:  STA EABC                ;RESET BYTE COUNT
L7B49:  INC EAHSX               ;UP TO NEXT
L7B4B:  INC EAHSX               ;INITIAL
L7B4D:  INC EAHSX
L7B4F:  LDA EACS                ;GET CHECKSUM
L7B51:  BCC EAUPD_7             ;(ALWAYS)

EAUPD_6:
L7B53:  ADC EAHSX               ;COMPUTE SOURCE ADDR
L7B55:  TAX
L7B56:  LDA HSCORE,X            ;ACCUMULATE CHKSUM
L7B58:  ADC EACS
L7B5A:  STA EACS
L7B5C:  LDA HSCORE,X

EAUPD_7:
L7B5E:  INC EABC
L7B60:  LDX EAX                 ;@INTO EA ROM TO PUT DATA
L7B62:  STA EADAL,X             ;SET UP ADDRESS/DATA
L7B65:  LDA #$04                ;SELECT WRITE MODE
L7B67:  STA EACTL
L7B6A:  LDA #$0C

EAUPD_4:
L7B6C:  INX
L7B6D:  CPX #$15                ;LAST ONE?
L7B6F:  BCC EAUPD_9             ;NO
L7B71:  LDX #$00                ;YES. RESET ACTIVITY FLAG
L7B73:  STX EAFLG               ;DONE
L7B75:  BEQ EAUPD_2             ;(ALWAYS)

EAUPD_10:
L7B77:  LDX EAX
L7B79:  LDA #$08
L7B7B:  STA EADAL,X             ;SELECT @
L7B7E:  STA EACTL               ;SELECT READ MODE
L7B81:  LDA #$09
L7B83:  STA EACTL
L7B86:  LDA #$08
L7B88:  STA EACTL
L7B8B:  LDX #$00                ;NEED A 0 LATER
L7B8D:  LDA EABDS,Y             ;GET @ OF @
L7B90:  BPL EAUPD_11            ;NORMAL
L7B92:  STX EABC                ;RESET BYTE COUNT
L7B94:  LDA EAIN                ;READ ROM DATA
L7B97:  STX EACTL               ;DE-SELECT CHIP
L7B9A:  EOR EACS                ;MATCH CHKSUM?
L7B9C:  BEQ EAUPD_12            ;YEP
L7B9E:  LDY #$02                ;CHECKSUM ERROR. IGNORE ROM DATA, CLEAR RAM DATA
L7BA0:  TYA                     ;LDA #2
L7BA1:  ADC EAHSX               ;COMPUTE DST @
L7BA3:  TAX
L7BA4:  LDA #$00

EAUPD_13:
L7BA6:  STA HSCORE,X            ;BLANK OUT SCORE AND INITIALS
L7BA8:  STA INITL,X
L7BAA:  DEX
L7BAB:  DEY
L7BAC:  BPL EAUPD_13
L7BAE:  INC EABAD               ;SIGNAL WE GO A BAD ENTRY

EAUPD_14:
L7BB0:  LDX EAX
L7BB2:  BPL EAUPD_4             ;(ALWAYS)

EAUPD_12:
L7BB4:  INC EAHSX               ;TO NEXT GROUP OF SCORE/INITIALS
L7BB6:  INC EAHSX
L7BB8:  INC EAHSX
L7BBA:  BPL EAUPD_14            ;(ALWAYS)

EAUPD_11:
L7BBC:  ADC EAHSX               ;COMPUTE DST
L7BBE:  TAY                     ;SAVE IT
L7BBF:  LDA EAIN                ;GET ROM DATA
L7BC2:  STX EACTL               ;DE-SELECT CHIP
L7BC5:  STA a:HSCORE,Y          ;PASSIT
L7BC8:  ADC EACS                ;ACCUMULATE CHECKSUM
L7BCA:  STA EACS
L7BCC:  INC EABC                ;NEXT BYTE
L7BCE:  LDA #$00                ;DE-SELECT
L7BD0:  BEQ EAUPD_14            ;(ALWAYS)

EABDS:
L7BD2:  .byte $00, $01, $02, $21, $22, $23, $FF ;...!"#.

STEAROM:
; also STEARO in the linker map
; [note] Start an EAROM erase-then-write
L7BD9:  LDY EAFLG               ;ALREADY WORKING?
L7BDB:  BNE STEAROM_1           ;YEP. NEVER MIND
L7BDD:  LDA #$08
L7BDF:  CMP EAHSX               ;FIT IN ROM?
L7BE1:  BCC STEAROM_1           ;NO
L7BE3:  ROR EAFLG               ;SET BIT 7. (STARTS SEQUENCE)
L7BE5:  LDA EABAD               ;ANY BAD ENTRIES?
L7BE7:  BEQ STEAROM_1           ;NO
L7BE9:  LDX #$15
L7BEB:  STX EABC                ;DO THE WHOLE ROM
L7BED:  DEX
L7BEE:  STX EAX
L7BF0:  STY EAHSX               ;RESET START ADDRESS
L7BF2:  STY EABAD               ;RESET BAD FLAG

STEAROM_1:
L7BF4:  RTS

;--------------------------------------[ INIT-INITIALIZATION ]--------------------------------------

INIT:
; also CASTST in the linker map
; [note] Initialise for a new game
L7BF5:  BIT HALT                ;WAIT FOR VG TO STOP BEFORE MONKEYING AROUND
L7BF8:  BMI INIT                ;WITH FRAME
L7BFA:  JSR SETROL              ;($714E) SET UP ASTEROID SUBROUTINES. (CLEARS FRAME)
L7BFD:  LDA #$B0                ;PUT A HALT INSTRUCTION FIRST
L7BFF:  STA $4003
L7C02:  LDA #$00
L7C04:  LDX #$03

INIT_30:
L7C06:  STA $61,X               ;CLEAR SCORE
L7C08:  STA $64,X
L7C0A:  DEX
L7C0B:  BNE INIT_30

INIT_31:
L7C0D:  STA OBJ,X               ;CLEAR WHOLE PAGE
L7C10:  INX
L7C11:  BNE INIT_31
L7C13:  STA HSSND               ;TURN OFF DEATH STAR SOUND
L7C15:  LDA #$01
L7C17:  JSR SSBTLT              ;($6325) DON'T WAIT
L7C1A:  LDA #$98                ;ENOUGH FOR 3 LARGE SAUCERS
L7C1C:  STA SEDLAY
L7C1F:  STA EDELAY              ;DELAY ENTRY OF SAUCER
L7C22:  LDA #$7F
L7C24:  STA RDELAY              ;DELAY FOR STARTING ROCKS
L7C27:  LDA #$06                ;IF MORE ROCKS THAN THIS THEN DON'T
L7C29:  STA DIFCTY              ;LAUNCH SAUCER
L7C2C:  LDA #$FF
L7C2E:  STA UPDFLG              ;NOT UPDATING INITIALS
L7C30:  STA $43
L7C32:  LDA #$30
L7C34:  STA THUMP3              ;RESET STARTING THUMP SOUND

SINIT:
; [note] The part of INIT the self-test shares: rock velocities, POKEY test
L7C37:  JSR PKYTST              ;($7FC1) INIT ROCK VELOCITIES
L7C3A:  LDA OPTN1               ;GET BONUS LEVEL
L7C3D:  AND #$03
L7C3F:  TAY
L7C40:  LDA BONUS_2,Y           ;GET BOUNUS PLATEAU
L7C43:  STA $FE
L7C45:  STA $69                 ;LSB
L7C47:  STA $6C
L7C49:  BMI SINIT_32            ;NO BONUS
L7C4B:  LDA #$01

SINIT_32:
L7C4D:  STA $6A
L7C4F:  STA $FF
L7C51:  STA $6D
L7C53:  LDA #$03
L7C55:  AND OPTN3               ;GET LIFE COUNT
L7C58:  TAX
L7C59:  INX                     ;+2
L7C5A:  INX
L7C5B:  CPY #$03                ;BONUS ENABLED?
L7C5D:  BNE SINIT_2             ;YES.
L7C5F:  INX                     ;NO. GIVE 'EM ANOTHER LIFE

SINIT_2:
L7C60:  LDA CMODE
L7C62:  AND #$03
L7C64:  CMP #$03                ;2 COINS/CREDIT?
L7C66:  BNE SINIT_1             ;NO
L7C68:  INX                     ;GIVE 'EM 1 MORE

SINIT_1:
L7C69:  STX NHITS
L7C6B:  JMP INISOU              ;($784F) SET UP POKEY

BONUS_2:
L7C6E:  .byte $00, $20, $50, $FF ;. P.

;------------------------[ LIVES - DRAW A SHIP FOR EACH LIFE YOU HAVE LEFT ]------------------------

LIVES:
; ENTRY	(A)=X POSITION FOR START OF PICTURES
; (Y)=NUMBER OF LIFES
L7C72:  LDX #$D5                ;Y POSITION FOR PICTURES

LIVESS:
; [note] Draw Y-1 ship glyphs at quarter size (the reserve ships)
L7C74:  STY TEMP1
L7C76:  LDY #$E0                ;1/4 SIZE PICTURE
L7C78:  STY VGSIZE
L7C7A:  JSR VGSABS              ;($7A31) POSITION BEAM AND RESET SCALE FACTOR
L7C7D:  LDA #$70
L7C7F:  JSR VGWAIT              ;($7AFC)
L7C82:  JMP LIVESS_11           ;($7C8C)

LIVESS_10:
L7C85:  LDX #$CA                ;LSB OF SHIP PICTURE ROUTINE
L7C87:  LDA #$A4
L7C89:  JSR VGADD2              ;($7CCC) JSRL TO PICTURE

LIVESS_11:
L7C8C:  DEC TEMP1
L7C8E:  BEQ LIVESS_99           ;DONE
L7C90:  BPL LIVESS_10           ;CONTINUE

LIVESS_99:
L7C92:  RTS

BONDSP:
; DISPLAY BONUS LIFE SCORE REQUIREMENT
L7C93:  LDA #$FD                ;POINT TO BONUS SCORE VALUE
L7C95:  LDY #$03                ;3 BYTES OF BINARY
L7C97:  SEC                     ;SUPPRESS LEADING ZEROES

DIGITS:
; ENTRY	(C) = CARRY SET FOR ZERO SUPPRESSION
; (A) = ADDRESS OF (Y) ZERO PAGE LOCATIONS CONTAINING NUMBER (LSB TO MSB)
; (Y) = NUMBER OF ZERO PAGE LOCATIONS TO USE (1 TO 127).
; USES	A,X,Y (TEMP4,TEMP4+2)
L7C98:  PHP                     ;SAVE INPUT PARAMETERS
L7C99:  STX $1D
L7C9B:  DEY
L7C9C:  STY $1C
L7C9E:  CLC
L7C9F:  ADC $1C
L7CA1:  STA TEMP4               ;MSB OF DIGITS
L7CA3:  PLP
L7CA4:  TAX

DIGITS_10:
L7CA5:  PHP
L7CA6:  LDA $00,X
L7CA8:  LSR A
L7CA9:  LSR A
L7CAA:  LSR A
L7CAB:  LSR A
L7CAC:  PLP
L7CAD:  JSR VGHEXZ              ;($79F7) FIRST DIGIT
L7CB0:  LDA $1C
L7CB2:  BNE DIGITS_20
L7CB4:  CLC                     ;DISPLAY LAST DIGIT (EVEN 0)

DIGITS_20:
L7CB5:  LDX TEMP4
L7CB7:  LDA $00,X
L7CB9:  JSR VGHEXZ              ;($79F7) SECOND DIGIT
L7CBC:  DEC TEMP4
L7CBE:  LDX TEMP4
L7CC0:  DEC $1C
L7CC2:  BPL DIGITS_10           ;LOOP FOR EACH SET OF DIGITS
L7CC4:  RTS

;------------------------------------[ VGBLNK (DISPLAY BALNK) ]-------------------------------------

VGBLNK:
; also DSTTST in the linker map
; [note] A digit followed by a space
L7CC5:  JSR VGHEX               ;($79FD) DISPLAY DIGIT
L7CC8:  LDA #$0A                ;FOLLOW WITH A SPACE
L7CCA:  LDX #$CB

;--------------------------[ VGADD2 (ADD 2 BYTES TO LIST, UPDATE VGLIST) ]--------------------------

VGADD2:
; [note] Store A,X as a word and advance two
L7CCC:  LDY #$00
L7CCE:  STA (VGLIST),Y
L7CD0:  INY
L7CD1:  TXA
L7CD2:  STA (VGLIST),Y
L7CD4:  JMP VGADD               ;($7A67) UPDATE VECTOR POINTER

;---------------------------------------[ PWRON RESET ENTRY ]---------------------------------------

PWRON:
; [note] Reset: RAM test, then into the self-test or the game
L7CD7:  LDX #$FE
L7CD9:  TXS                     ;SET STACK
L7CDA:  CLD                     ;IN BINARY MODE
L7CDB:  LDX #$00                ;WE HAVE 5.33MS TO CHECK PAGE 1
L7CDD:  STX $2C0F

;-------------------------------------------[ RAM TEST ]--------------------------------------------

PWRON_11:
L7CE0:  LDA #$11                ;2 2114'S

PWRON_10:
L7CE2:  STA SXPXL,X
L7CE5:  TAY                     ;SAVE CODE
L7CE6:  EOR SXPXL,X             ;WORK?
L7CE9:  BNE PWRON_70            ;NO
L7CEB:  TYA
L7CEC:  ASL A                   ;SHIFT PATTERN
L7CED:  BCC PWRON_10
L7CEF:  TXA
L7CF0:  STA $00,X
L7CF2:  STA SXPXL,X
L7CF5:  STA OBJ,X
L7CF8:  STA $0300,X
L7CFB:  STA VECRAM,X
L7CFE:  STA $4100,X
L7D01:  STA $4200,X
L7D04:  STA $4300,X
L7D07:  STA $4400,X
L7D0A:  STA $4500,X
L7D0D:  STA $4600,X
L7D10:  STA $4700,X
L7D13:  DEX
L7D14:  BNE PWRON_11            ;256 BYTES (TAKES 25.3MS)
L7D16:  STA WTDOG               ;DON'T LET WATCHDOG TIME OUT

PWRON_12:
L7D19:  TXA

PWRON_16:
L7D1A:  EOR SXPXL,X             ;ADDR MATCH?
L7D1D:  BNE PWRON_70            ;NO
L7D1F:  STA SXPXL,X             ;COVER OUR TRACKS
L7D22:  INX
L7D23:  BIT STSTSW              ;IN SELF-TEST?
L7D26:  BPL PWRON_13            ;NO
L7D28:  TXA                     ;YES. CHECK IT ALL
L7D29:  BNE PWRON_16
L7D2B:  BEQ PWRON_14

PWRON_13:
L7D2D:  CPX #$FB                ;NMI'S ARE RUNNING. DON'T CKECK IT ALL
L7D2F:  BCC PWRON_12
L7D31:  LDX #$00                ;NOW CHECK PAGE 0

PWRON_14:
L7D33:  TXA
L7D34:  EOR $00,X               ;ADDR MATCH?
L7D36:  BNE PWRON_70            ;NO
L7D38:  LDA #$11                ;TRY INDIVIDUAL BITS

PWRON_15:
L7D3A:  STA $00,X
L7D3C:  TAY                     ;SAVE BIT PATTERN
L7D3D:  EOR $00,X               ;WORK?

PWRON_70:
L7D3F:  BNE P0123E              ;BAD
L7D41:  TYA
L7D42:  ASL A                   ;NEXT BIT
L7D43:  BCC PWRON_15
L7D45:  LDY #$00                ;COVER OUR TRACKS
L7D47:  STY $00,X
L7D49:  DEX
L7D4A:  BNE PWRON_14

PG010K:
; [note] RAM test: pages 0 and 1 passed, test pages 2 and 3
L7D4C:  STA WTDOG               ;PAGES 0 & 1 ARE GOOD
L7D4F:  LDA #$02                ;CHECK PGS 2,3

PG010K_35:
L7D51:  STA VGSIZE

PG010K_40:
L7D53:  TYA
L7D54:  EOR ($00),Y             ;ADDRESS MATCH?
L7D56:  BNE P4000E              ;NO
L7D58:  LDA #$11                ;TEST EACH BIT INDIVIDUALY

PG010K_10:
L7D5A:  STA ($00),Y
L7D5C:  TAX                     ;SAVE PATTERN
L7D5D:  EOR ($00),Y             ;MATCH?
L7D5F:  BNE P4000E              ;NO
L7D61:  STA ($00),Y             ;COVER OUR TRACKS
L7D63:  TXA
L7D64:  ASL A
L7D65:  BCC PG010K_10
L7D67:  INY
L7D68:  BNE PG010K_40           ;NEXT LOCATION TO TEST
L7D6A:  STA WTDOG               ;NO BARKING NOW
L7D6D:  INC VGSIZE
L7D6F:  LDX VGSIZE
L7D71:  CPX #$04
L7D73:  BCC PG010K_40           ;NEXT PAGE TO TEST
L7D75:  LDA #$40
L7D77:  CPX #$40
L7D79:  BCC PG010K_35           ;TEST 2K OF RAM AT 4000
L7D7B:  CPX #$48
L7D7D:  BCC PG010K_40           ;MORE OF 2K BLOCK LEFT
L7D7F:  BCS STEST3              ;RAM IS GOOD

CKSUM5:
L7D81:  .byte $2C               ;,

P0123E:
; [note] RAM test: error in the first 1K
L7D82:  LDY #$00                ;ERROR IN FIRST 1K
L7D84:  BEQ STEST1

P4000E:
; [note] RAM test: error in vector RAM
L7D86:  LDY #$00
L7D88:  LDX VGSIZE
L7D8A:  CPX #$04
L7D8C:  BCC STEST1              ;IF ERROR IN FIRST 1K OF RAM
L7D8E:  INY
L7D8F:  CPX #$44
L7D91:  BCC STEST1              ;ERROR IN SECOND 1K RAM
L7D93:  INY                     ;ERROR MUST BE IN THIRD 1K RAM

STEST1:
; [note] Bad RAM: beep out the failing page on the 3 kHz clock
L7D94:  CMP #$10                ;SET TO 1,2 OR 3
L7D96:  ROL A
L7D97:  AND #$1F
L7D99:  CMP #$02
L7D9B:  ROL A                   ;EACH 1 REPRESENTS A BAD 2114
L7D9C:  AND #$03

STEST1_15:
L7D9E:  DEY
L7D9F:  BMI STEST1_20           ;IF THIS 1K BLOCK WAS BAD
L7DA1:  ASL A                   ;FLAG 2 RAM IC'S AS GOOD
L7DA2:  ASL A
L7DA3:  BCC STEST1_15           ;ALWAYS

STEST1_20:
L7DA5:  LSR A
L7DA6:  LDY #$07
L7DA8:  STY $2C0F
L7DAB:  LDX #$20                ;HIGH FREQ (IF CHIP GOOD)
L7DAD:  BCC STEST1_25           ;IF RAM IC IS GOOD
L7DAF:  LDX #$80                ;LOW FREQ

STEST1_25:
L7DB1:  STX POKEY
L7DB4:  LDX #$A8
L7DB6:  STX $2C01
L7DB9:  LDX #$00

STEST1_31:
L7DBB:  BIT THRKHZ              ;COUNT 1 3KHZ SIGNAL
L7DBE:  BPL STEST1_31

STEST1_32:
L7DC0:  BIT THRKHZ
L7DC3:  BMI STEST1_32
L7DC5:  DEX
L7DC6:  STA WTDOG               ;NOW NOT
L7DC9:  BNE STEST1_31           ;COUNT FOR 256/3000 OF A SECOND
L7DCB:  DEY
L7DCC:  BPL STEST1_31           ;8*256/3000 OF A SECOND
L7DCE:  STX $2C01               ;TURN OFF SOUND
L7DD1:  LDY #$08

STEST1_35:
L7DD3:  BIT THRKHZ              ;COUNT 3KHZ SIGNALS
L7DD6:  BPL STEST1_35

STEST1_36:
L7DD8:  BIT THRKHZ
L7DDB:  BMI STEST1_36
L7DDD:  DEX
L7DDE:  STA WTDOG               ;NOT NOW
L7DE1:  BNE STEST1_35           ;COUNT TIL 256/3000 OF A SECOND
L7DE3:  DEY
L7DE4:  BNE STEST1_35           ;COUNT TIL 8*256/3000 SECONDS
L7DE6:  TAX                     ;SET FLAGS
L7DE7:  BNE STEST1_20           ;MORE TO COME

STOP:
; [note] Spin until the self-test switch is pushed
L7DE9:  STA WTDOG               ;NO BITING NOW
L7DEC:  LDA STSTSW
L7DEF:  BMI STOP                ;WAIT UNTIL STEST SWITCH IS PUSHED

STOP_10:
L7DF1:  BPL STOP_10             ;START ALL OVER - WITH WATCHDOG

;-----------------------------------------[ ROM CHECKSUM ]------------------------------------------

STEST3:
; [note] Checksum the ROMs and test the bank select
L7DF3:  LDA #$00                ;CKSUM ALL ROMS
L7DF5:  TAY
L7DF6:  TAX
L7DF7:  LDA #$48

STEST3_5:
L7DF9:  STA $0A
L7DFB:  LDA #$07                ;8 PAGES TO TEST
L7DFD:  STA TEMP2
L7DFF:  LDA #$55                ;STARTING PATTERN
L7E01:  CLC

STEST3_10:
L7E02:  ADC (TEMP1),Y
L7E04:  INY
L7E05:  BNE STEST3_10           ;DO ONE PAGE
L7E07:  INC $0A
L7E09:  DEC TEMP2
L7E0B:  BPL STEST3_10           ;DO 8 PAGES
L7E0D:  STA R0,X                ;STORE 6 CKSUMS STARTING AT R0
L7E0F:  ORA CKERR               ;KEEP ERROR FLAGS
L7E11:  STA CKERR
L7E13:  INX
L7E14:  STA WTDOG               ;WHAT HAVE YOU BEEN TYPING ON THESE, LINDA?
L7E17:  LDA $0A
L7E19:  CMP #$58
L7E1B:  BCC STEST3_5            ;CKSUM 4800 TO 5800
L7E1D:  BNE STEST3_20           ;THEN SKIP TO 6000
L7E1F:  LDA #$60

STEST3_20:
L7E21:  CMP #$80
L7E23:  BCC STEST3_5            ;CKSUM 6000 TO 8000
L7E25:  STA $0300               ;200=0 AND 300=80
L7E28:  STA BNKSEL              ;SWITCH TO PLAYER 2
L7E2B:  CMP OBJ
L7E2E:  BEQ STEST3_25           ;BANK SELECT APPEARS OK
L7E30:  INC XT                  ;ERROR

STEST3_25:
L7E32:  LDA $0300
L7E35:  BEQ STEST5
L7E37:  INC XT                  ;ERROR

;----------------------------------------[ DISPLAY HANDLER ]----------------------------------------

STEST5:
; [note] Self-test display loop: one 16 ms pass
L7E39:  LDA #$10
L7E3B:  STA VGSIZE              ;SET CHARACTER SIZE
L7E3D:  STA BNKSEL              ;SWITCH TO PLAYER 1 CONTROLS
L7E40:  LDX #$24                ;THIS IS SET FOR 16MS BEST CASE

STEST5_5:
L7E42:  LDA THRKHZ              ;WAIT THRU ONE 3KHZ CYCLE
L7E45:  BPL STEST5_5

STEST5_7:
L7E47:  LDA THRKHZ
L7E4A:  BMI STEST5_7
L7E4C:  DEX                     ;COUNTDOWN TO VECTORS REPEAT EVERY 16MS
L7E4D:  BPL STEST5_5

STEST5_8:
L7E4F:  BIT HALT                ;WAIT FOR HALT
L7E52:  BMI STEST5_8            ;WATCHDOG WILL RESET IF VECTOR GENERATOR IS LOST
L7E54:  STA WTDOG
L7E57:  LDA #$00
L7E59:  STA VGLIST
L7E5B:  LDA #$40
L7E5D:  STA $04

STEST6:
; [note] Self-test: read the switch, draw the option switches and checksum results
L7E5F:  LDA STSTSW
L7E62:  AND #$80                ;S.T. SWITCH
L7E64:  BNE STEST6_90           ;STAY IN SELF-TEST
L7E66:  STA $01FF               ;ENABLE NMI'S
L7E69:  JMP START               ;($6000) BEGIN GAME

STEST6_90:
L7E6C:  LDA XT
L7E6E:  BEQ STEST6_30
L7E70:  LDX #$CC
L7E72:  LDA #$57
L7E74:  JSR VGJSRL              ;($7A2A) JSRL BNKERR FOR BANK SELECT ERROR

STEST6_30:
L7E77:  LDX #$96
L7E79:  STX $0D                 ;STARTING Y VALUE FOR CHECKSUMS
L7E7B:  LDX #$05

STEST6_32:
L7E7D:  LDA R0,X
L7E7F:  BEQ STEST6_35
L7E81:  STX TEMP2               ;SAVE X
L7E83:  LDX $0D
L7E85:  TXA
L7E86:  SEC
L7E87:  SBC #$08                ;32 BELOW CURRENT LINE
L7E89:  STA $0D                 ;SAVE POSITION FOR NEXT LINE
L7E8B:  LDA #$20
L7E8D:  JSR VGAWT               ;($7AF7)
L7E90:  LDX TEMP2
L7E92:  LDY ROMX,X              ;GET X ADDRESS OF ROM
L7E95:  JSR VGCHAR              ;($7A0A) DISPLAY
L7E98:  LDX TEMP2
L7E9A:  LDY ROMY,X              ;GET Y ADDRESS OF ROM
L7E9D:  JSR VGCHAR              ;($7A0A) DISPLAY
L7EA0:  LDX TEMP2

STEST6_35:
L7EA2:  DEX
L7EA3:  BPL STEST6_32           ;LOOP THRU ALL CHECKSUMS
L7EA5:  LDA #$57
L7EA7:  LDX #$44
L7EA9:  JSR VGJSRL              ;($7A2A) JSRL TO TEST PATTERN
L7EAC:  LDA #$93
L7EAE:  LDX #$A0
L7EB0:  JSR VGAWT               ;($7AF7) POSITION BEAM
L7EB3:  LDX #$03                ;NO NEED TO WAIT

STEST6_28:
L7EB5:  LDA OPTN1,X             ;GO FROM SW1 TO SW8
L7EB8:  AND #$03
L7EBA:  STX TEMP2
L7EBC:  JSR VGBLNK              ;($7CC5)
L7EBF:  LDX TEMP2
L7EC1:  DEX
L7EC2:  BPL STEST6_28           ;LOOP THRU 8 SWITCHES
L7EC4:  LDA #$93                ;X POSITION
L7EC6:  LDX #$B0                ;Y POSITION
L7EC8:  JSR VGAWT               ;($7AF7) POSITION
L7ECB:  LDA #$07                ;RELEASE POKEY
L7ECD:  STA $2C0F
L7ED0:  STA $2C0B
L7ED3:  LDA OPTN5               ;GET COIN OPTIONS
L7ED6:  EOR #$FF
L7ED8:  STA TEMP2
L7EDA:  STA CMODE
L7EDC:  ASL A
L7EDD:  ROL A
L7EDE:  ROL A
L7EDF:  ROL A
L7EE0:  ROL $0D
L7EE2:  AND #$07                ;ISOLATE BONUS OPTIONS
L7EE4:  JSR VGBLNK              ;($7CC5) DISPLAY DIGIT FOLLOWED BY BLANK
L7EE7:  LDA $0D
L7EE9:  AND #$01                ;ISOLATE MIDDLE MECH MULTIPLIER
L7EEB:  JSR VGBLNK              ;($7CC5) DISPLAY DIGIT FOLLOWED BY BLANK
L7EEE:  LDA TEMP2
L7EF0:  LSR A
L7EF1:  LSR A
L7EF2:  AND #$03                ;ISOLATE RIGHT MECH MULTIPLIER
L7EF4:  JSR VGBLNK              ;($7CC5) DISPLAY DIGIT FOLLOWED BY BLANK
L7EF7:  LDA TEMP2
L7EF9:  AND #$03                ;ISOLATE COIN MODE
L7EFB:  JSR VGBLNK              ;($7CC5) DISPLAY DIGIT FOLLOWED BY BLANK
L7EFE:  JSR SINIT               ;($7C37)
L7F01:  LDY NHITS
L7F03:  LDA #$96
L7F05:  LDX #$94
L7F07:  INY
L7F08:  JSR LIVESS              ;($7C74) DISPLAY THEM
L7F0B:  LDA #$10
L7F0D:  STA VGSIZE
L7F0F:  LDA $FF                 ;BONUS?
L7F11:  BMI STEST6_27           ;NO BONUS
L7F13:  LDA #$8E
L7F15:  LDX #$83
L7F17:  JSR VGAWT               ;($7AF7)
L7F1A:  JSR BONDSP              ;($7C93) DISPLAY BONUS SCORE

STEST6_27:
L7F1D:  LDA PERR                ;ANY POKEY ERRORS?
L7F1F:  BEQ STEST6_25           ;NO
L7F21:  LDX #$CB
L7F23:  LDA #$F4
L7F25:  JSR VGADD2              ;($7CCC)

STEST6_25:
L7F28:  INC FRAME
L7F2A:  LDA FIRESW              ;IF ALL 4 BUTTONS ARE ON
L7F2D:  AND THRUST
L7F30:  AND ROTL
L7F33:  AND ROTR
L7F36:  BPL STEST6_11           ;THEY'RE NOT
L7F38:  BIT LPLAYR
L7F3A:  BMI STEST6_11           ;ALREADY ERASED
L7F3C:  STA EAFLG               ;SIGNAL TO ERASE
L7F3E:  STA LPLAYR              ;ONLY DO THIS ONCE
L7F40:  LDX #$15
L7F42:  STX EABC                ;21 BYTES
L7F44:  DEX
L7F45:  STX EAX                 ;START @ 20

STEST6_11:
L7F47:  LDA LPLAYR              ;ANY EA STUFF?
L7F49:  BEQ STEST6_29           ;NO. NO MESSAGES EITHER
L7F4B:  LDA EAFLG               ;ERASING OR WRITING?
L7F4D:  BEQ STEST6_29           ;NO
L7F4F:  LDA #$94
L7F51:  LDX #$72
L7F53:  JSR VGAWT               ;($7AF7)
L7F56:  LDX #$F2                ;SAY WE'RE ERASING
L7F58:  LDA #$57
L7F5A:  JSR VGJSRL              ;($7A2A)
L7F5D:  JSR EAUPD               ;($7B11) DO EA STUFF
L7F60:  LDA INTCT               ;NMI'S DON'T WORK IN SELF TEST
L7F62:  CLC
L7F63:  ADC #$04                ;SO FOOL EAUPD ROUTINE
L7F65:  STA INTCT               ;BY SAYING 4 INTERRUPS HAPPENED

STEST6_29:
L7F67:  LDA #$7F
L7F69:  TAX
L7F6A:  JSR VGSABS              ;($7A31) CENTER BEAM
L7F6D:  JSR VGHALT              ;($79EC) STOP BEAM

;------------------------------------------[ SWITCH TEST ]------------------------------------------

STEST7:
; [note] Self-test: clear the POKEY, read the player switches, drive the sound test
L7F70:  LDY #$08
L7F72:  LDA #$00

STEST7_1:
L7F74:  STA $2BFF,Y             ;CLEAR POKEY REGISTERS
L7F77:  DEY
L7F78:  BNE STEST7_1            ;LEAVE Y=0 WHEN DONE
L7F7A:  JSR SWCH                ;($7F94) GET PLAYER SWITCHES
L7F7D:  ORA $88
L7F7F:  ORA $87
L7F81:  ORA ASTERS
L7F83:  BEQ STEST7_25           ;NO DIFFERENCES
L7F85:  LDA #$A4                ;TURN ON SOUND

STEST7_25:
L7F87:  STA $2C01               ;VOLUME SELECT
L7F8A:  LSR A                   ;CLEAR BIT 7
L7F8B:  STA POKEY               ;FREQUENCY SELECT
L7F8E:  STA GOADD               ;START DRAWING NOW
L7F91:  JMP STEST5              ;($7E39)

SWCH:
; [note] Read all the switches for the self-test display
L7F94:  JSR SWCH_1              ;($7F97) DO THE FOLLOWING TWICE

SWCH_1:
L7F97:  LDX #$07                ;PUT 8 SWITCHES INTO ACC

SWCH_2:
L7F99:  ROL COINA,X             ;RL/RR/TH/S1/S2/CR/CC/CL
L7F9C:  ROR A
L7F9D:  DEX
L7F9E:  BPL SWCH_2
L7FA0:  JSR SWCH_4              ;($7FB4) COMPUTE DIFFERENCES
L7FA3:  LDX #$04                ;PUT 5 SWITCHES INTO ACC

SWCH_3:
L7FA5:  ROL HYPSW,X             ;SHLD/FIRE/DIA.STP./SLAM/SELFT
L7FA8:  ROR A
L7FA9:  DEX
L7FAA:  BPL SWCH_3
L7FAC:  STX BNKSEL              ;SWITCH TO PLAYER 2 FOR NEXT TIME
L7FAF:  LDX #$28

SWCH_5:
L7FB1:  DEX
L7FB2:  BPL SWCH_5

SWCH_4:
L7FB4:  TAX                     ;SAVE SWITCHES FOR A SEC.
L7FB5:  EOR a:R6,Y              ;COMPUTE DIFFERENCES
L7FB8:  STA a:ASTERS,Y          ;SAVE DIFFERENCES
L7FBB:  STX R6,Y                ;SAVE NEW READINGS
L7FBD:  INY                     ;UP TO NEXT VARIABLES FOR NEXT TIME
L7FBE:  RTS                     ;RECURSE/EXIT AS RQD.

STEST7_FILL:
; placed by hand: DSTTST.MAC:460 `.REPT STEST7+81.-. / .BYTE -1 / .ENDR  ;FILLER SO ADDRESS DON'T CHANGE`. Unlabelled padding that pins PKYTST to $7FC1; NAMED here
L7FBF:  .byte $FF, $FF          ;..

;------------------------------------------[ POKEY TEST ]-------------------------------------------

PKYTST:
; [note] POKEY test, and the rock-speed initialiser
L7FC1:  LDA FRAME               ;GET FRAME #
L7FC3:  AND #$03                ;ISOLATE LSB'S
L7FC5:  TAX                     ;INDEX
L7FC6:  LDA RANDOM              ;GET POKY'S RANDOM #
L7FC9:  STA $DC,X               ;SAVE IT
L7FCB:  LDY #$00                ;CLEAR ERROR COUNTER (WILL ALWAYS GET 1 ERROR)
L7FCD:  LDX #$04                ;SET LOOP COUNTER

PKYTST_2:
L7FCF:  CMP PERR,X              ;HOW DOES THIS MATCH WITH THE LAST 3?
L7FD1:  BNE PKYTST_1            ;DIFFERENT
L7FD3:  INY                     ;SAME COUNT IT

PKYTST_1:
L7FD4:  DEX
L7FD5:  BNE PKYTST_2
L7FD7:  CPY #$04                ;SET CARRY
L7FD9:  LDY #$0A                ;MINIMUM VELOCITY NORMAL
L7FDB:  LDX #$F6
L7FDD:  LDA OPTN5               ;S/B 0
L7FE0:  ROR A
L7FE1:  BEQ PKYTST_3
L7FE3:  LDX #$FB                ;MAKE THE GAME EASY
L7FE5:  LDY #$05

PKYTST_3:
L7FE7:  STX RVELM               ;+
L7FE9:  STY RVELP               ;-
L7FEB:  STA PERR                ;ERROR CODE
L7FED:  RTS

ROMX:
; placed by hand: DSTTST.MAC:502 `ROMX: LET R,N,D,E,H,J`, the ROM position letters the checksum display prints, encoded (letter-'A'+11)*2: 38 30 1C 1E 24 28
L7FEE:  .byte $38, $30, $1C, $1E, $24, $28 ;80..$(

ROMY:
; placed by hand: DSTTST.MAC:503 `ROMY: NUM 2,2,1,1,1,1`, the matching position digits, encoded (n+1)*2: 06 06 04 04 04 04
L7FF4:  .byte $06, $06, $04, $04, $04, $04 ;......

VCTRS:
; placed by hand: SHUFFL.MAC:23 `.VCTRS ^H7FFA,NMI,PWRON,PWRON`, the 6502 vectors: NMI $785C, RESET $7CD7, IRQ/BRK $7CD7. The macro emits no label; NAMED here after the macro
L7FFA:  .byte $5C, $78, $D7, $7C, $D7, $7C ;\x.|.|
