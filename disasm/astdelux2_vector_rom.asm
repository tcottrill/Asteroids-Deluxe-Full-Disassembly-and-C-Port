; Asteroids Deluxe (astdelux2) - vector-board ROM ($4800-$57FF), plain assembler-style listing
; GENERATED by mkplain.py from astdelux2_dump.bin - do not hand-edit.
;
; Subroutine and variable names are Atari's own, taken from the released
; rev 2 Asteroids Deluxe source archive
; (github.com/historicalsource/asteroids-deluxe) and placed on this ROM
; by matching instruction sequences (nameroutines.py) - nothing here is
; invented.  Comments to the right of an instruction, the blocks above a
; routine, and the ruled section banners are the ORIGINAL Atari comments,
; carried across the same way.  Lines marked '[note]' are this project's
; own descriptions, added where the source's comments are thin or absent
; (ROUTINE_NOTES in astdelux_config.py) - everything else is Atari's.
;
; Reading the names: NAME is a routine or data label from the source.
; NAME_20 is that routine's local label 20$ - a branch target inside it,
; kept under its owner's name.  RTS_n and NAME_RTS_n are the source's
; shared RTS labels (RTS.n there; '.' is not legal to the assembler).
; Lxxxx is an address the source does not name, and every line carries
; one so any byte can be referred to.  Packed message text is decoded
; in the comment as "TEXT" (msgtext.py).
;
; Memory map (see astdelux_defines.asm for the full glossary):
;     0000-00FF  page 0   scratch / globals
;     0100-01FF  page 1   6502 stack
;     0200-03FF  pages 2/3 player object state (bank-switched)
;     2000-3FFF  I/O
;     4000-47FF  vector RAM (2K) - the display list the DVG reads
;     4800-57FF  vector board ROM (4K) - 6502 code AND DVG picture
;                data, interleaved: TRIROT.MAC is `.ASECT` / `.=4800`,
;                so this ROM is not all display-list data.  Which bytes
;                are DVG opcodes (`.word`) and which are 6502 (decoded
;                as instructions) comes from the traced code/data map
;                (m6502trace.py), not a guess.
;     6000-7FFF  program ROM (8K)
;
; Symbol names are the originals - the source archive documents exactly
; this revision.
;
; Round-trip check: this file assembles back to the ROM bytes with ca65.
;     python mkplain.py --set astdelux2 --check
;
.include "astdelux_defines.asm"

.org $4800

;-------------------------------[ Program ROM Forward Declarations ]--------------------------------

CHKST2     = $6102
CPYPOS     = $6210
CPYVEC     = $6246
SSBTLT     = $6325
RSAUCR     = $6826
NEWAST     = $698E
RNDPOS     = $6A03
NEWSHP     = $6A37
POINTS     = $6C60
SEARCH     = $6D6C
SEARC1     = $6D6E
CPXROT     = $6EE2
ATAN       = $70D4
COMP       = $70EC
COS        = $7134
SIN        = $7137
VGMSG      = $718F
SNDON      = $775B
ROCKSA     = $77E2
L77E3      = $77E3
VGRTSL     = $79E8
STEAROM    = $7BD9
INIT       = $7BF5
DIGITS     = $7C98
VGADD2     = $7CCC

;-----------------------------------[ Start Of Vector Board ROM ]-----------------------------------

;------------------------------------[ SPLIT TIPS ON COLLISION ]------------------------------------

SPLTTP:
; [note] Split the tips off a special-rock cluster on collision; frees the linked objects
L4800:  LDA OBJ,Y               ;GET PIX CODE
L4803:  AND #$3C                ;ISOLATE LINK FIELD
L4805:  LSR A                   ;MAKE IT RELATIVE TO 0
L4806:  LSR A
L4807:  TAX                     ;POINT TO OBJECT PARAMS
L4808:  LDA SRTIME,X            ;GET CONTROL BYTE
L480B:  BPL SPLTTP_1            ;NOT WAITING
L480D:  STX XT                  ;SAVE INDEX
L480F:  LDA #$05                ;POINTS
L4811:  JSR GPTS                ;($48B2) GIVE POINTS
L4814:  JSR SEARCH              ;($6D6C) LOOK FOR FREE ENTRY
L4817:  INC NROCKS              ;ADD ANOTHER TO TOTAL
L481A:  LDA OBJ,Y               ;GET PIX CODE AGAIN
L481D:  PHA                     ;SAVE IT
L481E:  JSR CPYPOS              ;($6210) COPY ALL PARAMATERS
L4821:  PLA                     ;(CPYPOS BLITZES 'OBJ')
L4822:  STA OBJ,X               ;(SO PASS THE OLD PIX CODE
L4825:  LDA #$00
L4827:  STA OBJ,Y               ;CAUSE A BIG EXPLOSION
L482A:  LDX XT                  ;RESTORE X

SPLTTP_3:
L482C:  LDA SRTIME,X            ;FREE ALL THE OBJECTS IN THE CLUSTER
L482F:  BPL SPLTTP_2            ;DONE
L4831:  PHA                     ;SAVE INDEX
L4832:  LDA #$7F
L4834:  STA SRTIME,X            ;RELEASE AS BIG OBJECT WITH MAX TIME
L4837:  PLA                     ;RETRIEVE INDEX
L4838:  LSR A                   ;COMPUTE THE LINK VALUE
L4839:  AND #$0F                ;MASK
L483B:  TAX                     ;X NOW HAS LINK TO NEXT OBJECT
L483C:  BPL SPLTTP_3            ;(ALWAYS)

SPLTTP_1:
L483E:  LSR A                   ;PUT SIZE BIT INTO CARRY
L483F:  BCS SPLTTP_4            ;ITS A BIG ONE
L4841:  LDA #$00
L4843:  STA SRTIME,X            ;DE-ACTIVATE CONTROL BYTE
L4846:  LDA #$20
L4848:  JSR GPTS                ;($48B2) GIVE 'EM 200 POINTS
L484B:  JSR DIASND              ;($49A4) GIVE SOUND FOR DIAMOND

SPLTTP_2:
L484E:  LDX TEMP3               ;RESTORE X
L4850:  RTS                     ;EXIT

SPLTTP_4:
L4851:  LDA #$10                ;GIVE 'EM 200
L4853:  STX XT                  ;SAVE X
L4855:  JSR GPTS                ;($48B2)
L4858:  JSR SEARCH              ;($6D6C) FIND A FREE ENTRY
L485B:  JSR CPYPOS              ;($6210) COPY POSITION PARAMETERS
L485E:  INC NROCKS              ;ADD 1 TO TOTAL OBJECTS
L4861:  INC SPROCK              ;ADD 1 TO SPECIAL COUNT
L4864:  LDA XT                  ;GET CONTROL BYTE INDEX
L4866:  ASL A
L4867:  ASL A
L4868:  ORA #$42                ;SAY ITS A SPECIAL ROCK BUT A SMALL ONE
L486A:  STA OBJ,X
L486D:  STX R0                  ;SAVE X
L486F:  LDX XT                  ;POINT TO CONTROL BYTE
L4871:  LDA #$7E
L4873:  STA SRTIME,X
L4876:  LDA ANGLE
L4878:  ADC #$20                ;POINT IT AWAY APPROX 45 DEGREES
L487A:  STA SRANG,X
L487D:  JSR FREESR              ;($48A7) FIND A FREE SPECIAL ROCK ENTRY
L4880:  STX XT                  ;SAVE ENTRY POINTER
L4882:  LDX R0                  ;POINT TO OBJ
L4884:  JSR SEARC1              ;($6D6E) LOOK FOR NEXT FREE OBJ
L4887:  JSR CPYPOS              ;($6210) MOVE POSITION PARAMETERS
L488A:  INC NROCKS              ;ADD 1 TO TOTAL OBJECT COUNT
L488D:  LDA XT                  ;GET LINK TO SPECIAL
L488F:  ASL A
L4890:  ASL A
L4891:  ORA #$42
L4893:  STA OBJ,X               ;SELECT SPECIAL ROCK
L4896:  LDX XT                  ;POINT TO SPECIAL CONTROLS
L4898:  LDA #$7E                ;ACTIVATE OBJECT
L489A:  STA SRTIME,X
L489D:  LDA ANGLE
L489F:  SBC #$20                ;POINT AWAY APPROX 45 DEGREES
L48A1:  STA SRANG,X
L48A4:  LDX TEMP3               ;RESTORE X
L48A6:  RTS                     ;EXIT

FREESR:
; [note] Find a free special-rock control entry, 6 down to 0; $FF if none
L48A7:  LDX #$06                ;MAXIMUM # OF SPECIAL ROCKS ALLOWED

FREESR_2:
L48A9:  LDA SRTIME,X            ;FIND AN EMPTY SLOT
L48AC:  BEQ TRIROT_RTS_0        ;GOT ONE
L48AE:  DEX
L48AF:  BPL FREESR_2            ;KEEP LOOKING

TRIROT_RTS_0:
; placed by hand: TRIROT.MAC:214 `RTS.0: RTS`, FREESR's exit. A bare RTS matches at every RTS in the ROM, so the order prune drops it. DSTRD0.MAC has its own RTS.0 (placed at $669C as DSTRD0_RTS.0); qualified by module the same way
L48B1:  RTS

GPTS:
; [note] Award points for a hit, but not when the saucer made it
L48B2:  LDX TEMP3
L48B4:  BEQ GPTS_1              ;SHIP. GIVE POINTS
L48B6:  CPX #$04                ;SHIP'S TORPEDOES?
L48B8:  BCC TRIROT_RTS_0        ;NO. NO POINTS

GPTS_1:
L48BA:  CLC
L48BB:  JMP POINTS              ;($6C60) GIVE POINTS

;------------------------------------------[ ATTACK SHIP ]------------------------------------------

ATTACK:
; [note] Steer special rock X toward the ship
L48BE:  STX R0                  ;SAVE X
L48C0:  LDY #$19                ;ASSUME WE WILL TRACK SHIP
L48C2:  STY R1                  ;INIT R1 FOR LATER
L48C4:  INC R9                  ;COUNT ATTACKING ENEMY
L48C6:  LDA OBJ,X               ;GET PIX CODE
L48C9:  LSR A
L48CA:  LSR A
L48CB:  AND #$0F
L48CD:  TAX                     ;POINT TO CONTROL BYTE
L48CE:  LDY SRTIME,X            ;GET CONTROL
L48D1:  CPY #$04                ;TIMED OUT?
L48D3:  BCC ATTACK_2            ;YEP. TRACK TO EDGE
L48D5:  LDA FRAME
L48D7:  AND #$0F                ;TIME OUT ?
L48D9:  BNE ATTACK_3            ;NOT HERE
L48DB:  TYA                     ;GET TIME
L48DC:  SEC
L48DD:  SBC #$02                ;TIME DOWN
L48DF:  STA SRTIME,X

ATTACK_3:
L48E2:  LDA SHPPIX              ;SHIP VISIBLE?
L48E5:  BEQ ATTACK_7            ;NOPE. FORCE A TIME OUT
L48E7:  BPL ATTACK_4            ;VISIBLE BUT BLOWING UP

ATTACK_7:
L48E9:  TYA                     ;GET CONTROL
L48EA:  AND #$01                ;KEEP SIZE
L48EC:  ORA #$02                ;AND A MINIMUM TIME (KEEPS IT .NE.)
L48EE:  STA SRTIME,X

ATTACK_2:
L48F1:  INC R1                  ;TRACK ON SNOW FLAKE

ATTACK_4:
L48F3:  LDY R1
L48F5:  STX XT                  ;SAVE X
L48F7:  LDX R0                  ;POINT TO POSITION PARAMETERS
L48F9:  JSR CPUTD               ;($4A1A)
L48FC:  JSR RTST                ;($49F5) DO RANGE
L48FF:  STA R3                  ;SAVE X DIFFERENCE
L4901:  LDA TEMP2
L4903:  STA R2
L4905:  LDA R1
L4907:  CLC
L4908:  ADC #$21                ;SKIP TO Y PARAMETERS
L490A:  TAY
L490B:  TXA
L490C:  ADC #$21
L490E:  TAX
L490F:  JSR CPUTD               ;($4A1A) COMPUTE Y DISTANCE
L4912:  JSR RTST                ;($49F5) RANGE IT
L4915:  JSR SCALER              ;($4A2A) SCALE IT, GET ARCTAN
L4918:  LDX XT                  ;RESTORE X
L491A:  STA R2                  ;SAVE ANGLE
L491C:  LDY #$19
L491E:  CPY R1                  ;TRACKING ON SHIP?
L4920:  BNE ATTACK_21           ;NO. ALWAYS TURN
L4922:  EOR #$80                ;FLIP IT 180
L4924:  SBC ANGLE               ;SEE HOW IT COMPARES WITH SHIP'S ANGLE
L4926:  BPL ATTACK_20
L4928:  EOR #$FF

ATTACK_20:
L492A:  CMP #$10                ;DON'T TURN IF SHIP IS POINTING AT ENEMY
L492C:  BCS ATTACK_21           ;GO AHEAD AND TURN
L492E:  LDA R2                  ;GET ANGLE
L4930:  SBC SRANG,X
L4933:  BPL ATTACK_22
L4935:  EOR #$FF

ATTACK_22:
L4937:  CMP #$40                ;IS OBJECT POINTING AT SHIP
L4939:  BCC ATTACK_18           ;YES. DON'T TURN

ATTACK_21:
L493B:  LDA R2                  ;RETRIEVE ANGLE
L493D:  SEC
L493E:  SBC SRANG,X             ;GET ABS(TARGET-CURRENT)
L4941:  STA R2                  ;SAVE SIGN
L4943:  BPL ATTACK_11           ;OK
L4945:  EOR #$FF                ;NEGATE IT

ATTACK_11:
L4947:  CMP #$08                ;DIFFERENCE > 8?
L4949:  BCC ATTACK_18           ;NOPE. DON'T TURN
L494B:  LDA #$01                ;PREPARE FOR SLOW TURN
L494D:  LDY #$19
L494F:  CPY R1                  ;TRACKING ON SHIP?
L4951:  BNE ATTACK_12           ;NO. SLOW TURNS
L4953:  LDX R9                  ;GET OBJ #
L4955:  CPX #$07                ;LIMIT IT
L4957:  BCC ATTACK_17
L4959:  LDX #$00

ATTACK_17:
L495B:  LDA AVEL,X              ;GET ANGULAR VELOCITY
L495E:  LDX XT                  ;RESTORE X

ATTACK_12:
L4960:  ASL R2                  ;GET SIGN
L4962:  BCC ATTACK_16           ;+
L4964:  EOR #$FF                ;NEGATE IT (CARRY SET FROM ABOVE)

ATTACK_16:
L4966:  ADC SRANG,X
L4969:  STA SRANG,X

ATTACK_18:
L496C:  LDA BINSCR
L496E:  ASL A
L496F:  CMP #$10                ;MAX IT OUT
L4971:  BCC ATTACK_19
L4973:  LDA #$0F

ATTACK_19:
L4975:  ADC #$1C                ;MINIMUM VELOCITY
L4977:  STA R1
L4979:  PHA
L497A:  LDA SRANG,X
L497D:  JSR COS                 ;($7134) GET COS(ANGLE)
L4980:  JSR MULT                ;($49B3)
L4983:  LDX R0                  ;RESTORE X
L4985:  STA XINC,X              ;SUPPLY NEW X INCREMENT
L4988:  PLA
L4989:  STA R1
L498B:  LDX XT
L498D:  LDA SRANG,X
L4990:  JSR SIN                 ;($7137)
L4993:  JSR MULT                ;($49B3)
L4996:  LDX R0
L4998:  STA YINC,X
L499B:  RTS

AVEL:
L499C:  .byte $01, $02, $03, $03, $03, $04, $04 ;.......

CKSUM0:
L49A3:  .byte $BA               ;.

DIASND:
; [note] Play the diamond sound when the last special rock of a cluster goes
L49A4:  DEC SPROCK
L49A7:  BNE DIASND_1            ;NOT LAST ONE
L49A9:  TYA                     ;SAVE Y
L49AA:  PHA
L49AB:  LDY #$3F                ;DIAMOND NOISE
L49AD:  JSR SNDON               ;($775B) START IT
L49B0:  PLA
L49B1:  TAY                     ;RESTORE AND EXIT

DIASND_1:
L49B2:  RTS

;-------------------------------------------[ MULTIPLY ]--------------------------------------------

MULT:
; AT EXIT:
; (A)=PRODUCT (SIGNED)
; Y,R1,R2,R3 DESTROYED
L49B3:  TAY                     ;SET CONDITION CODES
L49B4:  BPL MULT_1
L49B6:  EOR #$FF
L49B8:  CLC
L49B9:  ADC #$01

MULT_1:
L49BB:  STA R2
L49BD:  LDA #$00                ;INITIALIZE PRODUCT
L49BF:  STA R3

MULT_5:
L49C1:  ASL R1                  ;CHECK BIT
L49C3:  BCS MULT_2              ;ADD IT IN
L49C5:  BNE MULT_3              ;STILL SOME BITS LEFT

MULT_6:
L49C7:  LDA R3                  ;GET PRODUCT
L49C9:  CPY #$00                ;TEST SIGN AND SET CARRY
L49CB:  BPL MULT_4              ;OK
L49CD:  EOR #$FF                ;NEGATE PRODUCT
L49CF:  ADC #$00

MULT_4:
L49D1:  RTS

MULT_2:
L49D2:  LDA R3                  ;ACCUMULATE PRODUCT
L49D4:  CLC
L49D5:  ADC R2
L49D7:  STA R3

MULT_3:
L49D9:  LSR R2                  ;ADJUST MULTIPLICAND
L49DB:  BNE MULT_5              ;(MOST OF THE TIME WE SHOULD BRANCH)
L49DD:  BEQ MULT_6

;---------------------------------------[ DISTANCE HANDLERS ]---------------------------------------

RANGE:
; [note] Wrap a 16-bit position difference the short way round the screen
L49DF:  CMP #$10
L49E1:  BCC RANGE_1             ;OK
L49E3:  CMP #$F0
L49E5:  BCS RANGE_1             ;OK
L49E7:  STA R5                  ;SAVE HI BYTE

RANGE_4:
L49E9:  LDA #$00
L49EB:  SEC
L49EC:  SBC TEMP2               ;(TEMP2,A) = 0 - (TEMP2,A)
L49EE:  STA TEMP2
L49F0:  LDA #$00
L49F2:  SBC R5

RANGE_1:
L49F4:  RTS

RTST:
; [note] RANGE with the difficulty hook: is object X within range?
L49F5:  CMP #$04                ;1/8 SCREEN AWAY
L49F7:  BCC RANGE_1             ;NO
L49F9:  CMP #$FC
L49FB:  BCS RANGE_1
L49FD:  LDY BINSCR
L49FF:  CPY #$05                ;SCORE>40,000?
L4A01:  BCC RANGE               ;NO. BE EASY
L4A03:  LDY R9
L4A05:  CPY #$03                ;MORE THAN 2 ENEMIES?
L4A07:  BCC RANGE               ;NO. BE EASY
L4A09:  STA R5                  ;SAVE ACC
L4A0B:  TXA                     ;GET OBJ INDEX
L4A0C:  CPX #$21                ;CHECKING X?
L4A0E:  BCS RTST_2              ;NO
L4A10:  LSR A

RTST_2:
L4A11:  LSR A
L4A12:  ROR A                   ;PUT X/Y BIT INTO BIT 7
L4A13:  EOR R5                  ;GET SIGN OF DIFFERENCE MODIFIED BY X/Y BIT
L4A15:  BMI RANGE_4             ;NEGATE DIFFERNECE
L4A17:  LDA R5                  ;RESTORE ACC
L4A19:  RTS                     ;AND EXIT

CPUTD:
; [note] 16-bit position difference, object Y minus object X
L4A1A:  LDA OBJXL,Y             ;COMPUTE 16 BIT DIFFERENCE
L4A1D:  SEC
L4A1E:  SBC OBJXL,X
L4A21:  STA TEMP2
L4A23:  LDA OBJXH,Y
L4A26:  SBC OBJXH,X
L4A29:  RTS                     ;DONE

SCALER:
; [note] Normalise two differences, then take the angle between them
L4A2A:  STA R4                  ;SAVE HIGH Y DIFFERENCE
L4A2C:  BPL SCALER_1
L4A2E:  JSR COMP                ;($70EC)

SCALER_1:
L4A31:  STA R5                  ;SAVE ABS
L4A33:  LDA R3                  ;GET HI X
L4A35:  BPL SCALER_2
L4A37:  JSR COMP                ;($70EC)

SCALER_2:
L4A3A:  ORA R5                  ;MERGE ABS(X) OR ABS(Y)
L4A3C:  LDX #$07                ;INITIALIZE X

SCALER_4:
L4A3E:  ASL A                   ;FIND POSITION OF MSB
L4A3F:  BMI SCALER_3
L4A41:  DEX
L4A42:  BNE SCALER_4            ;UNTIL ALL 8 TESTED

SCALER_3:
L4A44:  CPX #$04                ;DIRECTION
L4A46:  BCS SCALER_7            ;SHIFT LEFT

SCALER_5:
L4A48:  LSR R3                  ;SHIFT DIFFERENCE RIGHT N PLACES
L4A4A:  ROR R2
L4A4C:  LSR R4
L4A4E:  ROR TEMP2
L4A50:  DEX
L4A51:  BPL SCALER_5
L4A53:  LDX R2                  ;PASS X DIFFERENCE
L4A55:  LDY TEMP2               ;PASS Y DIFFERENCE

SCALER_6:
L4A57:  JMP ATAN                ;($70D4)

SCALER_7:
L4A5A:  ASL R2                  ;SHIFT DIFFERENCE LEFT UNTIL BIT 15  IS SIGN
L4A5C:  ROL R3
L4A5E:  ASL TEMP2
L4A60:  ROL R4
L4A62:  INX
L4A63:  CPX #$07
L4A65:  BCC SCALER_7
L4A67:  LDX R3                  ;PASS X DIFFERENCE
L4A69:  LDY R4                  ;PASS Y DIFFERENCE
L4A6B:  BCS SCALER_6            ;(ALWAYS)

;------------------------------------[ ENEMY PICTURE HANDLERS ]-------------------------------------

TRIPIX:
; [note] Draw the special rock's picture
L4A6D:  LSR A
L4A6E:  LSR A
L4A6F:  LSR A
L4A70:  AND #$0F
L4A72:  TAX                     ;POINT TO CONTROL BYTE
L4A73:  LDA SRTIME,X            ;GET CONTROL
L4A76:  LSR A                   ;PUT SIZE INTO BIT 6
L4A77:  LDA #$00
L4A79:  ROR A
L4A7A:  ROR A
L4A7B:  STA R1                  ;SAVE IT
L4A7D:  LDA SRANG,X             ;GET ORIENTATION
L4A80:  LSR A
L4A81:  LSR A                   ;MAKE IT AN INDEX TO 1 OF 32 WORDS
L4A82:  BIT R1                  ;BIG PIX?
L4A84:  BVC TRIPIX_1            ;NOPE
L4A86:  AND #$1E                ;YEP. ZAP THE MSB

TRIPIX_1:
L4A88:  AND #$3E                ;ZAP BIT 0
L4A8A:  ORA R1                  ;MAKE IT INDEX INTO FRM JSRLS IF BIG
L4A8C:  TAY
L4A8D:  LDX TFPIX+1,Y           ;GET MSB OF JSRL
L4A90:  LDA TFPIX,Y             ;GET LSB OF JSRL
L4A93:  JMP VGADD2              ;($7CCC) STUF IT INTO VG RAM AND EXIT

;-------------------------------[ SETTIP INITIALISE SPECIAL CLUSTER ]-------------------------------

SETTIP:
; [note] Set up a special-rock cluster
L4A96:  LDA DIFCTY
L4A99:  LSR A
L4A9A:  CMP NROCKS              ;TOO MANY ROCKS?
L4A9D:  BCS SETTIP_1            ;NO

SETTIP_2:
L4A9F:  RTS                     ;TOO MANY ROCKS

SETTIP_1:
L4AA0:  LDA SROCKS              ;ONLY COME OUT AFTER 2ND WAVE
L4AA3:  CMP #$02
L4AA5:  BCC SETTIP_2
L4AA7:  LDX SPROCK              ;ALREADY HAVE SPECIALS?
L4AAA:  BNE SETTIP_2            ;YEP. DON'T LAUNCH ANYMORE
L4AAC:  LDY NROCKS              ;GET NUMBER OF ACTIVE OBJECTS

SETTIP_6:
L4AAF:  LDA OBJ,X               ;SEARCH FOR ACTIVE BUT NOT EXPLODING OBJECT
L4AB2:  BNE SETTIP_7            ;ACTIVE OR EXPLODING
L4AB4:  STX R0                  ;SAVE HIGHEST INDEX TO FREE OBJECT

SETTIP_7:
L4AB6:  BPL SETTIP_8            ;NOT EXPLODING
L4AB8:  DEY                     ;EXPLODING. DON'T COUNT IT

SETTIP_8:
L4AB9:  INX                     ;NEXT OBJ
L4ABA:  CPX #$19                ;LIMIT?
L4ABC:  BCC SETTIP_6            ;NOPE
L4ABE:  LDX PLAYR               ;POINT TO PLAYER
L4AC0:  LDA TRILE,X             ;LAUNCHED ANY THIS WAVE?
L4AC2:  BEQ SETTIP_9            ;NO. DO IT ANYWAY
L4AC4:  CPY #$03                ;FEWER THAN 3 ITEMS?
L4AC6:  BCC SETTIP_2            ;YES. DON'T LAUNCH

SETTIP_9:
L4AC8:  LDY #$1A                ;POINT TO SAUCER VELOCITIES
L4ACA:  STY TRILE,X             ;SET TRILE .NE. FOR NEXT TIME
L4ACC:  LDX R0                  ;POINT TO FREE OBJ
L4ACE:  JSR RNDPOS              ;($6A03) GET POSITION AND VELOCITY
L4AD1:  JSR RNDXYI              ;($4B3D) GET RANDOM VELOCITY
L4AD4:  LDY #$02
L4AD6:  STY HSSND               ;SIGNAL TO MAKE NOISE WHEN CHANNEL AVAIL

SETTIP_5:
L4AD8:  TYA                     ;GET LINK
L4AD9:  ASL A                   ;MOVE IT 2 BITS LEFT
L4ADA:  ASL A
L4ADB:  ORA #$42                ;SAY SPECIAL AND MEDIUM SIZE
L4ADD:  STA OBJ,X               ;SET UP
L4AE0:  INC NROCKS              ;COUNT OBJ
L4AE3:  INC SPROCK
L4AE6:  LDA ITIME,Y             ;GET INITIAL CONTROL DATA
L4AE9:  STA SRTIME,Y            ;PASS IT
L4AEC:  LDA IANG,Y              ;GET INITIAL ANGLE
L4AEF:  STA SRANG,Y
L4AF2:  LDA ITXL,Y              ;GET INTIAL POSITION OFFSET
L4AF5:  CLC
L4AF6:  ADC OBJXL,X             ;ADD IT IN
L4AF9:  STA OBJXL,X
L4AFC:  LDA ITXH,Y
L4AFF:  ADC OBJXH,X
L4B02:  STA OBJXH,X
L4B05:  LDA ITYL,Y
L4B08:  CLC
L4B09:  ADC OBJYL,X
L4B0C:  STA OBJYL,X
L4B0F:  LDA ITYH,Y
L4B12:  ADC OBJYH,X
L4B15:  STA OBJYH,X
L4B18:  DEY                     ;COUNT DOWN
L4B19:  BMI SETTIP_2            ;DONE
L4B1B:  STX R0                  ;SAVE CURRENT INDEX
L4B1D:  JSR SEARC1              ;($6D6E) GET NEXT FREE SPACE
L4B20:  STY R1                  ;SAVE Y
L4B22:  LDY R0                  ;POINT TO OLD SPACE
L4B24:  JSR CPYPOS              ;($6210) COPY POSITION PARAMETERS
L4B27:  LDY R1                  ;RESTORE Y
L4B29:  BPL SETTIP_5            ;(ALWAYS)

ITXL:
L4B2B:  .byte $00, $58, $70     ;.Xp

ITXH:
L4B2E:  .byte $00, $FF, $00     ;...

ITYL:
L4B31:  .byte $40, $50, $00     ;@P.

ITYH:
L4B34:  .byte $FF, $00, $00     ;...

ITIME:
L4B37:  .byte $83, $85, $81     ;...

IANG:
L4B3A:  .byte $F0, $98, $40     ;..@

RNDXYI:
; [note] Add a random +/-6 to each axis
L4B3D:  JSR RNDXYI_1            ;($4B43) DO THE FOLLOWING TWICE
L4B40:  STA XINC,X              ;SET UP X

RNDXYI_1:
L4B43:  LDY #$06                ;ASSUME +
L4B45:  LDA RANDOM              ;GET RANDOM #
L4B48:  BPL RNDXYI_2            ;TRUE
L4B4A:  LDY #$FA                ;ELSE SET -

RNDXYI_2:
L4B4C:  TYA
L4B4D:  STA YINC,X
L4B50:  RTS

SINCOS:
L4B51:  .byte $00, $03, $06, $09, $0C, $10, $13, $16 ;........
L4B59:  .byte $19, $1C, $1F, $22, $25, $28, $2B, $2E ;..."%(+.
L4B61:  .byte $31, $33, $36, $39, $3C, $3F, $41, $44 ;1369<?AD
L4B69:  .byte $47, $49, $4C, $4E, $51, $53, $55, $58 ;GILNQSUX
L4B71:  .byte $5A, $5C, $5E, $60, $62, $64, $66, $68 ;Z\^`bdfh
L4B79:  .byte $6A, $6B, $6D, $6F, $70, $71, $73, $74 ;jkmopqst
L4B81:  .byte $75, $76, $78, $79, $7A, $7A, $7B, $7C ;uvxyzz{|
L4B89:  .byte $7D, $7D, $7E, $7E, $7E, $7F, $7F, $7F ;}}~~~...
L4B91:  .byte $7F               ;.

;----------------------------------[ DSTROT ASTEROIDS ROTATIONS ]-----------------------------------

ROTAST:
; [note] Rewrite one rock subroutine in vector RAM (the rocks' rotation)
L4B92:  LDA FRAME               ;GET INDEX
L4B94:  AND #$03
L4B96:  TAX
L4B97:  CLC
L4B98:  ADC #$FE                ;COMPUTE ROTATION VELOCITY
L4B9A:  ADC ASTERS,X            ;ROTATE THE ROCK
L4B9C:  STA ASTERS,X            ;ACC = XXQQPPPX
L4B9E:  AND #$F0                ;CPXROT ROUTINE NEEDS ACC TO = QQQPPPXX
L4BA0:  CLC                     ;SO WE SHIFT THE QQ 1 BIT LEFT AND INSERT A
L4BA1:  ADC ASTERS,X
L4BA3:  ASL A                   ;ACC = QQ0PPPXX
L4BA4:  JSR CPXROT              ;($6EE2) COMPUTE INDEX INTO VECTOR TABLES
L4BA7:  LDA RSOURC,Y            ;Y INDEXES INTO THE TABLE OF
L4BAA:  STA R0                  ;ADDRESSES THAT POINT TO THE LIST OF VECTORS
L4BAC:  LDA RSOURC+1,Y          ;PERTAINING TO THE PICTURE. THE APPROPRIATE
L4BAF:  STA R1                  ;ADDRESS IS COPIED INTO R0,R1.
L4BB1:  TXA                     ;TO ADD VARIETY, 2 OF THE 4 ROCK PICTURES ARE
L4BB2:  ASL A                   ;DISPLAYED IN A MIRROR IMAGE FORMAT. THESE
L4BB3:  TAX                     ;INSTRUCTIONS BOTH ADJUST THE ROCK PICTURE
L4BB4:  ASL A                   ;CODE TO ADDRESS WORDS AND APPLIES THE
L4BB5:  AND #$04                ;MIRROR IMAGE. THE MIRRORING IS
L4BB7:  EOR TEMP1               ;DETERMINED BY THE CODE.
L4BB9:  STA TEMP1
L4BBB:  LDA ROCKSA,X            ;GET LSB OF JSRL
L4BBE:  ASL A                   ;MAKE IT A BYTE ADDRESS
L4BBF:  STA VGLIST
L4BC1:  LDA ROCKSA+1,X
L4BC4:  ROL A
L4BC5:  EOR #$C0                ;DROP BIT 15 AND SET BIT 14
L4BC7:  STA $04
L4BC9:  LDX #$0C                ;GET COUNT OF VECTORS
L4BCB:  JSR CPYVEC              ;($6246) MOVE VECTORS, MODIFYING AS REQUIRED
L4BCE:  JMP VGRTSL              ;($79E8) STUFF IN AN RTSL/RECURSE OR EXIT AS REQUIRED

;-------------------------------[ CHKST-CHECK FOR START/END OF GAME ]-------------------------------

CHKST:
; EXIT	(C)=SET IF STARTING A NEW GAME
L4BD1:  LDA NPLAYR
L4BD3:  BEQ CHKST_10            ;GAME NOT IN PROGRESS
L4BD5:  LDA GDELAY
L4BD7:  BNE CHKST_60            ;STAY READY MODE
L4BD9:  JMP CHKST1              ;($4CFE) WE ARE NOT IN PLAYER READY MODE

CHKST_60:
L4BDC:  DEC GDELAY
L4BDE:  JSR CHKST2              ;($6102) DISPLAY PLAYER NUMBER MESSAGE

CHKST_30:
L4BE1:  CLC
L4BE2:  RTS

CHKST_10:
L4BE3:  STA R3                  ;2 COIN MINIMUM FLAG
L4BE5:  LDA CMODE               ;GET PRICE CODE
L4BE7:  AND #$03                ;FREE PLAY?
L4BE9:  BNE CHKST_35            ;NOPE
L4BEB:  LDA #$02                ;ALWAYS HAVE 2 CREDITS
L4BED:  STA CRDT
L4BEF:  BNE CHKST_15            ;(ALWAYS)

CHKST_35:
L4BF1:  CLC
L4BF2:  ADC #$07
L4BF4:  TAY
L4BF5:  LDA UPDFLG              ;UPDATING HI-SCORE?
L4BF7:  AND $43
L4BF9:  BPL CHKST_15            ;YES. NO MESSAGE
L4BFB:  JSR VGMSG               ;($718F) GAME PRICE
L4BFE:  LDA CRDT
L4C00:  CMP #$40                ;BAD VALUE?

CHKST_CRAPOUT:
; placed by hand: DSTRD0.MAC:311 `BCS .  ;YES. CRAP OUT`. The source branches to itself without a label; NAMED here for its comment. Spins until the watchdog resets the board
L4C02:  BCS CHKST_CRAPOUT       ;YES. CRAP OUT
L4C04:  STA R0                  ;SAVE IT
L4C06:  LDY #$0B                ;CREDIT MESSAGE
L4C08:  JSR VGMSG               ;($718F)
L4C0B:  LDX #$00                ;CLEAR PRODUCT
L4C0D:  STX R1
L4C0F:  INX                     ;LDX #1
L4C10:  STX R2                  ;CONVERTER
L4C12:  SED                     ;DO THE FOLLOWING IN DECIMAL MODE

CHKST_19:
L4C13:  LSR R0                  ;GET DATA BIT
L4C15:  BCC CHKST_17            ;DON'T HAVE ONE
L4C17:  LDA R1                  ;ACCUMULATE IT
L4C19:  CLC
L4C1A:  ADC R2
L4C1C:  STA R1

CHKST_17:
L4C1E:  BEQ CHKST_18            ;DONE
L4C20:  LDA R2                  ;DOUBLE CONVERTER VALUE
L4C22:  ADC R2                  ;(CARRY S/B CLEAR HERE)
L4C24:  STA R2
L4C26:  BCC CHKST_19            ;(ALWAYS)

CHKST_18:
L4C28:  CLD                     ;BACK TO BINARY MODE
L4C29:  LDX #$00                ;NO INTENSITY CHANGE
L4C2B:  LDY #$01                ;1 BYTE TO DISPLAY
L4C2D:  LDA #$11                ;DISPLAY VALUE IN R2
L4C2F:  SEC                     ;ZERO SUPPRESS
L4C30:  JSR DIGITS              ;($7C98)
L4C33:  LDA CMODE               ;GET COIN MODES
L4C35:  AND #$03                ;ISOLATE PRICE
L4C37:  CMP #$03                ;50 CENT PLAY?
L4C39:  BNE CHKST_15            ;NO. NEVER MIND
L4C3B:  LDA CNCT
L4C3D:  LSR A                   ;ANY 1/2 CREDITS?
L4C3E:  BCC CHKST_15            ;NO
L4C40:  LDA #$20                ;YES. GET JSRL Z.5
L4C42:  LDX #$CB
L4C44:  JSR VGADD2              ;($7CCC) DRAW IN A 1/2

CHKST_15:
L4C47:  LDY #$06                ;ASSUME 'PUSH START'
L4C49:  LDX CRDT                ;CREDIT?
L4C4B:  BNE CHKST_16            ;YEP
L4C4D:  STX TWOCM               ;RESET 2 COIN MIN FLAG

CHKST_16:
L4C4F:  LDA OPTN2
L4C52:  LSR A                   ;2 COIN MINIMUM OPTION?
L4C53:  BCC CHKST_14            ;NO
L4C55:  BIT TWOCM               ;MINIMUM MET?
L4C57:  BMI CHKST_14            ;YEP
L4C59:  CPX #$01                ;2 OR MORE CREDITS?
L4C5B:  BCC CHKST_13            ;0 CREDITS
L4C5D:  BNE CHKST_14            ;2 OR MORE
L4C5F:  ROR R3                  ;1 CREDIT (CARRY=1)

CHKST_13:
L4C61:  LDY #$0C                ;POINT TO '2 COIN MINIMUM' MESSAGE
L4C63:  BNE CHKST_21

CHKST_14:
L4C65:  LDA #$FF
L4C67:  STA TWOCM               ;SIGNAL MINIMUM MET
L4C69:  CPY #$0C                ;2 COIN MIN MESSAGE?
L4C6B:  BNE CHKST_12            ;NO

CHKST_21:
L4C6D:  JSR BM                  ;($4CEF) DISPLAY MESSAGE

CHKST_11:
L4C70:  CLC
L4C71:  LDA #$00
L4C73:  STA LOUT1               ;NO LAMPS
L4C75:  RTS                     ;BUT DON'T START

CHKST_12:
L4C76:  TXA                     ;ANY CREDITS?
L4C77:  BEQ CHKST_11            ;NO DON'T START
L4C79:  JSR BM                  ;($4CEF) BLINK 'PRESS START'
L4C7C:  LDY CRDT                ;GET CREDITS
L4C7E:  LDX #$01
L4C80:  LDA STRT1
L4C83:  BMI CHKST_20            ;ONE PLAYER START
L4C85:  CPY #$02
L4C87:  BCC CHKST_40            ;ONLY 1 CREDIT
L4C89:  LDA STRT2
L4C8C:  BPL CHKST_40            ;NO START YET
L4C8E:  STA BNKSEL              ;SWITCH TO PLAYER 2
L4C91:  JSR RTS_4_42            ;($4CE6) START EA ROM
L4C94:  JSR INIT                ;($7BF5) REINITIALIZE MEMORY
L4C97:  JSR NEWAST              ;($698E) NEW ASTEROIDS
L4C9A:  JSR NEWSHP              ;($6A37) PUT SHIP IN MIDDLE
L4C9D:  LDA NHITS
L4C9F:  STA $70                 ;ENABLE 2ND PLAYER
L4CA1:  LDX #$02
L4CA3:  DEC CRDT                ;ONE CREDIT LESS

CHKST_20:
L4CA5:  STX NPLAYR              ;NUMBER OF PLAYERS
L4CA7:  DEC CRDT                ;ONE CREDIT LESS
L4CA9:  STX BNKSEL              ;PLAYER 1
L4CAC:  STX LOUT1               ;SET LAMP CODE
L4CAE:  JSR RTS_4_42            ;($4CE6) CHECK FOR EA START
L4CB1:  JSR INIT                ;($7BF5) INITIALIZE MEM
L4CB4:  JSR NEWSHP              ;($6A37) PUT SHIP IN MIDDLE
L4CB7:  LDA #$80
L4CB9:  STA GDELAY
L4CBB:  ASL A                   ;LDA I,0 SETS CARRY TOO
L4CBC:  STA PLAYR
L4CBE:  STA PLAYR2
L4CC0:  STA PLAYR3
L4CC2:  STA BC                  ;RESET BONUS ACCUMULATOR
L4CC4:  STA BCCNT               ;RESET BONUS COUNTER
L4CC6:  LDA NHITS
L4CC8:  STA HITS                ;NUMBER OF HITS ALLOWED
L4CCA:  LDA #$04
L4CCC:  STA THUMP2
L4CCE:  STA NRESET              ;RESET NOISE GENERATOR
L4CD1:  RTS                     ;EXIT WITH CARRY SET

CHKST_40:
L4CD2:  LDA FRAME
L4CD4:  AND #$0F
L4CD6:  BNE CHKST_45            ;DO NOT CHANGE LITE
L4CD8:  LDA #$01                ;ASSUME 2 PLAYER
L4CDA:  CMP CRDT                ;MORE THAN 1 CREDIT?
L4CDC:  BEQ CHKST_46            ;NO
L4CDE:  LDA #$03                ;YES

CHKST_46:
L4CE0:  EOR LOUT1
L4CE2:  STA LOUT1               ;LET NMI WRITE TO OUT1

CHKST_45:
L4CE4:  CLC

RTS_4:
; [note] Shared return
L4CE5:  RTS

RTS_4_42:
L4CE6:  LDA UPDFLG              ;ANY HI-SCORES?
L4CE8:  AND $43
L4CEA:  BMI CHKST_45            ;NO
L4CEC:  JMP STEAROM             ;($7BD9) YES. START EA ROM

BM:
; [note] Blink the two-coin-minimum message
L4CEF:  LDA TWOCM
L4CF1:  ORA R3
L4CF3:  BPL BM_1                ;DON'T BLINK
L4CF5:  LDA FRAME
L4CF7:  AND #$20                ;ON/OFF
L4CF9:  BNE RTS_4               ;OFF

BM_1:
L4CFB:  JMP VGMSG               ;($718F)

CHKST1:
; [note] Game in progress: handle game over and the player change
L4CFE:  LDA FRAME
L4D00:  AND #$3F
L4D02:  BNE CHKST1_70           ;ONLY EVERY 1 SECOND
L4D04:  LDA THUMP3
L4D07:  CMP #$08
L4D09:  BEQ CHKST1_70           ;AT FASTEST RATE NOW
L4D0B:  DEC THUMP3

CHKST1_70:
L4D0E:  LDX PLAYR
L4D10:  LDA HITS,X
L4D12:  BNE CHKST1_60           ;IF HE STILL IN GAME
L4D14:  LDA SHPTP               ;ANY OF HIS MISSILES STILL FLYING?
L4D17:  ORA $021E
L4D1A:  ORA $021F
L4D1D:  ORA $0220
L4D20:  BNE CHKST1_60           ;TORPEDO STILL ALIVE
L4D22:  LDY #$07
L4D24:  JSR VGMSG               ;($718F) GAME OVER MESSAGE
L4D27:  LDA NPLAYR
L4D29:  CMP #$02
L4D2B:  BCC CHKST1_60           ;1 PLAYER GAME
L4D2D:  JSR CHKST2              ;($6102) DISPLAY PLAYER NUMBER

CHKST1_60:
L4D30:  LDA SHPPIX
L4D33:  BNE CHKST1_80           ;STILL ALIVE

CHKST1_62:
L4D35:  LDA SDELAY
L4D38:  CMP #$80
L4D3A:  BNE CHKST1_80           ;SHIP RETURNING TO LIFE
L4D3C:  LDA #$10
L4D3E:  JSR SSBTLT              ;($6325)
L4D41:  LDX NPLAYR
L4D43:  LDA HITS
L4D45:  ORA $70
L4D47:  BEQ CHKST1_90           ;GAME IS ALL OVER
L4D49:  JSR RSAUCR              ;($6826) RESET SAUCER VALUES

CHKST1_61:
L4D4C:  DEX
L4D4D:  BEQ CHKST1_80           ;ONE PLAYER NO MESSAGE NEEDED
L4D4F:  LDA #$80
L4D51:  STA GDELAY              ;DELAY BEFORE STARTING PLAYER
L4D53:  LDA PLAYR
L4D55:  EOR #$01
L4D57:  TAX                     ;1 TO 0 AND 0 TO 1
L4D58:  LDA HITS,X
L4D5A:  BEQ CHKST1_80           ;NO HITS FOR THIS PLAYER
L4D5C:  STX PLAYR               ;SET PLAYER NUMBER
L4D5E:  TXA
L4D5F:  ROR A
L4D60:  ROR A
L4D61:  STA BNKSEL              ;SWITCH PLAYERS
L4D64:  TXA
L4D65:  ASL A
L4D66:  STA PLAYR2
L4D68:  ORA PLAYR
L4D6A:  STA PLAYR3

CHKST1_80:
L4D6C:  CLC
L4D6D:  RTS

CHKST1_90:
L4D6E:  STX LPLAYR              ;SAVE NUMBER OF PLAYERS IN THIS GAME
L4D70:  LDA #$FF
L4D72:  STA NPLAYR              ;FLAG TO UPDATE HIGH SCORES
L4D74:  LDA #$03
L4D76:  STA LOUT1               ;LET NMI WRITE TO LAMPS
L4D78:  STA BNKSEL              ;PLAYER 1
L4D7B:  BNE CHKST1_80           ;(ALWAYS)

HITSCR:
; placed by hand: DSTRD0.MAC:3023 `HITSCR: .BYTE 10,5,2  ;SCORES FOR HITTING SMALL, MEDIUM & LARGE ROCKS`, parked after CHKST1 by ENTSEC/XITSEC and read by SPLIT_15 ($6FAD) as `lda $4D7D,x`. Three bytes is too short for the by-content placement to trust
L4D7D:  .byte $10, $05, $02     ;...

EXPPIC:
L4D80:  .byte $15               ;.
L4D81:  .byte $C7               ;.
L4D82:  .word $C6FA             ;JSRL EXP12 ($4DF4)
L4D84:  .word $C6DB             ;JSRL EXP14 ($4DB6)
L4D86:  .word $C6C4             ;JSRL EXP16 ($4D88)

EXP16:
L4D88:  .word $F80D             ;SVEC u=16 dx=-16 dy=0 z=0
L4D8A:  .word $F878             ;SVEC u=16 dx=0 dy=0 z=7
L4D8C:  .word $FD0D             ;SVEC u=16 dx=-16 dy=-16 z=0
L4D8E:  .word $F878             ;SVEC u=16 dx=0 dy=0 z=7
L4D90:  .word $FD09             ;SVEC u=16 dx=16 dy=-16 z=0
L4D92:  .word $F878             ;SVEC u=16 dx=0 dy=0 z=7
L4D94:  .word $F10B             ;SVEC u=8 dx=24 dy=8 z=0
L4D96:  .word $F878             ;SVEC u=16 dx=0 dy=0 z=7
L4D98:  .word $F50A             ;SVEC u=8 dx=16 dy=-8 z=0
L4D9A:  .word $F878             ;SVEC u=16 dx=0 dy=0 z=7
L4D9C:  .word $F908             ;SVEC u=16 dx=0 dy=16 z=0
L4D9E:  .word $F878             ;SVEC u=16 dx=0 dy=0 z=7
L4DA0:  .word $F309             ;SVEC u=8 dx=8 dy=24 z=0
L4DA2:  .word $F878             ;SVEC u=16 dx=0 dy=0 z=7
L4DA4:  .word $F30D             ;SVEC u=8 dx=-8 dy=24 z=0
L4DA6:  .word $F878             ;SVEC u=16 dx=0 dy=0 z=7
L4DA8:  .word $5480, $0600      ;VCTR s=5 dx=-32 dy=-8 z=0 [x16]
L4DAC:  .word $F878             ;SVEC u=16 dx=0 dy=0 z=7
L4DAE:  .word $F10F             ;SVEC u=8 dx=-24 dy=8 z=0
L4DB0:  .word $F878             ;SVEC u=16 dx=0 dy=0 z=7
L4DB2:  .word $FE0A             ;SVEC u=16 dx=32 dy=-32 z=0
L4DB4:  .word $D000             ;RTSL

EXP14:
L4DB6:  .word $3000, $0780      ;VCTR s=3 dx=-14 dy=0 z=0 [x64]
L4DBA:  .word $F878             ;SVEC u=16 dx=0 dy=0 z=7
L4DBC:  .word $3780, $0780      ;VCTR s=3 dx=-14 dy=-14 z=0 [x64]
L4DC0:  .word $F878             ;SVEC u=16 dx=0 dy=0 z=7
L4DC2:  .word $3780, $0380      ;VCTR s=3 dx=14 dy=-14 z=0 [x64]
L4DC6:  .word $F878             ;SVEC u=16 dx=0 dy=0 z=7
L4DC8:  .word $40E0, $02A0      ;VCTR s=4 dx=21 dy=7 z=0 [x32]
L4DCC:  .word $F878             ;SVEC u=16 dx=0 dy=0 z=7
L4DCE:  .word $35C0, $0380      ;VCTR s=3 dx=14 dy=-7 z=0 [x64]
L4DD2:  .word $F878             ;SVEC u=16 dx=0 dy=0 z=7
L4DD4:  .word $3380, $0000      ;VCTR s=3 dx=0 dy=14 z=0 [x64]
L4DD8:  .word $F878             ;SVEC u=16 dx=0 dy=0 z=7
L4DDA:  .word $42A0, $00E0      ;VCTR s=4 dx=7 dy=21 z=0 [x32]
L4DDE:  .word $F878             ;SVEC u=16 dx=0 dy=0 z=7
L4DE0:  .word $42A0, $04E0      ;VCTR s=4 dx=-7 dy=21 z=0 [x32]
L4DE4:  .word $F878             ;SVEC u=16 dx=0 dy=0 z=7
L4DE6:  .word $44E0, $0780      ;VCTR s=4 dx=-28 dy=-7 z=0 [x32]
L4DEA:  .word $F878             ;SVEC u=16 dx=0 dy=0 z=7
L4DEC:  .word $40E0, $06A0      ;VCTR s=4 dx=-21 dy=7 z=0 [x32]
L4DF0:  .word $F878             ;SVEC u=16 dx=0 dy=0 z=7
L4DF2:  .word $D000             ;RTSL

EXP12:
L4DF4:  .word $F807             ;SVEC u=4 dx=-12 dy=0 z=0
L4DF6:  .word $F878             ;SVEC u=16 dx=0 dy=0 z=7
L4DF8:  .word $FF07             ;SVEC u=4 dx=-12 dy=-12 z=0
L4DFA:  .word $F878             ;SVEC u=16 dx=0 dy=0 z=7
L4DFC:  .word $FF03             ;SVEC u=4 dx=12 dy=-12 z=0
L4DFE:  .word $F878             ;SVEC u=16 dx=0 dy=0 z=7
L4E00:  .word $40C0, $0240      ;VCTR s=4 dx=18 dy=6 z=0 [x32]
L4E04:  .word $F878             ;SVEC u=16 dx=0 dy=0 z=7
L4E06:  .word $3580, $0300      ;VCTR s=3 dx=12 dy=-6 z=0 [x64]
L4E0A:  .word $F878             ;SVEC u=16 dx=0 dy=0 z=7
L4E0C:  .word $FB00             ;SVEC u=4 dx=0 dy=12 z=0
L4E0E:  .word $F878             ;SVEC u=16 dx=0 dy=0 z=7
L4E10:  .word $4240, $00C0      ;VCTR s=4 dx=6 dy=18 z=0 [x32]
L4E14:  .word $F878             ;SVEC u=16 dx=0 dy=0 z=7
L4E16:  .word $4240, $04C0      ;VCTR s=4 dx=-6 dy=18 z=0 [x32]
L4E1A:  .word $F878             ;SVEC u=16 dx=0 dy=0 z=7
L4E1C:  .word $44C0, $0700      ;VCTR s=4 dx=-24 dy=-6 z=0 [x32]
L4E20:  .word $F878             ;SVEC u=16 dx=0 dy=0 z=7
L4E22:  .word $40C0, $0640      ;VCTR s=4 dx=-18 dy=6 z=0 [x32]
L4E26:  .word $F878             ;SVEC u=16 dx=0 dy=0 z=7
L4E28:  .word $D000             ;RTSL

EXP10:
L4E2A:  .word $3000, $0680      ;VCTR s=3 dx=-10 dy=0 z=0 [x64]
L4E2E:  .word $F878             ;SVEC u=16 dx=0 dy=0 z=7
L4E30:  .word $3680, $0680      ;VCTR s=3 dx=-10 dy=-10 z=0 [x64]
L4E34:  .word $F878             ;SVEC u=16 dx=0 dy=0 z=7
L4E36:  .word $3680, $0280      ;VCTR s=3 dx=10 dy=-10 z=0 [x64]
L4E3A:  .word $F878             ;SVEC u=16 dx=0 dy=0 z=7
L4E3C:  .word $3140, $03C0      ;VCTR s=3 dx=15 dy=5 z=0 [x64]
L4E40:  .word $F878             ;SVEC u=16 dx=0 dy=0 z=7
L4E42:  .word $3540, $0280      ;VCTR s=3 dx=10 dy=-5 z=0 [x64]
L4E46:  .word $F878             ;SVEC u=16 dx=0 dy=0 z=7
L4E48:  .word $3280, $0000      ;VCTR s=3 dx=0 dy=10 z=0 [x64]
L4E4C:  .word $F878             ;SVEC u=16 dx=0 dy=0 z=7
L4E4E:  .word $33C0, $0140      ;VCTR s=3 dx=5 dy=15 z=0 [x64]
L4E52:  .word $F878             ;SVEC u=16 dx=0 dy=0 z=7
L4E54:  .word $33C0, $0540      ;VCTR s=3 dx=-5 dy=15 z=0 [x64]
L4E58:  .word $F878             ;SVEC u=16 dx=0 dy=0 z=7
L4E5A:  .word $44A0, $0680      ;VCTR s=4 dx=-20 dy=-5 z=0 [x32]
L4E5E:  .word $F878             ;SVEC u=16 dx=0 dy=0 z=7
L4E60:  .word $3140, $07C0      ;VCTR s=3 dx=-15 dy=5 z=0 [x64]
L4E64:  .word $F878             ;SVEC u=16 dx=0 dy=0 z=7
L4E66:  .word $D000             ;RTSL

SAUCER:
L4E68:  .word $F10E             ;SVEC u=8 dx=-16 dy=8 z=0
L4E6A:  .word $F8CA             ;SVEC u=16 dx=32 dy=0 z=12
L4E6C:  .word $F60B             ;SVEC u=8 dx=24 dy=-16 z=0
L4E6E:  .word $6000, $D680      ;VCTR s=6 dx=-80 dy=0 z=13 [x8]
L4E72:  .word $F6DB             ;SVEC u=8 dx=24 dy=-16 z=13
L4E74:  .word $F8CA             ;SVEC u=16 dx=32 dy=0 z=12
L4E76:  .word $F2DB             ;SVEC u=8 dx=24 dy=16 z=13
L4E78:  .word $F2DF             ;SVEC u=8 dx=-24 dy=16 z=13
L4E7A:  .word $F2CD             ;SVEC u=8 dx=-8 dy=16 z=12
L4E7C:  .word $F8CD             ;SVEC u=16 dx=-16 dy=0 z=12
L4E7E:  .word $F6CD             ;SVEC u=8 dx=-8 dy=-16 z=12
L4E80:  .word $F6DF             ;SVEC u=8 dx=-24 dy=-16 z=13
L4E82:  .word $D000             ;RTSL

ROCK0:
L4E84:  .word $F009             ;SVEC u=8 dx=8 dy=0 z=0
L4E86:  .word $F17B             ;SVEC u=8 dx=24 dy=8 z=7
L4E88:  .word $F178             ;SVEC u=8 dx=0 dy=8 z=7
L4E8A:  .word $F27F             ;SVEC u=8 dx=-24 dy=16 z=7
L4E8C:  .word $F07F             ;SVEC u=8 dx=-24 dy=0 z=7
L4E8E:  .word $F679             ;SVEC u=8 dx=8 dy=-16 z=7
L4E90:  .word $F87E             ;SVEC u=16 dx=-32 dy=0 z=7
L4E92:  .word $F778             ;SVEC u=8 dx=0 dy=-24 z=7
L4E94:  .word $F77B             ;SVEC u=8 dx=24 dy=-24 z=7
L4E96:  .word $F17B             ;SVEC u=8 dx=24 dy=8 z=7
L4E98:  .word $F579             ;SVEC u=8 dx=8 dy=-8 z=7
L4E9A:  .word $F979             ;SVEC u=16 dx=16 dy=16 z=7
L4E9C:  .word $F27F             ;SVEC u=8 dx=-24 dy=16 z=7

ROCK1:
L4E9E:  .word $3080, $0200      ;VCTR s=3 dx=8 dy=2 z=0 [x64]
L4EA2:  .word $4180, $72C0      ;VCTR s=4 dx=22 dy=12 z=7 [x32]
L4EA6:  .word $3200, $7480      ;VCTR s=3 dx=-2 dy=8 z=7 [x64]
L4EAA:  .word $4160, $7740      ;VCTR s=4 dx=-26 dy=11 z=7 [x32]
L4EAE:  .word $44A0, $7700      ;VCTR s=4 dx=-24 dy=-5 z=7 [x32]
L4EB2:  .word $3780, $72C0      ;VCTR s=3 dx=11 dy=-14 z=7 [x64]
L4EB6:  .word $44C0, $77E0      ;VCTR s=4 dx=-31 dy=-6 z=7 [x32]
L4EBA:  .word $4700, $7080      ;VCTR s=4 dx=4 dy=-24 z=7 [x32]
L4EBE:  .word $4660, $73A0      ;VCTR s=4 dx=29 dy=-19 z=7 [x32]
L4EC2:  .word $41A0, $72C0      ;VCTR s=4 dx=22 dy=13 z=7 [x32]
L4EC6:  .word $3580, $7240      ;VCTR s=3 dx=9 dy=-6 z=7 [x64]
L4ECA:  .word $4260, $71A0      ;VCTR s=4 dx=13 dy=19 z=7 [x32]
L4ECE:  .word $4160, $7760      ;VCTR s=4 dx=-27 dy=11 z=7 [x32]

ROCK2:
L4ED2:  .word $2180, $0380      ;VCTR s=2 dx=7 dy=3 z=0 [x128]
L4ED6:  .word $4220, $7280      ;VCTR s=4 dx=20 dy=17 z=7 [x32]
L4EDA:  .word $2380, $7600      ;VCTR s=2 dx=-4 dy=7 z=7 [x128]
L4EDE:  .word $40C0, $7780      ;VCTR s=4 dx=-28 dy=6 z=7 [x32]
L4EE2:  .word $4540, $76C0      ;VCTR s=4 dx=-22 dy=-10 z=7 [x32]
L4EE6:  .word $36C0, $7340      ;VCTR s=3 dx=13 dy=-11 z=7 [x64]
L4EEA:  .word $45A0, $77A0      ;VCTR s=4 dx=-29 dy=-13 z=7 [x32]
L4EEE:  .word $46C0, $7120      ;VCTR s=4 dx=9 dy=-22 z=7 [x32]
L4EF2:  .word $45A0, $73E0      ;VCTR s=4 dx=31 dy=-13 z=7 [x32]
L4EF6:  .word $4220, $7280      ;VCTR s=4 dx=20 dy=17 z=7 [x32]
L4EFA:  .word $3500, $7280      ;VCTR s=3 dx=10 dy=-4 z=7 [x64]
L4EFE:  .word $4280, $7120      ;VCTR s=4 dx=9 dy=20 z=7 [x32]
L4F02:  .word $40C0, $77A0      ;VCTR s=4 dx=-29 dy=6 z=7 [x32]

ROCK3:
L4F06:  .word $2200, $0380      ;VCTR s=2 dx=7 dy=4 z=0 [x128]
L4F0A:  .word $4280, $71E0      ;VCTR s=4 dx=15 dy=20 z=7 [x32]
L4F0E:  .word $2380, $7600      ;VCTR s=2 dx=-4 dy=7 z=7 [x128]
L4F12:  .word $4000, $77A0      ;VCTR s=4 dx=-29 dy=0 z=7 [x32]
L4F16:  .word $45A0, $7680      ;VCTR s=4 dx=-20 dy=-13 z=7 [x32]
L4F1A:  .word $3640, $73C0      ;VCTR s=3 dx=15 dy=-9 z=7 [x64]
L4F1E:  .word $4640, $7740      ;VCTR s=4 dx=-26 dy=-18 z=7 [x32]
L4F22:  .word $4680, $71A0      ;VCTR s=4 dx=13 dy=-20 z=7 [x32]
L4F26:  .word $5460, $7210      ;VCTR s=5 dx=33 dy=-6 z=7 [x16]
L4F2A:  .word $4260, $7200      ;VCTR s=4 dx=16 dy=19 z=7 [x32]
L4F2E:  .word $3480, $72C0      ;VCTR s=3 dx=11 dy=-2 z=7 [x64]
L4F32:  .word $42C0, $7080      ;VCTR s=4 dx=4 dy=22 z=7 [x32]
L4F36:  .word $4000, $7780      ;VCTR s=4 dx=-28 dy=0 z=7 [x32]

ROCK4:
L4F3A:  .word $F303             ;SVEC u=2 dx=6 dy=6 z=0
L4F3C:  .word $42C0, $7160      ;VCTR s=4 dx=11 dy=22 z=7 [x32]
L4F40:  .word $F377             ;SVEC u=2 dx=-6 dy=6 z=7
L4F42:  .word $44C0, $7780      ;VCTR s=4 dx=-28 dy=-6 z=7 [x32]
L4F46:  .word $4620, $7620      ;VCTR s=4 dx=-17 dy=-17 z=7 [x32]
L4F4A:  .word $44A0, $7220      ;VCTR s=4 dx=17 dy=-5 z=7 [x32]
L4F4E:  .word $46E0, $76E0      ;VCTR s=4 dx=-23 dy=-23 z=7 [x32]
L4F52:  .word $4620, $7220      ;VCTR s=4 dx=17 dy=-17 z=7 [x32]
L4F56:  .word $5000, $7220      ;VCTR s=5 dx=34 dy=0 z=7 [x16]
L4F5A:  .word $42E0, $7180      ;VCTR s=4 dx=12 dy=23 z=7 [x32]
L4F5E:  .word $3000, $72C0      ;VCTR s=3 dx=11 dy=0 z=7 [x64]
L4F62:  .word $42C0, $7000      ;VCTR s=4 dx=0 dy=22 z=7 [x32]
L4F66:  .word $44A0, $7780      ;VCTR s=4 dx=-28 dy=-5 z=7 [x32]

ROCK5:
L4F6A:  .word $2380, $0200      ;VCTR s=2 dx=4 dy=7 z=0 [x128]
L4F6E:  .word $4300, $70E0      ;VCTR s=4 dx=7 dy=24 z=7 [x32]
L4F72:  .word $2200, $7780      ;VCTR s=2 dx=-7 dy=4 z=7 [x128]
L4F76:  .word $4560, $7740      ;VCTR s=4 dx=-26 dy=-11 z=7 [x32]
L4F7A:  .word $4680, $75A0      ;VCTR s=4 dx=-13 dy=-20 z=7 [x32]
L4F7E:  .word $4440, $7220      ;VCTR s=4 dx=17 dy=-2 z=7 [x32]
L4F82:  .word $4740, $7640      ;VCTR s=4 dx=-18 dy=-26 z=7 [x32]
L4F86:  .word $45C0, $7280      ;VCTR s=4 dx=20 dy=-14 z=7 [x32]
L4F8A:  .word $5070, $7220      ;VCTR s=5 dx=34 dy=7 z=7 [x16]
L4F8E:  .word $4300, $70C0      ;VCTR s=4 dx=6 dy=24 z=7 [x32]
L4F92:  .word $30C0, $72C0      ;VCTR s=3 dx=11 dy=3 z=7 [x64]
L4F96:  .word $42C0, $7480      ;VCTR s=4 dx=-4 dy=22 z=7 [x32]
L4F9A:  .word $4560, $7760      ;VCTR s=4 dx=-27 dy=-11 z=7 [x32]

ROCK6:
L4F9E:  .word $2380, $0180      ;VCTR s=2 dx=3 dy=7 z=0 [x128]
L4FA2:  .word $4340, $7040      ;VCTR s=4 dx=2 dy=26 z=7 [x32]
L4FA6:  .word $30C0, $7600      ;VCTR s=3 dx=-8 dy=3 z=7 [x64]
L4FAA:  .word $F67F             ;SVEC u=8 dx=-24 dy=-16 z=7
L4FAC:  .word $46E0, $7520      ;VCTR s=4 dx=-9 dy=-23 z=7 [x32]
L4FB0:  .word $4040, $7240      ;VCTR s=4 dx=18 dy=2 z=7 [x32]
L4FB4:  .word $47C0, $7580      ;VCTR s=4 dx=-12 dy=-30 z=7 [x32]
L4FB8:  .word $4520, $72C0      ;VCTR s=4 dx=22 dy=-9 z=7 [x32]
L4FBC:  .word $41A0, $73E0      ;VCTR s=4 dx=31 dy=13 z=7 [x32]
L4FC0:  .word $4320, $7040      ;VCTR s=4 dx=2 dy=25 z=7 [x32]
L4FC4:  .word $3140, $72C0      ;VCTR s=3 dx=11 dy=5 z=7 [x64]
L4FC8:  .word $4280, $7520      ;VCTR s=4 dx=-9 dy=20 z=7 [x32]
L4FCC:  .word $F67F             ;SVEC u=8 dx=-24 dy=-16 z=7

ROCK7:
L4FCE:  .word $3200, $0080      ;VCTR s=3 dx=2 dy=8 z=0 [x64]
L4FD2:  .word $4320, $7480      ;VCTR s=4 dx=-4 dy=25 z=7 [x32]
L4FD6:  .word $2100, $7780      ;VCTR s=2 dx=-7 dy=2 z=7 [x128]
L4FDA:  .word $46A0, $76A0      ;VCTR s=4 dx=-21 dy=-21 z=7 [x32]
L4FDE:  .word $46E0, $74A0      ;VCTR s=4 dx=-5 dy=-23 z=7 [x32]
L4FE2:  .word $4080, $7240      ;VCTR s=4 dx=18 dy=4 z=7 [x32]
L4FE6:  .word $47E0, $74C0      ;VCTR s=4 dx=-6 dy=-31 z=7 [x32]
L4FEA:  .word $44A0, $72E0      ;VCTR s=4 dx=23 dy=-5 z=7 [x32]
L4FEE:  .word $4260, $7380      ;VCTR s=4 dx=28 dy=19 z=7 [x32]
L4FF2:  .word $4320, $7460      ;VCTR s=4 dx=-3 dy=25 z=7 [x32]
L4FF6:  .word $3180, $7280      ;VCTR s=3 dx=10 dy=6 z=7 [x64]
L4FFA:  .word $4260, $75A0      ;VCTR s=4 dx=-13 dy=19 z=7 [x32]
L4FFE:  .word $4680, $7680      ;VCTR s=4 dx=-20 dy=-20 z=7 [x32]

RSOURC:
L5002:  .byte $84               ;.
L5003:  .byte $4E               ;N
L5004:  .word $4E9E, $4ED2      ;-> ROCK1, ROCK2
L5008:  .word $4F06, $4F3A      ;-> ROCK3, ROCK4
L500C:  .word $4F6A, $4F9E      ;-> ROCK5, ROCK6
L5010:  .byte $CE, $4F          ;.O

SHLDVC:
L5012:  .word $5180, $0380      ;VCTR s=5 dx=56 dy=24 z=0 [x16]
L5016:  .word $FA0E             ;SVEC u=16 dx=-32 dy=32 z=0
L5018:  .word $F80F             ;SVEC u=16 dx=-48 dy=0 z=0
L501A:  .word $FE0E             ;SVEC u=16 dx=-32 dy=-32 z=0
L501C:  .word $FF08             ;SVEC u=16 dx=0 dy=-48 z=0
L501E:  .word $FE0A             ;SVEC u=16 dx=32 dy=-32 z=0
L5020:  .word $F80B             ;SVEC u=16 dx=48 dy=0 z=0
L5022:  .word $FA0A             ;SVEC u=16 dx=32 dy=32 z=0
L5024:  .word $FB08             ;SVEC u=16 dx=0 dy=48 z=0
L5026:  .word $5580, $0780      ;VCTR s=5 dx=-56 dy=-24 z=0 [x16]

TFPIX:
; [note] The special rock's picture table: 48 JSRL words (TRI.MAC).  The
;        first 32 (TFPIX..TFPIX+63) are TRI00-TRI37, the single triangle
;        at 32 orientations 1/32 turn apart; TRIPIX indexes them by
;        SRANG>>2 with bit 0 cleared.  The next 16 (TFPIX+64..+95) are
;        FRM00-FRM17, the big piece - two triangles point to point - at 16
;        orientations; TRIPIX takes those when SRTIME bit 0 says big, and
;        SHPEXP lifts one vector from them for each fragment of the
;        exploding ship.  Every word is decoded in the vector listing.
L502A:  .byte $45               ;E
L502B:  .byte $C8               ;.
L502C:  .word $C84E             ;JSRL TRI01 ($509C)
L502E:  .word $C857             ;JSRL TRI02 ($50AE)
L5030:  .word $C860             ;JSRL TRI03 ($50C0)
L5032:  .word $C869             ;JSRL TRI04 ($50D2)
L5034:  .word $C872             ;JSRL TRI05 ($50E4)
L5036:  .word $C87B             ;JSRL TRI06 ($50F6)
L5038:  .word $C884             ;JSRL TRI07 ($5108)
L503A:  .word $C88D             ;JSRL TRI10 ($511A)
L503C:  .word $C896             ;JSRL TRI11 ($512C)
L503E:  .word $C89F             ;JSRL TRI12 ($513E)
L5040:  .word $C8A8             ;JSRL TRI13 ($5150)
L5042:  .word $C8B1             ;JSRL TRI14 ($5162)
L5044:  .word $C8BA             ;JSRL TRI15 ($5174)
L5046:  .word $C8C3             ;JSRL TRI16 ($5186)
L5048:  .word $C8CC             ;JSRL TRI17 ($5198)
L504A:  .word $C8D5             ;JSRL TRI20 ($51AA)
L504C:  .word $C8DE             ;JSRL TRI21 ($51BC)
L504E:  .word $C8E7             ;JSRL TRI22 ($51CE)
L5050:  .word $C8F0             ;JSRL TRI23 ($51E0)
L5052:  .word $C8F9             ;JSRL TRI24 ($51F2)
L5054:  .word $C902             ;JSRL TRI25 ($5204)
L5056:  .word $C90B             ;JSRL TRI26 ($5216)
L5058:  .word $C914             ;JSRL TRI27 ($5228)
L505A:  .word $C91D             ;JSRL TRI30 ($523A)
L505C:  .word $C926             ;JSRL TRI31 ($524C)
L505E:  .word $C92F             ;JSRL TRI32 ($525E)
L5060:  .word $C938             ;JSRL TRI33 ($5270)
L5062:  .word $C941             ;JSRL TRI34 ($5282)
L5064:  .word $C94A             ;JSRL TRI35 ($5294)
L5066:  .word $C953             ;JSRL TRI36 ($52A6)
L5068:  .word $C95C             ;JSRL TRI37 ($52B8)
L506A:  .byte $65               ;e
L506B:  .byte $C9               ;.
L506C:  .word $C969             ;JSRL FRM01 ($52D2)
L506E:  .word $C96F             ;JSRL FRM02 ($52DE)
L5070:  .word $C975             ;JSRL FRM03 ($52EA)
L5072:  .word $C97B             ;JSRL FRM04 ($52F6)
L5074:  .word $C981             ;JSRL FRM05 ($5302)
L5076:  .word $C987             ;JSRL FRM06 ($530E)
L5078:  .word $C98D             ;JSRL FRM07 ($531A)
L507A:  .word $C993             ;JSRL FRM10 ($5326)
L507C:  .word $C997             ;JSRL FRM11 ($532E)
L507E:  .word $C99D             ;JSRL FRM12 ($533A)
L5080:  .word $C9A3             ;JSRL FRM13 ($5346)
L5082:  .word $C9A9             ;JSRL FRM14 ($5352)
L5084:  .word $C9AF             ;JSRL FRM15 ($535E)
L5086:  .word $C9B5             ;JSRL FRM16 ($536A)
L5088:  .word $C9BB             ;JSRL FRM17 ($5376)

TRI00:
; [note] TRI00-TRI37: the special rock's triangle at 32 orientations, 18
;        bytes each (four VCTRs and an RTSL), reached through TFPIX.
;        Decoded in the vector listing.
L508A:  .word $4380, $7600      ;VCTR s=4 dx=-16 dy=28 z=7 [x32]
L508E:  .word $55C0, $7300      ;VCTR s=5 dx=48 dy=-28 z=7 [x16]
L5092:  .word $55C0, $7700      ;VCTR s=5 dx=-48 dy=-28 z=7 [x16]
L5096:  .word $4380, $7200      ;VCTR s=4 dx=16 dy=28 z=7 [x32]
L509A:  .word $D000             ;RTSL

TRI01:
L509C:  .word $4300, $76A0      ;VCTR s=4 dx=-21 dy=24 z=7 [x32]
L50A0:  .word $5520, $7340      ;VCTR s=5 dx=52 dy=-18 z=7 [x16]
L50A4:  .word $5650, $7690      ;VCTR s=5 dx=-41 dy=-37 z=7 [x16]
L50A8:  .word $43E0, $7140      ;VCTR s=4 dx=10 dy=31 z=7 [x32]
L50AC:  .word $D000             ;RTSL

TRI02:
L50AE:  .word $4280, $7720      ;VCTR s=4 dx=-25 dy=20 z=7 [x32]
L50B2:  .word $5480, $7370      ;VCTR s=5 dx=55 dy=-8 z=7 [x16]
L50B6:  .word $56C0, $7620      ;VCTR s=5 dx=-34 dy=-44 z=7 [x16]
L50BA:  .word $5200, $7040      ;VCTR s=5 dx=4 dy=32 z=7 [x16]
L50BE:  .word $D000             ;RTSL

TRI03:
L50C0:  .word $41C0, $77A0      ;VCTR s=4 dx=-29 dy=14 z=7 [x32]
L50C4:  .word $5040, $7380      ;VCTR s=5 dx=56 dy=4 z=7 [x16]
L50C8:  .word $5720, $7590      ;VCTR s=5 dx=-25 dy=-50 z=7 [x16]
L50CC:  .word $5200, $7420      ;VCTR s=5 dx=-2 dy=32 z=7 [x16]
L50D0:  .word $D000             ;RTSL

TRI04:
L50D2:  .word $4100, $77E0      ;VCTR s=4 dx=-31 dy=8 z=7 [x32]
L50D6:  .word $50F0, $7360      ;VCTR s=5 dx=54 dy=15 z=7 [x16]
L50DA:  .word $5760, $74F0      ;VCTR s=5 dx=-15 dy=-54 z=7 [x16]
L50DE:  .word $43E0, $7500      ;VCTR s=4 dx=-8 dy=31 z=7 [x32]
L50E2:  .word $D000             ;RTSL

TRI05:
L50E4:  .word $5020, $7600      ;VCTR s=5 dx=-32 dy=2 z=7 [x16]
L50E8:  .word $5190, $7320      ;VCTR s=5 dx=50 dy=25 z=7 [x16]
L50EC:  .word $5780, $7440      ;VCTR s=5 dx=-4 dy=-56 z=7 [x16]
L50F0:  .word $43A0, $75C0      ;VCTR s=4 dx=-14 dy=29 z=7 [x32]
L50F4:  .word $D000             ;RTSL

TRI06:
L50F6:  .word $5440, $7600      ;VCTR s=5 dx=-32 dy=-4 z=7 [x16]
L50FA:  .word $5220, $72C0      ;VCTR s=5 dx=44 dy=34 z=7 [x16]
L50FE:  .word $5770, $7080      ;VCTR s=5 dx=8 dy=-55 z=7 [x16]
L5102:  .word $4320, $7680      ;VCTR s=4 dx=-20 dy=25 z=7 [x32]
L5106:  .word $D000             ;RTSL

TRI07:
L5108:  .word $4540, $77E0      ;VCTR s=4 dx=-31 dy=-10 z=7 [x32]
L510C:  .word $5290, $7250      ;VCTR s=5 dx=37 dy=41 z=7 [x16]
L5110:  .word $5740, $7120      ;VCTR s=5 dx=18 dy=-52 z=7 [x16]
L5114:  .word $42A0, $7700      ;VCTR s=4 dx=-24 dy=21 z=7 [x32]
L5118:  .word $D000             ;RTSL

TRI10:
L511A:  .word $4600, $7780      ;VCTR s=4 dx=-28 dy=-16 z=7 [x32]
L511E:  .word $5300, $71C0      ;VCTR s=5 dx=28 dy=48 z=7 [x16]
L5122:  .word $5700, $71C0      ;VCTR s=5 dx=28 dy=-48 z=7 [x16]
L5126:  .word $4200, $7780      ;VCTR s=4 dx=-28 dy=16 z=7 [x32]
L512A:  .word $D000             ;RTSL

TRI11:
L512C:  .word $46A0, $7700      ;VCTR s=4 dx=-24 dy=-21 z=7 [x32]
L5130:  .word $5340, $7120      ;VCTR s=5 dx=18 dy=52 z=7 [x16]
L5134:  .word $5690, $7250      ;VCTR s=5 dx=37 dy=-41 z=7 [x16]
L5138:  .word $4140, $77E0      ;VCTR s=4 dx=-31 dy=10 z=7 [x32]
L513C:  .word $D000             ;RTSL

TRI12:
L513E:  .word $4720, $7680      ;VCTR s=4 dx=-20 dy=-25 z=7 [x32]
L5142:  .word $5370, $7080      ;VCTR s=5 dx=8 dy=55 z=7 [x16]
L5146:  .word $5620, $72C0      ;VCTR s=5 dx=44 dy=-34 z=7 [x16]
L514A:  .word $5040, $7600      ;VCTR s=5 dx=-32 dy=4 z=7 [x16]
L514E:  .word $D000             ;RTSL

TRI13:
L5150:  .word $47A0, $75C0      ;VCTR s=4 dx=-14 dy=-29 z=7 [x32]
L5154:  .word $5380, $7440      ;VCTR s=5 dx=-4 dy=56 z=7 [x16]
L5158:  .word $5590, $7320      ;VCTR s=5 dx=50 dy=-25 z=7 [x16]
L515C:  .word $5420, $7600      ;VCTR s=5 dx=-32 dy=-2 z=7 [x16]
L5160:  .word $D000             ;RTSL

TRI14:
L5162:  .word $47E0, $7500      ;VCTR s=4 dx=-8 dy=-31 z=7 [x32]
L5166:  .word $5360, $74F0      ;VCTR s=5 dx=-15 dy=54 z=7 [x16]
L516A:  .word $54F0, $7360      ;VCTR s=5 dx=54 dy=-15 z=7 [x16]
L516E:  .word $4500, $77E0      ;VCTR s=4 dx=-31 dy=-8 z=7 [x32]
L5172:  .word $D000             ;RTSL

TRI15:
L5174:  .word $5600, $7420      ;VCTR s=5 dx=-2 dy=-32 z=7 [x16]
L5178:  .word $5320, $7590      ;VCTR s=5 dx=-25 dy=50 z=7 [x16]
L517C:  .word $5440, $7380      ;VCTR s=5 dx=56 dy=-4 z=7 [x16]
L5180:  .word $45C0, $77A0      ;VCTR s=4 dx=-29 dy=-14 z=7 [x32]
L5184:  .word $D000             ;RTSL

TRI16:
L5186:  .word $5600, $7040      ;VCTR s=5 dx=4 dy=-32 z=7 [x16]
L518A:  .word $52C0, $7620      ;VCTR s=5 dx=-34 dy=44 z=7 [x16]
L518E:  .word $5080, $7370      ;VCTR s=5 dx=55 dy=8 z=7 [x16]
L5192:  .word $4680, $7720      ;VCTR s=4 dx=-25 dy=-20 z=7 [x32]
L5196:  .word $D000             ;RTSL

TRI17:
L5198:  .word $47E0, $7140      ;VCTR s=4 dx=10 dy=-31 z=7 [x32]
L519C:  .word $5250, $7690      ;VCTR s=5 dx=-41 dy=37 z=7 [x16]
L51A0:  .word $5120, $7340      ;VCTR s=5 dx=52 dy=18 z=7 [x16]
L51A4:  .word $4700, $76A0      ;VCTR s=4 dx=-21 dy=-24 z=7 [x32]
L51A8:  .word $D000             ;RTSL

TRI20:
L51AA:  .word $4780, $7200      ;VCTR s=4 dx=16 dy=-28 z=7 [x32]
L51AE:  .word $51C0, $7700      ;VCTR s=5 dx=-48 dy=28 z=7 [x16]
L51B2:  .word $51C0, $7300      ;VCTR s=5 dx=48 dy=28 z=7 [x16]
L51B6:  .word $4780, $7600      ;VCTR s=4 dx=-16 dy=-28 z=7 [x32]
L51BA:  .word $D000             ;RTSL

TRI21:
L51BC:  .word $4700, $72A0      ;VCTR s=4 dx=21 dy=-24 z=7 [x32]
L51C0:  .word $5120, $7740      ;VCTR s=5 dx=-52 dy=18 z=7 [x16]
L51C4:  .word $5250, $7290      ;VCTR s=5 dx=41 dy=37 z=7 [x16]
L51C8:  .word $47E0, $7540      ;VCTR s=4 dx=-10 dy=-31 z=7 [x32]
L51CC:  .word $D000             ;RTSL

TRI22:
L51CE:  .word $4680, $7320      ;VCTR s=4 dx=25 dy=-20 z=7 [x32]
L51D2:  .word $5080, $7770      ;VCTR s=5 dx=-55 dy=8 z=7 [x16]
L51D6:  .word $52C0, $7220      ;VCTR s=5 dx=34 dy=44 z=7 [x16]
L51DA:  .word $5600, $7440      ;VCTR s=5 dx=-4 dy=-32 z=7 [x16]
L51DE:  .word $D000             ;RTSL

TRI23:
L51E0:  .word $45C0, $73A0      ;VCTR s=4 dx=29 dy=-14 z=7 [x32]
L51E4:  .word $5440, $7780      ;VCTR s=5 dx=-56 dy=-4 z=7 [x16]
L51E8:  .word $5320, $7190      ;VCTR s=5 dx=25 dy=50 z=7 [x16]
L51EC:  .word $5600, $7020      ;VCTR s=5 dx=2 dy=-32 z=7 [x16]
L51F0:  .word $D000             ;RTSL

TRI24:
L51F2:  .word $4500, $73E0      ;VCTR s=4 dx=31 dy=-8 z=7 [x32]
L51F6:  .word $54F0, $7760      ;VCTR s=5 dx=-54 dy=-15 z=7 [x16]
L51FA:  .word $5360, $70F0      ;VCTR s=5 dx=15 dy=54 z=7 [x16]
L51FE:  .word $47E0, $7100      ;VCTR s=4 dx=8 dy=-31 z=7 [x32]
L5202:  .word $D000             ;RTSL

TRI25:
L5204:  .word $5420, $7200      ;VCTR s=5 dx=32 dy=-2 z=7 [x16]
L5208:  .word $5590, $7720      ;VCTR s=5 dx=-50 dy=-25 z=7 [x16]
L520C:  .word $5380, $7040      ;VCTR s=5 dx=4 dy=56 z=7 [x16]
L5210:  .word $47A0, $71C0      ;VCTR s=4 dx=14 dy=-29 z=7 [x32]
L5214:  .word $D000             ;RTSL

TRI26:
L5216:  .word $5040, $7200      ;VCTR s=5 dx=32 dy=4 z=7 [x16]
L521A:  .word $5620, $76C0      ;VCTR s=5 dx=-44 dy=-34 z=7 [x16]
L521E:  .word $5370, $7480      ;VCTR s=5 dx=-8 dy=55 z=7 [x16]
L5222:  .word $4720, $7280      ;VCTR s=4 dx=20 dy=-25 z=7 [x32]
L5226:  .word $D000             ;RTSL

TRI27:
L5228:  .word $4140, $73E0      ;VCTR s=4 dx=31 dy=10 z=7 [x32]
L522C:  .word $5690, $7650      ;VCTR s=5 dx=-37 dy=-41 z=7 [x16]
L5230:  .word $5340, $7520      ;VCTR s=5 dx=-18 dy=52 z=7 [x16]
L5234:  .word $46A0, $7300      ;VCTR s=4 dx=24 dy=-21 z=7 [x32]
L5238:  .word $D000             ;RTSL

TRI30:
L523A:  .word $4200, $7380      ;VCTR s=4 dx=28 dy=16 z=7 [x32]
L523E:  .word $5700, $75C0      ;VCTR s=5 dx=-28 dy=-48 z=7 [x16]
L5242:  .word $5300, $75C0      ;VCTR s=5 dx=-28 dy=48 z=7 [x16]
L5246:  .word $4600, $7380      ;VCTR s=4 dx=28 dy=-16 z=7 [x32]
L524A:  .word $D000             ;RTSL

TRI31:
L524C:  .word $42A0, $7300      ;VCTR s=4 dx=24 dy=21 z=7 [x32]
L5250:  .word $5740, $7520      ;VCTR s=5 dx=-18 dy=-52 z=7 [x16]
L5254:  .word $5290, $7650      ;VCTR s=5 dx=-37 dy=41 z=7 [x16]
L5258:  .word $4540, $73E0      ;VCTR s=4 dx=31 dy=-10 z=7 [x32]
L525C:  .word $D000             ;RTSL

TRI32:
L525E:  .word $4320, $7280      ;VCTR s=4 dx=20 dy=25 z=7 [x32]
L5262:  .word $5770, $7480      ;VCTR s=5 dx=-8 dy=-55 z=7 [x16]
L5266:  .word $5220, $76C0      ;VCTR s=5 dx=-44 dy=34 z=7 [x16]
L526A:  .word $5440, $7200      ;VCTR s=5 dx=32 dy=-4 z=7 [x16]
L526E:  .word $D000             ;RTSL

TRI33:
L5270:  .word $43A0, $71C0      ;VCTR s=4 dx=14 dy=29 z=7 [x32]
L5274:  .word $5780, $7040      ;VCTR s=5 dx=4 dy=-56 z=7 [x16]
L5278:  .word $5190, $7720      ;VCTR s=5 dx=-50 dy=25 z=7 [x16]
L527C:  .word $5020, $7200      ;VCTR s=5 dx=32 dy=2 z=7 [x16]
L5280:  .word $D000             ;RTSL

TRI34:
L5282:  .word $43E0, $7100      ;VCTR s=4 dx=8 dy=31 z=7 [x32]
L5286:  .word $5760, $70F0      ;VCTR s=5 dx=15 dy=-54 z=7 [x16]
L528A:  .word $50F0, $7760      ;VCTR s=5 dx=-54 dy=15 z=7 [x16]
L528E:  .word $4100, $73E0      ;VCTR s=4 dx=31 dy=8 z=7 [x32]
L5292:  .word $D000             ;RTSL

TRI35:
L5294:  .word $5200, $7020      ;VCTR s=5 dx=2 dy=32 z=7 [x16]
L5298:  .word $5720, $7190      ;VCTR s=5 dx=25 dy=-50 z=7 [x16]
L529C:  .word $5040, $7780      ;VCTR s=5 dx=-56 dy=4 z=7 [x16]
L52A0:  .word $41C0, $73A0      ;VCTR s=4 dx=29 dy=14 z=7 [x32]
L52A4:  .word $D000             ;RTSL

TRI36:
L52A6:  .word $5200, $7440      ;VCTR s=5 dx=-4 dy=32 z=7 [x16]
L52AA:  .word $56C0, $7220      ;VCTR s=5 dx=34 dy=-44 z=7 [x16]
L52AE:  .word $5480, $7770      ;VCTR s=5 dx=-55 dy=-8 z=7 [x16]
L52B2:  .word $4280, $7320      ;VCTR s=4 dx=25 dy=20 z=7 [x32]
L52B6:  .word $D000             ;RTSL

TRI37:
L52B8:  .word $43E0, $7540      ;VCTR s=4 dx=-10 dy=31 z=7 [x32]
L52BC:  .word $5650, $7290      ;VCTR s=5 dx=41 dy=-37 z=7 [x16]
L52C0:  .word $5520, $7740      ;VCTR s=5 dx=-52 dy=-18 z=7 [x16]
L52C4:  .word $4300, $72A0      ;VCTR s=4 dx=21 dy=24 z=7 [x32]
L52C8:  .word $D000             ;RTSL

FRM00:
; [note] FRM00-FRM17: the big special rock at 16 orientations - an SVEC
;        out, JSRL to one triangle, an SVEC back, and a JMPL to the
;        triangle facing the other way (TRI00 and TRI20 for FRM00).
;        Reached through TFPIX+64; also where SHPEXP takes the ship's
;        explosion fragments from.
L52CA:  .word $F809             ;SVEC u=16 dx=16 dy=0 z=0
L52CC:  .word $C845             ;JSRL TRI00 ($508A)
L52CE:  .word $F80E             ;SVEC u=16 dx=-32 dy=0 z=0
L52D0:  .word $E8D5             ;JMPL TRI20 ($51AA)

FRM01:
L52D2:  .word $4060, $0200      ;VCTR s=4 dx=16 dy=3 z=0 [x32]
L52D6:  .word $C84E             ;JSRL TRI01 ($509C)
L52D8:  .word $5460, $0600      ;VCTR s=5 dx=-32 dy=-6 z=0 [x16]
L52DC:  .word $E8DE             ;JMPL TRI21 ($51BC)

FRM02:
L52DE:  .word $3180, $03C0      ;VCTR s=3 dx=15 dy=6 z=0 [x64]
L52E2:  .word $C857             ;JSRL TRI02 ($50AE)
L52E4:  .word $4580, $07C0      ;VCTR s=4 dx=-30 dy=-12 z=0 [x32]
L52E8:  .word $E8E7             ;JMPL TRI22 ($51CE)

FRM03:
L52EA:  .word $3240, $0340      ;VCTR s=3 dx=13 dy=9 z=0 [x64]
L52EE:  .word $C860             ;JSRL TRI03 ($50C0)
L52F0:  .word $4640, $0740      ;VCTR s=4 dx=-26 dy=-18 z=0 [x32]
L52F4:  .word $E8F0             ;JMPL TRI23 ($51E0)

FRM04:
L52F6:  .word $32C0, $02C0      ;VCTR s=3 dx=11 dy=11 z=0 [x64]
L52FA:  .word $C869             ;JSRL TRI04 ($50D2)
L52FC:  .word $46C0, $06C0      ;VCTR s=4 dx=-22 dy=-22 z=0 [x32]
L5300:  .word $E8F9             ;JMPL TRI24 ($51F2)

FRM05:
L5302:  .word $3340, $0240      ;VCTR s=3 dx=9 dy=13 z=0 [x64]
L5306:  .word $C872             ;JSRL TRI05 ($50E4)
L5308:  .word $4740, $0640      ;VCTR s=4 dx=-18 dy=-26 z=0 [x32]
L530C:  .word $E902             ;JMPL TRI25 ($5204)

FRM06:
L530E:  .word $33C0, $0180      ;VCTR s=3 dx=6 dy=15 z=0 [x64]
L5312:  .word $C87B             ;JSRL TRI06 ($50F6)
L5314:  .word $47C0, $0580      ;VCTR s=4 dx=-12 dy=-30 z=0 [x32]
L5318:  .word $E90B             ;JMPL TRI26 ($5216)

FRM07:
L531A:  .word $4200, $0060      ;VCTR s=4 dx=3 dy=16 z=0 [x32]
L531E:  .word $C884             ;JSRL TRI07 ($5108)
L5320:  .word $5600, $0460      ;VCTR s=5 dx=-6 dy=-32 z=0 [x16]
L5324:  .word $E914             ;JMPL TRI27 ($5228)

FRM10:
L5326:  .word $F908             ;SVEC u=16 dx=0 dy=16 z=0
L5328:  .word $C88D             ;JSRL TRI10 ($511A)
L532A:  .word $FE08             ;SVEC u=16 dx=0 dy=-32 z=0
L532C:  .word $E91D             ;JMPL TRI30 ($523A)

FRM11:
L532E:  .word $4200, $0460      ;VCTR s=4 dx=-3 dy=16 z=0 [x32]
L5332:  .word $C896             ;JSRL TRI11 ($512C)
L5334:  .word $5600, $0060      ;VCTR s=5 dx=6 dy=-32 z=0 [x16]
L5338:  .word $E926             ;JMPL TRI31 ($524C)

FRM12:
L533A:  .word $33C0, $0580      ;VCTR s=3 dx=-6 dy=15 z=0 [x64]
L533E:  .word $C89F             ;JSRL TRI12 ($513E)
L5340:  .word $47C0, $0180      ;VCTR s=4 dx=12 dy=-30 z=0 [x32]
L5344:  .word $E92F             ;JMPL TRI32 ($525E)

FRM13:
L5346:  .word $3340, $0640      ;VCTR s=3 dx=-9 dy=13 z=0 [x64]
L534A:  .word $C8A8             ;JSRL TRI13 ($5150)
L534C:  .word $4740, $0240      ;VCTR s=4 dx=18 dy=-26 z=0 [x32]
L5350:  .word $E938             ;JMPL TRI33 ($5270)

FRM14:
L5352:  .word $32C0, $06C0      ;VCTR s=3 dx=-11 dy=11 z=0 [x64]
L5356:  .word $C8B1             ;JSRL TRI14 ($5162)
L5358:  .word $46C0, $02C0      ;VCTR s=4 dx=22 dy=-22 z=0 [x32]
L535C:  .word $E941             ;JMPL TRI34 ($5282)

FRM15:
L535E:  .word $3240, $0740      ;VCTR s=3 dx=-13 dy=9 z=0 [x64]
L5362:  .word $C8BA             ;JSRL TRI15 ($5174)
L5364:  .word $4640, $0340      ;VCTR s=4 dx=26 dy=-18 z=0 [x32]
L5368:  .word $E94A             ;JMPL TRI35 ($5294)

FRM16:
L536A:  .word $3180, $07C0      ;VCTR s=3 dx=-15 dy=6 z=0 [x64]
L536E:  .word $C8C3             ;JSRL TRI16 ($5186)
L5370:  .word $4580, $03C0      ;VCTR s=4 dx=30 dy=-12 z=0 [x32]
L5374:  .word $E953             ;JMPL TRI36 ($52A6)

FRM17:
L5376:  .word $4060, $0600      ;VCTR s=4 dx=-16 dy=3 z=0 [x32]
L537A:  .word $C8CC             ;JSRL TRI17 ($5198)
L537C:  .word $5460, $0200      ;VCTR s=5 dx=32 dy=-6 z=0 [x16]
L5380:  .word $E95C             ;JMPL TRI37 ($52B8)

CPMGL:
L5382:  .word $A080, $01A0      ;LABS size=0 x=416 y=128
L5386:  .word $7000, $0000      ;WAIT t=7 z=0

ASTMSG:
L538A:  .word $C9D7             ;JSRL CIRCL ($53AE)
L538C:  .word $3180, $0200      ;VCTR s=3 dx=8 dy=6 z=0 [x64]
L5390:  .word $F875             ;SVEC u=4 dx=-4 dy=0 z=7
L5392:  .word $FD70             ;SVEC u=4 dx=0 dy=-4 z=7
L5394:  .word $F871             ;SVEC u=4 dx=4 dy=0 z=7
L5396:  .word $3480, $0200      ;VCTR s=3 dx=8 dy=-2 z=0 [x64]
L539A:  .word $C9D7             ;JSRL CIRCL ($53AE)
L539C:  .word $F901             ;SVEC u=4 dx=4 dy=4 z=0
L539E:  .word $F871             ;SVEC u=4 dx=4 dy=0 z=7
L53A0:  .word $1300, $7000      ;VCTR s=1 dx=0 dy=3 z=7 [x256]
L53A4:  .word $F875             ;SVEC u=4 dx=-4 dy=0 z=7
L53A6:  .word $F770             ;SVEC u=2 dx=0 dy=-6 z=7
L53A8:  .word $34C0, $0300      ;VCTR s=3 dx=12 dy=-3 z=0 [x64]
L53AC:  .word $D000             ;RTSL

CIRCL:
L53AE:  .word $F573             ;SVEC u=2 dx=6 dy=-2 z=7
L53B0:  .word $F173             ;SVEC u=2 dx=6 dy=2 z=7
L53B2:  .word $F178             ;SVEC u=8 dx=0 dy=8 z=7
L53B4:  .word $F177             ;SVEC u=2 dx=-6 dy=2 z=7
L53B6:  .word $F577             ;SVEC u=2 dx=-6 dy=-2 z=7
L53B8:  .word $F578             ;SVEC u=8 dx=0 dy=-8 z=7
L53BA:  .word $D000             ;RTSL

SHIPS:
L53BC:  .word $1200, $3E28      ;VCTR s=1 dx=-552 dy=512 z=3 [raw]
L53C0:  .word $6954, $957F      ;VCTR s=6 dx=-383 dy=340 z=9 [raw]
L53C4:  .word $B4AB             ;HALT

SHIPSV:
L53C6:  .word $5600, $0580      ;VCTR s=5 dx=-24 dy=-32 z=0 [x16]
L53CA:  .word $5080, $0380      ;VCTR s=5 dx=56 dy=8 z=0 [x16]
L53CE:  .word $F909             ;SVEC u=16 dx=16 dy=16 z=0
L53D0:  .word $5180, $0700      ;VCTR s=5 dx=-48 dy=24 z=0 [x16]
L53D4:  .word $5580, $0700      ;VCTR s=5 dx=-48 dy=-24 z=0 [x16]
L53D8:  .word $FD09             ;SVEC u=16 dx=16 dy=-16 z=0
L53DA:  .word $5480, $0380      ;VCTR s=5 dx=56 dy=-8 z=0 [x16]
L53DE:  .word $6300, $04C0      ;VCTR s=6 dx=-24 dy=96 z=0 [x8]
L53E2:  .word $6700, $04C0      ;VCTR s=6 dx=-24 dy=-96 z=0 [x8]
L53E6:  .word $F60B             ;SVEC u=8 dx=24 dy=-16 z=0
L53E8:  .word $F20B             ;SVEC u=8 dx=24 dy=16 z=0

SHIP01:
L53EA:  .word $5620, $0550      ;VCTR s=5 dx=-21 dy=-34 z=0 [x16]
L53EE:  .word $50D0, $0370      ;VCTR s=5 dx=55 dy=13 z=0 [x16]
L53F2:  .word $4240, $01E0      ;VCTR s=4 dx=15 dy=18 z=0 [x32]
L53F6:  .word $5130, $0730      ;VCTR s=5 dx=-51 dy=19 z=0 [x16]
L53FA:  .word $55D0, $06D0      ;VCTR s=5 dx=-45 dy=-29 z=0 [x16]
L53FE:  .word $45C0, $0240      ;VCTR s=4 dx=18 dy=-14 z=0 [x32]
L5402:  .word $5420, $0380      ;VCTR s=5 dx=56 dy=-2 z=0 [x16]
L5406:  .word $62E8, $0508      ;VCTR s=6 dx=-33 dy=93 z=0 [x8]
L540A:  .word $6710, $0478      ;VCTR s=6 dx=-15 dy=-98 z=0 [x8]
L540E:  .word $45C0, $0340      ;VCTR s=4 dx=26 dy=-14 z=0 [x32]
L5412:  .word $4260, $02C0      ;VCTR s=4 dx=22 dy=19 z=0 [x32]

SHIP02:
L5416:  .word $5640, $0510      ;VCTR s=5 dx=-17 dy=-36 z=0 [x16]
L541A:  .word $5130, $0350      ;VCTR s=5 dx=53 dy=19 z=0 [x16]
L541E:  .word $4260, $01A0      ;VCTR s=4 dx=13 dy=19 z=0 [x32]
L5422:  .word $50E0, $0740      ;VCTR s=5 dx=-52 dy=14 z=0 [x16]
L5426:  .word $5610, $06B0      ;VCTR s=5 dx=-43 dy=-33 z=0 [x16]
L542A:  .word $45A0, $0260      ;VCTR s=4 dx=19 dy=-13 z=0 [x32]
L542E:  .word $5030, $0390      ;VCTR s=5 dx=57 dy=3 z=0 [x16]
L5432:  .word $62D0, $0550      ;VCTR s=6 dx=-42 dy=90 z=0 [x8]
L5436:  .word $6718, $0428      ;VCTR s=6 dx=-5 dy=-99 z=0 [x8]
L543A:  .word $4560, $0340      ;VCTR s=4 dx=26 dy=-11 z=0 [x32]
L543E:  .word $4280, $02A0      ;VCTR s=4 dx=21 dy=20 z=0 [x32]

SHIP03:
L5442:  .word $5660, $04E0      ;VCTR s=5 dx=-14 dy=-38 z=0 [x16]
L5446:  .word $5180, $0340      ;VCTR s=5 dx=52 dy=24 z=0 [x16]
L544A:  .word $4280, $0140      ;VCTR s=4 dx=10 dy=20 z=0 [x32]
L544E:  .word $5090, $0750      ;VCTR s=5 dx=-53 dy=9 z=0 [x16]
L5452:  .word $5650, $0670      ;VCTR s=5 dx=-39 dy=-37 z=0 [x16]
L5456:  .word $4540, $0280      ;VCTR s=4 dx=20 dy=-10 z=0 [x32]
L545A:  .word $5080, $0380      ;VCTR s=5 dx=56 dy=8 z=0 [x16]
L545E:  .word $62A8, $0598      ;VCTR s=6 dx=-51 dy=85 z=0 [x8]
L5462:  .word $6718, $0028      ;VCTR s=6 dx=5 dy=-99 z=0 [x8]
L5466:  .word $4500, $0380      ;VCTR s=4 dx=28 dy=-8 z=0 [x32]
L546A:  .word $42C0, $0240      ;VCTR s=4 dx=18 dy=22 z=0 [x32]

SHIP04:
L546E:  .word $5670, $04A0      ;VCTR s=5 dx=-10 dy=-39 z=0 [x16]
L5472:  .word $51D0, $0310      ;VCTR s=5 dx=49 dy=29 z=0 [x16]
L5476:  .word $42A0, $0100      ;VCTR s=4 dx=8 dy=21 z=0 [x32]
L547A:  .word $5040, $0750      ;VCTR s=5 dx=-53 dy=4 z=0 [x16]
L547E:  .word $5690, $0630      ;VCTR s=5 dx=-35 dy=-41 z=0 [x16]
L5482:  .word $4500, $02A0      ;VCTR s=4 dx=21 dy=-8 z=0 [x32]
L5486:  .word $50E0, $0360      ;VCTR s=5 dx=54 dy=14 z=0 [x16]
L548A:  .word $6278, $05D0      ;VCTR s=6 dx=-58 dy=79 z=0 [x8]
L548E:  .word $6710, $0070      ;VCTR s=6 dx=14 dy=-98 z=0 [x8]
L5492:  .word $44A0, $0380      ;VCTR s=4 dx=28 dy=-5 z=0 [x32]
L5496:  .word $F30A             ;SVEC u=8 dx=16 dy=24 z=0

SHIP05:
L5498:  .word $5680, $0460      ;VCTR s=5 dx=-6 dy=-40 z=0 [x16]
L549C:  .word $5220, $02E0      ;VCTR s=5 dx=46 dy=34 z=0 [x16]
L54A0:  .word $42C0, $00C0      ;VCTR s=4 dx=6 dy=22 z=0 [x32]
L54A4:  .word $5420, $0760      ;VCTR s=5 dx=-54 dy=-2 z=0 [x16]
L54A8:  .word $56C0, $05F0      ;VCTR s=5 dx=-31 dy=-44 z=0 [x16]
L54AC:  .word $44C0, $02C0      ;VCTR s=4 dx=22 dy=-6 z=0 [x32]
L54B0:  .word $5130, $0350      ;VCTR s=5 dx=53 dy=19 z=0 [x16]
L54B4:  .word $6248, $0610      ;VCTR s=6 dx=-66 dy=73 z=0 [x8]
L54B8:  .word $6700, $00C0      ;VCTR s=6 dx=24 dy=-96 z=0 [x8]
L54BC:  .word $4440, $03A0      ;VCTR s=4 dx=29 dy=-2 z=0 [x32]
L54C0:  .word $4320, $01A0      ;VCTR s=4 dx=13 dy=25 z=0 [x32]

SHIP06:
L54C4:  .word $5680, $0420      ;VCTR s=5 dx=-2 dy=-40 z=0 [x16]
L54C8:  .word $5260, $02A0      ;VCTR s=5 dx=42 dy=38 z=0 [x16]
L54CC:  .word $42C0, $0080      ;VCTR s=4 dx=4 dy=22 z=0 [x32]
L54D0:  .word $5470, $0750      ;VCTR s=5 dx=-53 dy=-7 z=0 [x16]
L54D4:  .word $56E0, $05A0      ;VCTR s=5 dx=-26 dy=-46 z=0 [x16]
L54D8:  .word $44A0, $02C0      ;VCTR s=4 dx=22 dy=-5 z=0 [x32]
L54DC:  .word $5190, $0330      ;VCTR s=5 dx=51 dy=25 z=0 [x16]
L54E0:  .word $6210, $0650      ;VCTR s=6 dx=-74 dy=66 z=0 [x8]
L54E4:  .word $66E8, $0110      ;VCTR s=6 dx=34 dy=-93 z=0 [x8]
L54E8:  .word $4000, $03A0      ;VCTR s=4 dx=29 dy=0 z=0 [x32]
L54EC:  .word $4360, $0160      ;VCTR s=4 dx=11 dy=27 z=0 [x32]

SHIP07:
L54F0:  .word $5680, $0020      ;VCTR s=5 dx=2 dy=-40 z=0 [x16]
L54F4:  .word $52A0, $0260      ;VCTR s=5 dx=38 dy=42 z=0 [x16]
L54F8:  .word $42C0, $0040      ;VCTR s=4 dx=2 dy=22 z=0 [x32]
L54FC:  .word $54C0, $0740      ;VCTR s=5 dx=-52 dy=-12 z=0 [x16]
L5500:  .word $5710, $0560      ;VCTR s=5 dx=-22 dy=-49 z=0 [x16]
L5504:  .word $4440, $02C0      ;VCTR s=4 dx=22 dy=-2 z=0 [x32]
L5508:  .word $51D0, $0310      ;VCTR s=5 dx=49 dy=29 z=0 [x16]
L550C:  .word $61D8, $0680      ;VCTR s=6 dx=-80 dy=59 z=0 [x8]
L5510:  .word $66C8, $0158      ;VCTR s=6 dx=43 dy=-89 z=0 [x8]
L5514:  .word $4060, $0380      ;VCTR s=4 dx=28 dy=3 z=0 [x32]
L5518:  .word $4360, $0120      ;VCTR s=4 dx=9 dy=27 z=0 [x32]

SHIP10:
L551C:  .word $5680, $0060      ;VCTR s=5 dx=6 dy=-40 z=0 [x16]
L5520:  .word $52E0, $0220      ;VCTR s=5 dx=34 dy=46 z=0 [x16]
L5524:  .word $42C0, $0000      ;VCTR s=4 dx=0 dy=22 z=0 [x32]
L5528:  .word $5510, $0730      ;VCTR s=5 dx=-51 dy=-17 z=0 [x16]
L552C:  .word $5730, $0510      ;VCTR s=5 dx=-17 dy=-51 z=0 [x16]
L5530:  .word $4000, $02C0      ;VCTR s=4 dx=22 dy=0 z=0 [x32]
L5534:  .word $5220, $02E0      ;VCTR s=5 dx=46 dy=34 z=0 [x16]
L5538:  .word $6198, $06A8      ;VCTR s=6 dx=-85 dy=51 z=0 [x8]
L553C:  .word $66A8, $0198      ;VCTR s=6 dx=51 dy=-85 z=0 [x8]
L5540:  .word $40C0, $0380      ;VCTR s=4 dx=28 dy=6 z=0 [x32]
L5544:  .word $4380, $00C0      ;VCTR s=4 dx=6 dy=28 z=0 [x32]

SHIP17:
L5548:  .word $5600, $0580      ;VCTR s=5 dx=-24 dy=-32 z=0 [x16]
L554C:  .word $5080, $7380      ;VCTR s=5 dx=56 dy=8 z=7 [x16]
L5550:  .word $F979             ;SVEC u=16 dx=16 dy=16 z=7
L5552:  .word $5180, $7700      ;VCTR s=5 dx=-48 dy=24 z=7 [x16]
L5556:  .word $5580, $7700      ;VCTR s=5 dx=-48 dy=-24 z=7 [x16]
L555A:  .word $FD79             ;SVEC u=16 dx=16 dy=-16 z=7
L555C:  .word $5480, $7380      ;VCTR s=5 dx=56 dy=-8 z=7 [x16]
L5560:  .word $6300, $74C0      ;VCTR s=6 dx=-24 dy=96 z=7 [x8]
L5564:  .word $6700, $74C0      ;VCTR s=6 dx=-24 dy=-96 z=7 [x8]
L5568:  .word $7080, $0220      ;VCTR s=7 dx=136 dy=32 z=0 [x4]
L556C:  .word $D000             ;RTSL

CHAR_A:
L556E:  .word $FA70             ;SVEC u=4 dx=0 dy=8 z=7
L5570:  .word $F272             ;SVEC u=2 dx=4 dy=4 z=7
L5572:  .word $F672             ;SVEC u=2 dx=4 dy=-4 z=7
L5574:  .word $FE70             ;SVEC u=4 dx=0 dy=-8 z=7
L5576:  .word $F906             ;SVEC u=4 dx=-8 dy=4 z=0
L5578:  .word $F872             ;SVEC u=4 dx=8 dy=0 z=7
L557A:  .word $F602             ;SVEC u=2 dx=4 dy=-4 z=0
L557C:  .word $D000             ;RTSL

CHAR_B:
L557E:  .word $FB70             ;SVEC u=4 dx=0 dy=12 z=7
L5580:  .word $F073             ;SVEC u=2 dx=6 dy=0 z=7
L5582:  .word $F571             ;SVEC u=2 dx=2 dy=-2 z=7
L5584:  .word $F570             ;SVEC u=2 dx=0 dy=-2 z=7
L5586:  .word $F575             ;SVEC u=2 dx=-2 dy=-2 z=7
L5588:  .word $F077             ;SVEC u=2 dx=-6 dy=0 z=7
L558A:  .word $F003             ;SVEC u=2 dx=6 dy=0 z=0
L558C:  .word $F571             ;SVEC u=2 dx=2 dy=-2 z=7
L558E:  .word $F570             ;SVEC u=2 dx=0 dy=-2 z=7
L5590:  .word $F575             ;SVEC u=2 dx=-2 dy=-2 z=7
L5592:  .word $F077             ;SVEC u=2 dx=-6 dy=0 z=7
L5594:  .word $EB0A             ;JMPL CHAR_SPACE ($5614)

CHAR_C:
L5596:  .word $FB70             ;SVEC u=4 dx=0 dy=12 z=7
L5598:  .word $F872             ;SVEC u=4 dx=8 dy=0 z=7
L559A:  .word $FF06             ;SVEC u=4 dx=-8 dy=-12 z=0
L559C:  .word $EB58             ;JMPL UNDERL ($56B0)

CHAR_D:
L559E:  .word $FB70             ;SVEC u=4 dx=0 dy=12 z=7
L55A0:  .word $F072             ;SVEC u=2 dx=4 dy=0 z=7
L55A2:  .word $F672             ;SVEC u=2 dx=4 dy=-4 z=7
L55A4:  .word $F670             ;SVEC u=2 dx=0 dy=-4 z=7
L55A6:  .word $F676             ;SVEC u=2 dx=-4 dy=-4 z=7
L55A8:  .word $F076             ;SVEC u=2 dx=-4 dy=0 z=7
L55AA:  .word $EB0A             ;JMPL CHAR_SPACE ($5614)

CHAR_E:
L55AC:  .word $F872             ;SVEC u=4 dx=8 dy=0 z=7
L55AE:  .word $F806             ;SVEC u=4 dx=-8 dy=0 z=0

CHAR_F:
L55B0:  .word $FB70             ;SVEC u=4 dx=0 dy=12 z=7
L55B2:  .word $F872             ;SVEC u=4 dx=8 dy=0 z=7
L55B4:  .word $F705             ;SVEC u=2 dx=-2 dy=-6 z=0
L55B6:  .word $F077             ;SVEC u=2 dx=-6 dy=0 z=7

CHARF1:
L55B8:  .word $F700             ;SVEC u=2 dx=0 dy=-6 z=0
L55BA:  .word $F803             ;SVEC u=4 dx=12 dy=0 z=0
L55BC:  .word $D000             ;RTSL

CHAR_G:
L55BE:  .word $FB70             ;SVEC u=4 dx=0 dy=12 z=7
L55C0:  .word $F872             ;SVEC u=4 dx=8 dy=0 z=7
L55C2:  .word $F670             ;SVEC u=2 dx=0 dy=-4 z=7
L55C4:  .word $F606             ;SVEC u=2 dx=-4 dy=-4 z=0
L55C6:  .word $F072             ;SVEC u=2 dx=4 dy=0 z=7
L55C8:  .word $F670             ;SVEC u=2 dx=0 dy=-4 z=7
L55CA:  .word $EB09             ;JMPL CHAR01 ($5612)

CHAR_H:
L55CC:  .word $FB70             ;SVEC u=4 dx=0 dy=12 z=7
L55CE:  .word $F700             ;SVEC u=2 dx=0 dy=-6 z=0
L55D0:  .word $F872             ;SVEC u=4 dx=8 dy=0 z=7
L55D2:  .word $F300             ;SVEC u=2 dx=0 dy=6 z=0
L55D4:  .word $EB71             ;JMPL CHAR72 ($56E2)

CHAR_I:
L55D6:  .word $F872             ;SVEC u=4 dx=8 dy=0 z=7
L55D8:  .word $FB06             ;SVEC u=4 dx=-8 dy=12 z=0

CHARI1:
L55DA:  .word $F872             ;SVEC u=4 dx=8 dy=0 z=7
L55DC:  .word $F006             ;SVEC u=2 dx=-4 dy=0 z=0

CHARI2:
L55DE:  .word $FF70             ;SVEC u=4 dx=0 dy=-12 z=7
L55E0:  .word $F802             ;SVEC u=4 dx=8 dy=0 z=0
L55E2:  .word $D000             ;RTSL

CHAR_J:
L55E4:  .word $F200             ;SVEC u=2 dx=0 dy=4 z=0
L55E6:  .word $F672             ;SVEC u=2 dx=4 dy=-4 z=7
L55E8:  .word $F072             ;SVEC u=2 dx=4 dy=0 z=7
L55EA:  .word $EB36             ;JMPL CHARU1 ($566C)

CHAR_K:
L55EC:  .word $FB70             ;SVEC u=4 dx=0 dy=12 z=7
L55EE:  .word $F003             ;SVEC u=2 dx=6 dy=0 z=0
L55F0:  .word $F777             ;SVEC u=2 dx=-6 dy=-6 z=7
L55F2:  .word $F773             ;SVEC u=2 dx=6 dy=-6 z=7
L55F4:  .word $F003             ;SVEC u=2 dx=6 dy=0 z=0
L55F6:  .word $D000             ;RTSL

CHAR_L:
L55F8:  .word $FB00             ;SVEC u=4 dx=0 dy=12 z=0
L55FA:  .word $FF70             ;SVEC u=4 dx=0 dy=-12 z=7
L55FC:  .word $EB58             ;JMPL UNDERL ($56B0)

CHAR_M:
L55FE:  .word $FB70             ;SVEC u=4 dx=0 dy=12 z=7
L5600:  .word $F672             ;SVEC u=2 dx=4 dy=-4 z=7
L5602:  .word $F272             ;SVEC u=2 dx=4 dy=4 z=7
L5604:  .word $EB71             ;JMPL CHAR72 ($56E2)

CHAR_N:
L5606:  .word $FB70             ;SVEC u=4 dx=0 dy=12 z=7
L5608:  .word $FF72             ;SVEC u=4 dx=8 dy=-12 z=7
L560A:  .word $EB36             ;JMPL CHARU1 ($566C)

CHAR_O:
L560C:  .word $FB70             ;SVEC u=4 dx=0 dy=12 z=7
L560E:  .word $F872             ;SVEC u=4 dx=8 dy=0 z=7
L5610:  .word $FF70             ;SVEC u=4 dx=0 dy=-12 z=7

CHAR01:
L5612:  .word $F876             ;SVEC u=4 dx=-8 dy=0 z=7

CHAR_SPACE:
L5614:  .word $F803             ;SVEC u=4 dx=12 dy=0 z=0
L5616:  .word $D000             ;RTSL

CHAR_P:
L5618:  .word $FB70             ;SVEC u=4 dx=0 dy=12 z=7
L561A:  .word $F872             ;SVEC u=4 dx=8 dy=0 z=7
L561C:  .word $F770             ;SVEC u=2 dx=0 dy=-6 z=7
L561E:  .word $F876             ;SVEC u=4 dx=-8 dy=0 z=7
L5620:  .word $EADC             ;JMPL CHARF1 ($55B8)

CHAR_Q:
L5622:  .word $FB70             ;SVEC u=4 dx=0 dy=12 z=7
L5624:  .word $F872             ;SVEC u=4 dx=8 dy=0 z=7
L5626:  .word $FE70             ;SVEC u=4 dx=0 dy=-8 z=7
L5628:  .word $F676             ;SVEC u=2 dx=-4 dy=-4 z=7
L562A:  .word $F076             ;SVEC u=2 dx=-4 dy=0 z=7
L562C:  .word $F202             ;SVEC u=2 dx=4 dy=4 z=0
L562E:  .word $F672             ;SVEC u=2 dx=4 dy=-4 z=7
L5630:  .word $EB59             ;JMPL CHAR21 ($56B2)

CHAR_R:
L5632:  .word $FB70             ;SVEC u=4 dx=0 dy=12 z=7
L5634:  .word $F872             ;SVEC u=4 dx=8 dy=0 z=7
L5636:  .word $F770             ;SVEC u=2 dx=0 dy=-6 z=7
L5638:  .word $F876             ;SVEC u=4 dx=-8 dy=0 z=7
L563A:  .word $F001             ;SVEC u=2 dx=2 dy=0 z=0
L563C:  .word $F773             ;SVEC u=2 dx=6 dy=-6 z=7
L563E:  .word $EB59             ;JMPL CHAR21 ($56B2)

Z_5:
L5640:  .word $F200             ;SVEC u=2 dx=0 dy=4 z=0
L5642:  .word $FA73             ;SVEC u=4 dx=12 dy=8 z=7
L5644:  .word $F906             ;SVEC u=4 dx=-8 dy=4 z=0
L5646:  .word $FE70             ;SVEC u=4 dx=0 dy=-8 z=7
L5648:  .word $F601             ;SVEC u=2 dx=2 dy=-4 z=0
L564A:  .word $F072             ;SVEC u=2 dx=4 dy=0 z=7
L564C:  .word $F670             ;SVEC u=2 dx=0 dy=-4 z=7
L564E:  .word $F076             ;SVEC u=2 dx=-4 dy=0 z=7
L5650:  .word $F670             ;SVEC u=2 dx=0 dy=-4 z=7
L5652:  .word $F072             ;SVEC u=2 dx=4 dy=0 z=7
L5654:  .word $D000             ;RTSL

CHAR_S:
L5656:  .word $F872             ;SVEC u=4 dx=8 dy=0 z=7
L5658:  .word $F370             ;SVEC u=2 dx=0 dy=6 z=7
L565A:  .word $F876             ;SVEC u=4 dx=-8 dy=0 z=7
L565C:  .word $F370             ;SVEC u=2 dx=0 dy=6 z=7
L565E:  .word $F872             ;SVEC u=4 dx=8 dy=0 z=7
L5660:  .word $EB37             ;JMPL CHARU2 ($566E)

CHAR_T:
L5662:  .word $FB00             ;SVEC u=4 dx=0 dy=12 z=0
L5664:  .word $EAED             ;JMPL CHARI1 ($55DA)

CHAR_U:
L5666:  .word $FB00             ;SVEC u=4 dx=0 dy=12 z=0
L5668:  .word $FF70             ;SVEC u=4 dx=0 dy=-12 z=7
L566A:  .word $F872             ;SVEC u=4 dx=8 dy=0 z=7

CHARU1:
L566C:  .word $FB70             ;SVEC u=4 dx=0 dy=12 z=7

CHARU2:
L566E:  .word $FF01             ;SVEC u=4 dx=4 dy=-12 z=0
L5670:  .word $D000             ;RTSL

CHAR_V:
L5672:  .word $FB00             ;SVEC u=4 dx=0 dy=12 z=0
L5674:  .word $FF71             ;SVEC u=4 dx=4 dy=-12 z=7
L5676:  .word $FB71             ;SVEC u=4 dx=4 dy=12 z=7
L5678:  .word $EB37             ;JMPL CHARU2 ($566E)

CHAR_W:
L567A:  .word $FB00             ;SVEC u=4 dx=0 dy=12 z=0
L567C:  .word $FF70             ;SVEC u=4 dx=0 dy=-12 z=7
L567E:  .word $F272             ;SVEC u=2 dx=4 dy=4 z=7
L5680:  .word $F672             ;SVEC u=2 dx=4 dy=-4 z=7
L5682:  .word $EB36             ;JMPL CHARU1 ($566C)

CHAR_X:
L5684:  .word $FB72             ;SVEC u=4 dx=8 dy=12 z=7
L5686:  .word $F806             ;SVEC u=4 dx=-8 dy=0 z=0
L5688:  .word $FF72             ;SVEC u=4 dx=8 dy=-12 z=7
L568A:  .word $EB72             ;JMPL CHAR73 ($56E4)

CHAR_Y:
L568C:  .word $F002             ;SVEC u=2 dx=4 dy=0 z=0
L568E:  .word $FA70             ;SVEC u=4 dx=0 dy=8 z=7
L5690:  .word $F276             ;SVEC u=2 dx=-4 dy=4 z=7
L5692:  .word $F802             ;SVEC u=4 dx=8 dy=0 z=0
L5694:  .word $F676             ;SVEC u=2 dx=-4 dy=-4 z=7
L5696:  .word $FE02             ;SVEC u=4 dx=8 dy=-8 z=0
L5698:  .word $D000             ;RTSL

CHAR_Z:
L569A:  .word $FB00             ;SVEC u=4 dx=0 dy=12 z=0
L569C:  .word $F872             ;SVEC u=4 dx=8 dy=0 z=7
L569E:  .word $FF76             ;SVEC u=4 dx=-8 dy=-12 z=7
L56A0:  .word $EB58             ;JMPL UNDERL ($56B0)

CHAR_1:
L56A2:  .word $FB01             ;SVEC u=4 dx=4 dy=12 z=0
L56A4:  .word $EAEF             ;JMPL CHARI2 ($55DE)

CHAR_2:
L56A6:  .word $FB00             ;SVEC u=4 dx=0 dy=12 z=0
L56A8:  .word $F872             ;SVEC u=4 dx=8 dy=0 z=7
L56AA:  .word $F770             ;SVEC u=2 dx=0 dy=-6 z=7
L56AC:  .word $F876             ;SVEC u=4 dx=-8 dy=0 z=7
L56AE:  .word $F770             ;SVEC u=2 dx=0 dy=-6 z=7

UNDERL:
L56B0:  .word $F872             ;SVEC u=4 dx=8 dy=0 z=7

CHAR21:
L56B2:  .word $F002             ;SVEC u=2 dx=4 dy=0 z=0
L56B4:  .word $D000             ;RTSL

CHAR_3:
L56B6:  .word $FB00             ;SVEC u=4 dx=0 dy=12 z=0

CHAR31:
L56B8:  .word $F872             ;SVEC u=4 dx=8 dy=0 z=7
L56BA:  .word $FF70             ;SVEC u=4 dx=0 dy=-12 z=7
L56BC:  .word $F876             ;SVEC u=4 dx=-8 dy=0 z=7
L56BE:  .word $F300             ;SVEC u=2 dx=0 dy=6 z=0
L56C0:  .word $F872             ;SVEC u=4 dx=8 dy=0 z=7
L56C2:  .word $F702             ;SVEC u=2 dx=4 dy=-6 z=0
L56C4:  .word $D000             ;RTSL

CHAR_4:
L56C6:  .word $FB00             ;SVEC u=4 dx=0 dy=12 z=0
L56C8:  .word $F770             ;SVEC u=2 dx=0 dy=-6 z=7
L56CA:  .word $F872             ;SVEC u=4 dx=8 dy=0 z=7
L56CC:  .word $F300             ;SVEC u=2 dx=0 dy=6 z=0
L56CE:  .word $EB71             ;JMPL CHAR72 ($56E2)

CHAR_6:
L56D0:  .word $F300             ;SVEC u=2 dx=0 dy=6 z=0
L56D2:  .word $F872             ;SVEC u=4 dx=8 dy=0 z=7
L56D4:  .word $F770             ;SVEC u=2 dx=0 dy=-6 z=7
L56D6:  .word $F876             ;SVEC u=4 dx=-8 dy=0 z=7
L56D8:  .word $FB70             ;SVEC u=4 dx=0 dy=12 z=7
L56DA:  .word $FF03             ;SVEC u=4 dx=12 dy=-12 z=0
L56DC:  .word $D000             ;RTSL

CHAR_7:
L56DE:  .word $FB00             ;SVEC u=4 dx=0 dy=12 z=0

CHAR71:
L56E0:  .word $F872             ;SVEC u=4 dx=8 dy=0 z=7

CHAR72:
L56E2:  .word $FF70             ;SVEC u=4 dx=0 dy=-12 z=7

CHAR73:
L56E4:  .word $F002             ;SVEC u=2 dx=4 dy=0 z=0
L56E6:  .word $D000             ;RTSL

JJ98:
L56E8:  .word $CB77             ;JSRL CHAR_9 ($56EE)

CHAR_8:
L56EA:  .word $FB70             ;SVEC u=4 dx=0 dy=12 z=7
L56EC:  .word $EB5C             ;JMPL CHAR31 ($56B8)

CHAR_9:
L56EE:  .word $F802             ;SVEC u=4 dx=8 dy=0 z=0
L56F0:  .word $F300             ;SVEC u=2 dx=0 dy=6 z=0
L56F2:  .word $F876             ;SVEC u=4 dx=-8 dy=0 z=7
L56F4:  .word $F370             ;SVEC u=2 dx=0 dy=6 z=7
L56F6:  .byte $70               ;p
L56F7:  .byte $EB               ;.

VGMSGA:
L56F8:  .byte $0A               ;.
L56F9:  .byte $CB               ;.
L56FA:  .word $CB06             ;JSRL CHAR_O ($560C)
L56FC:  .word $CB51             ;JSRL CHAR_1 ($56A2)
L56FE:  .word $CB53             ;JSRL CHAR_2 ($56A6)
L5700:  .word $CB5B             ;JSRL CHAR_3 ($56B6)
L5702:  .word $CB63             ;JSRL CHAR_4 ($56C6)
L5704:  .word $CB2B             ;JSRL CHAR_S ($5656)
L5706:  .word $CB68             ;JSRL CHAR_6 ($56D0)
L5708:  .word $CB6F             ;JSRL CHAR_7 ($56DE)
L570A:  .word $CB75             ;JSRL CHAR_8 ($56EA)
L570C:  .word $CB77             ;JSRL CHAR_9 ($56EE)
L570E:  .word $CAB7             ;JSRL CHAR_A ($556E)
L5710:  .word $CABF             ;JSRL CHAR_B ($557E)
L5712:  .word $CACB             ;JSRL CHAR_C ($5596)
L5714:  .word $CACF             ;JSRL CHAR_D ($559E)
L5716:  .word $CAD6             ;JSRL CHAR_E ($55AC)
L5718:  .word $CAD8             ;JSRL CHAR_F ($55B0)
L571A:  .word $CADF             ;JSRL CHAR_G ($55BE)
L571C:  .word $CAE6             ;JSRL CHAR_H ($55CC)
L571E:  .word $CAEB             ;JSRL CHAR_I ($55D6)
L5720:  .word $CAF2             ;JSRL CHAR_J ($55E4)
L5722:  .word $CAF6             ;JSRL CHAR_K ($55EC)
L5724:  .word $CAFC             ;JSRL CHAR_L ($55F8)
L5726:  .word $CAFF             ;JSRL CHAR_M ($55FE)
L5728:  .word $CB03             ;JSRL CHAR_N ($5606)
L572A:  .word $CB06             ;JSRL CHAR_O ($560C)
L572C:  .word $CB0C             ;JSRL CHAR_P ($5618)
L572E:  .word $CB11             ;JSRL CHAR_Q ($5622)
L5730:  .word $CB19             ;JSRL CHAR_R ($5632)
L5732:  .word $CB2B             ;JSRL CHAR_S ($5656)
L5734:  .word $CB31             ;JSRL CHAR_T ($5662)
L5736:  .word $CB33             ;JSRL CHAR_U ($5666)
L5738:  .word $CB39             ;JSRL CHAR_V ($5672)
L573A:  .word $CB3D             ;JSRL CHAR_W ($567A)
L573C:  .word $CB42             ;JSRL CHAR_X ($5684)
L573E:  .word $CB46             ;JSRL CHAR_Y ($568C)
L5740:  .word $CB4D             ;JSRL CHAR_Z ($569A)
L5742:  .word $CB74             ;JSRL JJ98 ($56E8)

TEST1:
L5744:  .word $A080, $0000      ;LABS size=0 x=0 y=128
L5748:  .word $7000, $0000      ;WAIT t=7 z=0
L574C:  .word $9000, $73FF      ;VCTR s=9 dx=1023 dy=0 z=7 [x1]
L5750:  .word $92FF, $7000      ;VCTR s=9 dx=0 dy=767 z=7 [x1]
L5754:  .word $9000, $77FF      ;VCTR s=9 dx=-1023 dy=0 z=7 [x1]
L5758:  .word $96FF, $7000      ;VCTR s=9 dx=0 dy=-767 z=7 [x1]
L575C:  .word $92FF, $72FF      ;VCTR s=9 dx=767 dy=767 z=7 [x1]
L5760:  .word $8600, $7200      ;VCTR s=8 dx=256 dy=-256 z=7 [x2]
L5764:  .word $87FE, $77FE      ;VCTR s=8 dx=-511 dy=-511 z=7 [x2]
L5768:  .word $9200, $7600      ;VCTR s=9 dx=-512 dy=512 z=7 [x1]
L576C:  .word $81FE, $7200      ;VCTR s=8 dx=256 dy=255 z=7 [x2]
L5770:  .word $96FF, $72FF      ;VCTR s=9 dx=767 dy=-767 z=7 [x1]
L5774:  .word $A37F, $03FF      ;LABS size=0 x=1023 y=895
L5778:  .word $7000, $0000      ;WAIT t=7 z=0
L577C:  .word $96FF, $76FF      ;VCTR s=9 dx=-767 dy=-767 z=7 [x1]
L5780:  .word $81FE, $7600      ;VCTR s=8 dx=-256 dy=255 z=7 [x2]
L5784:  .word $9200, $7200      ;VCTR s=9 dx=512 dy=512 z=7 [x1]
L5788:  .word $87FE, $73FE      ;VCTR s=8 dx=511 dy=-511 z=7 [x2]
L578C:  .word $8600, $7600      ;VCTR s=8 dx=-256 dy=-256 z=7 [x2]
L5790:  .word $92FF, $76FF      ;VCTR s=9 dx=-767 dy=767 z=7 [x1]
L5794:  .word $A1FC, $01F4      ;LABS size=0 x=500 y=508
L5798:  .word $7000, $0000      ;WAIT t=7 z=0
L579C:  .word $F0DB             ;SVEC u=8 dx=24 dy=0 z=13
L579E:  .word $F900             ;SVEC u=4 dx=0 dy=4 z=0
L57A0:  .word $F0CF             ;SVEC u=8 dx=-24 dy=0 z=12
L57A2:  .word $F900             ;SVEC u=4 dx=0 dy=4 z=0
L57A4:  .word $F0BB             ;SVEC u=8 dx=24 dy=0 z=11
L57A6:  .word $F900             ;SVEC u=4 dx=0 dy=4 z=0
L57A8:  .word $F0AF             ;SVEC u=8 dx=-24 dy=0 z=10
L57AA:  .word $F900             ;SVEC u=4 dx=0 dy=4 z=0
L57AC:  .word $F09B             ;SVEC u=8 dx=24 dy=0 z=9
L57AE:  .word $F900             ;SVEC u=4 dx=0 dy=4 z=0
L57B0:  .word $F08F             ;SVEC u=8 dx=-24 dy=0 z=8
L57B2:  .word $F900             ;SVEC u=4 dx=0 dy=4 z=0
L57B4:  .word $F07B             ;SVEC u=8 dx=24 dy=0 z=7
L57B6:  .word $F900             ;SVEC u=4 dx=0 dy=4 z=0
L57B8:  .word $F06F             ;SVEC u=8 dx=-24 dy=0 z=6
L57BA:  .word $F900             ;SVEC u=4 dx=0 dy=4 z=0
L57BC:  .word $F05B             ;SVEC u=8 dx=24 dy=0 z=5
L57BE:  .word $F900             ;SVEC u=4 dx=0 dy=4 z=0
L57C0:  .word $F04F             ;SVEC u=8 dx=-24 dy=0 z=4
L57C2:  .word $F900             ;SVEC u=4 dx=0 dy=4 z=0
L57C4:  .word $F03B             ;SVEC u=8 dx=24 dy=0 z=3
L57C6:  .word $F900             ;SVEC u=4 dx=0 dy=4 z=0
L57C8:  .word $F02F             ;SVEC u=8 dx=-24 dy=0 z=2
L57CA:  .word $D000             ;RTSL

BNKERR:
L57CC:  .word $A0E4, $115E      ;LABS size=1 x=350 y=228
L57D0:  .word $7000, $0000      ;WAIT t=7 z=0
L57D4:  .word $CABF             ;JSRL CHAR_B ($557E)
L57D6:  .word $CAB7             ;JSRL CHAR_A ($556E)
L57D8:  .word $CB03             ;JSRL CHAR_N ($5606)
L57DA:  .word $CAF6             ;JSRL CHAR_K ($55EC)
L57DC:  .word $CB0A             ;JSRL CHAR_SPACE ($5614)

ERM:
L57DE:  .word $CAD6             ;JSRL CHAR_E ($55AC)
L57E0:  .word $CB19             ;JSRL CHAR_R ($5632)
L57E2:  .word $CB19             ;JSRL CHAR_R ($5632)
L57E4:  .word $CB06             ;JSRL CHAR_O ($560C)
L57E6:  .word $EB19             ;JMPL CHAR_R ($5632)

PKYERR:
L57E8:  .word $A0C0, $119A      ;LABS size=1 x=410 y=192
L57EC:  .word $7000, $0000      ;WAIT t=7 z=0
L57F0:  .word $EBEF             ;JMPL ERM ($57DE)

ERASE:
L57F2:  .word $CAD6             ;JSRL CHAR_E ($55AC)
L57F4:  .word $CB19             ;JSRL CHAR_R ($5632)
L57F6:  .word $CAB7             ;JSRL CHAR_A ($556E)
L57F8:  .word $CB2B             ;JSRL CHAR_S ($5656)
L57FA:  .word $CAEB             ;JSRL CHAR_I ($55D6)
L57FC:  .word $CB03             ;JSRL CHAR_N ($5606)
L57FE:  .word $EADF             ;JMPL CHAR_G ($55BE)
